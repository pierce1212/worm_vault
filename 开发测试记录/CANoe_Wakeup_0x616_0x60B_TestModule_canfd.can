includes
{
}

variables
{
  msTimer tWakeSend;
  msTimer tSleepMonitor;
  msTimer tNextRound;
  msTimer tCanFdObserve;

  message *gTraceCanFdMsg;

  int gState = 0;             // 0=idle, 1=sending 0x616, 2=waiting sleep after 0x616, 3=waiting CAN FD probe delay, 4=observing CAN FD probe, 6=waiting next 0x616
  int gTestRunning = 0;
  int gWakeSendEnabled = 0;
  long gRound = 0;
  long gTotalCount = 0;       // 0 means run forever
  long gWakeSuccessCount = 0;
  long gWakeFailCount = 0;
  long gSleepSuccessCount = 0;
  long gSleepFailCount = 0;

  int gSendCount = 0;
  int gMaxSendCount = 200;
  int gSendPeriodMs = 10;

  long gSleepSilentElapsedMs = 0;
  long gSleepWaitElapsedMs = 0;
  long gSleepSilentTimeMs = 500;   // 0x60B absent this long means sleep
  long gSleepTimeoutMs = 10000;    // stop sequence if 0x60B is still present after this
  long gSleepCheckPeriodMs = 100;
  long gNextRoundDelayMs = 10000;  // wait after sleep is detected

  long gTraceMsgCount = 162;
  long gTraceNextIndex = 0;
  long gTraceCurrentIndex = -1;
  long gTraceCurrentId = 0;
  int gTraceCurrentLength = 0;
  long gTraceSentCount = 0;
  long gCanFdNoWakeCount = 0;
  long gCanFdAbnormalWakeCount = 0;
  long gCanFdObserveTimeMs = 10000; // observe 0x60B this long after the CAN FD probe
  long gCanErrorFrameCount = 0;
  long gCanErrorFrameCountAtProbe = 0;
}

long GetCanFdDlcCode(long dataLength)
{
  if (dataLength <= 8) { return dataLength; }
  if (dataLength <= 12) { return 9; }
  if (dataLength <= 16) { return 10; }
  if (dataLength <= 20) { return 11; }
  if (dataLength <= 24) { return 12; }
  if (dataLength <= 32) { return 13; }
  if (dataLength <= 48) { return 14; }
  return 15;
}

void TraceClearCurrentMessage()
{
  long i;

  for (i = 0; i < 64; i++)
  {
    gTraceCanFdMsg.byte(i) = 0;
  }
}

void TraceLoadCurrentMessage(long traceIndex)
{
  TraceClearCurrentMessage();

  gTraceCurrentIndex = traceIndex;
  gTraceCurrentId = 0;
  gTraceCurrentLength = 0;

  switch (traceIndex)
  {
    case 0:
      gTraceCurrentId = 0x21;
      gTraceCurrentLength = 8;
      gTraceCanFdMsg.byte(0) = 0x54;
      gTraceCanFdMsg.byte(1) = 0x04;
      gTraceCanFdMsg.byte(2) = 0x07;
      gTraceCanFdMsg.byte(3) = 0xD1;
      gTraceCanFdMsg.byte(4) = 0x00;
      gTraceCanFdMsg.byte(5) = 0x00;
      gTraceCanFdMsg.byte(6) = 0x00;
      gTraceCanFdMsg.byte(7) = 0x00;
      break;
    case 1:
      gTraceCurrentId = 0x31;
      gTraceCurrentLength = 8;
      gTraceCanFdMsg.byte(0) = 0xBF;
      gTraceCanFdMsg.byte(1) = 0x03;
      gTraceCanFdMsg.byte(2) = 0x07;
      gTraceCanFdMsg.byte(3) = 0xC7;
      gTraceCanFdMsg.byte(4) = 0x46;
      gTraceCanFdMsg.byte(5) = 0x53;
      gTraceCanFdMsg.byte(6) = 0x01;
      gTraceCanFdMsg.byte(7) = 0x00;
      break;
    case 2:
      gTraceCurrentId = 0x38;
      gTraceCurrentLength = 16;
      gTraceCanFdMsg.byte(0) = 0x27;
      gTraceCanFdMsg.byte(1) = 0x03;
      gTraceCanFdMsg.byte(2) = 0x22;
      gTraceCanFdMsg.byte(3) = 0x30;
      gTraceCanFdMsg.byte(4) = 0x00;
      gTraceCanFdMsg.byte(5) = 0x00;
      gTraceCanFdMsg.byte(6) = 0x00;
      gTraceCanFdMsg.byte(7) = 0x00;
      gTraceCanFdMsg.byte(8) = 0x5D;
      gTraceCanFdMsg.byte(9) = 0x00;
      gTraceCanFdMsg.byte(10) = 0xDA;
      gTraceCanFdMsg.byte(11) = 0xC0;
      gTraceCanFdMsg.byte(12) = 0x00;
      gTraceCanFdMsg.byte(13) = 0x00;
      gTraceCanFdMsg.byte(14) = 0x00;
      gTraceCanFdMsg.byte(15) = 0x00;
      break;
    case 3:
      gTraceCurrentId = 0x3B;
      gTraceCurrentLength = 64;
      gTraceCanFdMsg.byte(0) = 0x4D;
      gTraceCanFdMsg.byte(1) = 0x02;
      gTraceCanFdMsg.byte(2) = 0x80;
      gTraceCanFdMsg.byte(3) = 0x00;
      gTraceCanFdMsg.byte(4) = 0x80;
      gTraceCanFdMsg.byte(5) = 0x00;
      gTraceCanFdMsg.byte(6) = 0x7F;
      gTraceCanFdMsg.byte(7) = 0xFF;
      gTraceCanFdMsg.byte(8) = 0xD8;
      gTraceCanFdMsg.byte(9) = 0x02;
      gTraceCanFdMsg.byte(10) = 0x00;
      gTraceCanFdMsg.byte(11) = 0x80;
      gTraceCanFdMsg.byte(12) = 0x00;
      gTraceCanFdMsg.byte(13) = 0x80;
      gTraceCanFdMsg.byte(14) = 0x00;
      gTraceCanFdMsg.byte(15) = 0x00;
      gTraceCanFdMsg.byte(16) = 0xD8;
      gTraceCanFdMsg.byte(17) = 0x02;
      gTraceCanFdMsg.byte(18) = 0x7F;
      gTraceCanFdMsg.byte(19) = 0xFF;
      gTraceCanFdMsg.byte(20) = 0x00;
      gTraceCanFdMsg.byte(21) = 0x80;
      gTraceCanFdMsg.byte(22) = 0x00;
      gTraceCanFdMsg.byte(23) = 0x00;
      gTraceCanFdMsg.byte(24) = 0x0B;
      gTraceCanFdMsg.byte(25) = 0x02;
      gTraceCanFdMsg.byte(26) = 0x80;
      gTraceCanFdMsg.byte(27) = 0x00;
      gTraceCanFdMsg.byte(28) = 0x05;
      gTraceCanFdMsg.byte(29) = 0x00;
      gTraceCanFdMsg.byte(30) = 0x00;
      gTraceCanFdMsg.byte(31) = 0x00;
      gTraceCanFdMsg.byte(32) = 0xDE;
      gTraceCanFdMsg.byte(33) = 0x02;
      gTraceCanFdMsg.byte(34) = 0x80;
      gTraceCanFdMsg.byte(35) = 0x00;
      gTraceCanFdMsg.byte(36) = 0x40;
      gTraceCanFdMsg.byte(37) = 0x80;
      gTraceCanFdMsg.byte(38) = 0x00;
      gTraceCanFdMsg.byte(39) = 0x40;
      gTraceCanFdMsg.byte(40) = 0xAC;
      gTraceCanFdMsg.byte(41) = 0x02;
      gTraceCanFdMsg.byte(42) = 0x80;
      gTraceCanFdMsg.byte(43) = 0x00;
      gTraceCanFdMsg.byte(44) = 0x80;
      gTraceCanFdMsg.byte(45) = 0x00;
      gTraceCanFdMsg.byte(46) = 0x00;
      gTraceCanFdMsg.byte(47) = 0x00;
      gTraceCanFdMsg.byte(48) = 0x70;
      gTraceCanFdMsg.byte(49) = 0x02;
      gTraceCanFdMsg.byte(50) = 0x00;
      gTraceCanFdMsg.byte(51) = 0xFF;
      gTraceCanFdMsg.byte(52) = 0xFF;
      gTraceCanFdMsg.byte(53) = 0x00;
      gTraceCanFdMsg.byte(54) = 0x00;
      gTraceCanFdMsg.byte(55) = 0x00;
      gTraceCanFdMsg.byte(56) = 0xEC;
      gTraceCanFdMsg.byte(57) = 0x20;
      gTraceCanFdMsg.byte(58) = 0x00;
      gTraceCanFdMsg.byte(59) = 0x00;
      gTraceCanFdMsg.byte(60) = 0x00;
      gTraceCanFdMsg.byte(61) = 0x00;
      gTraceCanFdMsg.byte(62) = 0x00;
      gTraceCanFdMsg.byte(63) = 0x00;
      break;
    case 4:
      gTraceCurrentId = 0x4B;
      gTraceCurrentLength = 24;
      gTraceCanFdMsg.byte(0) = 0x70;
      gTraceCanFdMsg.byte(1) = 0x02;
      gTraceCanFdMsg.byte(2) = 0x80;
      gTraceCanFdMsg.byte(3) = 0x00;
      gTraceCanFdMsg.byte(4) = 0x80;
      gTraceCanFdMsg.byte(5) = 0x00;
      gTraceCanFdMsg.byte(6) = 0x11;
      gTraceCanFdMsg.byte(7) = 0x00;
      gTraceCanFdMsg.byte(8) = 0x27;
      gTraceCanFdMsg.byte(9) = 0x02;
      gTraceCanFdMsg.byte(10) = 0x80;
      gTraceCanFdMsg.byte(11) = 0x00;
      gTraceCanFdMsg.byte(12) = 0x80;
      gTraceCanFdMsg.byte(13) = 0x00;
      gTraceCanFdMsg.byte(14) = 0x00;
      gTraceCanFdMsg.byte(15) = 0x00;
      gTraceCanFdMsg.byte(16) = 0x76;
      gTraceCanFdMsg.byte(17) = 0x02;
      gTraceCanFdMsg.byte(18) = 0x00;
      gTraceCanFdMsg.byte(19) = 0x00;
      gTraceCanFdMsg.byte(20) = 0xC0;
      gTraceCanFdMsg.byte(21) = 0x00;
      gTraceCanFdMsg.byte(22) = 0x00;
      gTraceCanFdMsg.byte(23) = 0x00;
      break;
    case 5:
      gTraceCurrentId = 0x59;
      gTraceCurrentLength = 8;
      gTraceCanFdMsg.byte(0) = 0xA6;
      gTraceCanFdMsg.byte(1) = 0x26;
      gTraceCanFdMsg.byte(2) = 0x75;
      gTraceCanFdMsg.byte(3) = 0x30;
      gTraceCanFdMsg.byte(4) = 0x12;
      gTraceCanFdMsg.byte(5) = 0x00;
      gTraceCanFdMsg.byte(6) = 0x00;
      gTraceCanFdMsg.byte(7) = 0x00;
      break;
    case 6:
      gTraceCurrentId = 0x5A;
      gTraceCurrentLength = 8;
      gTraceCanFdMsg.byte(0) = 0x80;
      gTraceCanFdMsg.byte(1) = 0x21;
      gTraceCanFdMsg.byte(2) = 0xC3;
      gTraceCanFdMsg.byte(3) = 0x50;
      gTraceCanFdMsg.byte(4) = 0x12;
      gTraceCanFdMsg.byte(5) = 0x00;
      gTraceCanFdMsg.byte(6) = 0x7F;
      gTraceCanFdMsg.byte(7) = 0xFF;
      break;
    case 7:
      gTraceCurrentId = 0x66;
      gTraceCurrentLength = 8;
      gTraceCanFdMsg.byte(0) = 0x00;
      gTraceCanFdMsg.byte(1) = 0x00;
      gTraceCanFdMsg.byte(2) = 0x00;
      gTraceCanFdMsg.byte(3) = 0x55;
      gTraceCanFdMsg.byte(4) = 0x65;
      gTraceCanFdMsg.byte(5) = 0x4F;
      gTraceCanFdMsg.byte(6) = 0x55;
      gTraceCanFdMsg.byte(7) = 0x72;
      break;
    case 8:
      gTraceCurrentId = 0x69;
      gTraceCurrentLength = 24;
      gTraceCanFdMsg.byte(0) = 0xB9;
      gTraceCanFdMsg.byte(1) = 0xFE;
      gTraceCanFdMsg.byte(2) = 0x59;
      gTraceCanFdMsg.byte(3) = 0x04;
      gTraceCanFdMsg.byte(4) = 0x2E;
      gTraceCanFdMsg.byte(5) = 0xA4;
      gTraceCanFdMsg.byte(6) = 0x00;
      gTraceCanFdMsg.byte(7) = 0x00;
      gTraceCanFdMsg.byte(8) = 0x00;
      gTraceCanFdMsg.byte(9) = 0x00;
      gTraceCanFdMsg.byte(10) = 0x58;
      gTraceCanFdMsg.byte(11) = 0xE8;
      gTraceCanFdMsg.byte(12) = 0x5D;
      gTraceCanFdMsg.byte(13) = 0x08;
      gTraceCanFdMsg.byte(14) = 0x00;
      gTraceCanFdMsg.byte(15) = 0x00;
      gTraceCanFdMsg.byte(16) = 0x00;
      gTraceCanFdMsg.byte(17) = 0x00;
      gTraceCanFdMsg.byte(18) = 0x0B;
      gTraceCanFdMsg.byte(19) = 0x8A;
      gTraceCanFdMsg.byte(20) = 0x07;
      gTraceCanFdMsg.byte(21) = 0xF3;
      gTraceCanFdMsg.byte(22) = 0x4C;
      gTraceCanFdMsg.byte(23) = 0xB0;
      break;
    case 9:
      gTraceCurrentId = 0x79;
      gTraceCurrentLength = 16;
      gTraceCanFdMsg.byte(0) = 0x00;
      gTraceCanFdMsg.byte(1) = 0x00;
      gTraceCanFdMsg.byte(2) = 0x00;
      gTraceCanFdMsg.byte(3) = 0x55;
      gTraceCanFdMsg.byte(4) = 0x54;
      gTraceCanFdMsg.byte(5) = 0x00;
      gTraceCanFdMsg.byte(6) = 0x00;
      gTraceCanFdMsg.byte(7) = 0x00;
      gTraceCanFdMsg.byte(8) = 0x00;
      gTraceCanFdMsg.byte(9) = 0x00;
      gTraceCanFdMsg.byte(10) = 0x00;
      gTraceCanFdMsg.byte(11) = 0x00;
      gTraceCanFdMsg.byte(12) = 0x00;
      gTraceCanFdMsg.byte(13) = 0x00;
      gTraceCanFdMsg.byte(14) = 0x55;
      gTraceCanFdMsg.byte(15) = 0x00;
      break;
    case 10:
      gTraceCurrentId = 0x85;
      gTraceCurrentLength = 16;
      gTraceCanFdMsg.byte(0) = 0x00;
      gTraceCanFdMsg.byte(1) = 0x00;
      gTraceCanFdMsg.byte(2) = 0x00;
      gTraceCanFdMsg.byte(3) = 0x00;
      gTraceCanFdMsg.byte(4) = 0x00;
      gTraceCanFdMsg.byte(5) = 0x00;
      gTraceCanFdMsg.byte(6) = 0x00;
      gTraceCanFdMsg.byte(7) = 0x00;
      gTraceCanFdMsg.byte(8) = 0x00;
      gTraceCanFdMsg.byte(9) = 0x00;
      gTraceCanFdMsg.byte(10) = 0x00;
      gTraceCanFdMsg.byte(11) = 0x00;
      gTraceCanFdMsg.byte(12) = 0x00;
      gTraceCanFdMsg.byte(13) = 0x00;
      gTraceCanFdMsg.byte(14) = 0x00;
      gTraceCanFdMsg.byte(15) = 0x00;
      break;
    case 11:
      gTraceCurrentId = 0x8F;
      gTraceCurrentLength = 8;
      gTraceCanFdMsg.byte(0) = 0xD9;
      gTraceCanFdMsg.byte(1) = 0x03;
      gTraceCanFdMsg.byte(2) = 0x80;
      gTraceCanFdMsg.byte(3) = 0x00;
      gTraceCanFdMsg.byte(4) = 0x00;
      gTraceCanFdMsg.byte(5) = 0x05;
      gTraceCanFdMsg.byte(6) = 0x00;
      gTraceCanFdMsg.byte(7) = 0x00;
      break;
    case 12:
      gTraceCurrentId = 0x98;
      gTraceCurrentLength = 24;
      gTraceCanFdMsg.byte(0) = 0xAD;
      gTraceCanFdMsg.byte(1) = 0x00;
      gTraceCanFdMsg.byte(2) = 0x00;
      gTraceCanFdMsg.byte(3) = 0x00;
      gTraceCanFdMsg.byte(4) = 0x00;
      gTraceCanFdMsg.byte(5) = 0x14;
      gTraceCanFdMsg.byte(6) = 0x23;
      gTraceCanFdMsg.byte(7) = 0x00;
      gTraceCanFdMsg.byte(8) = 0x1D;
      gTraceCanFdMsg.byte(9) = 0x00;
      gTraceCanFdMsg.byte(10) = 0x80;
      gTraceCanFdMsg.byte(11) = 0x00;
      gTraceCanFdMsg.byte(12) = 0x00;
      gTraceCanFdMsg.byte(13) = 0x00;
      gTraceCanFdMsg.byte(14) = 0x00;
      gTraceCanFdMsg.byte(15) = 0x00;
      gTraceCanFdMsg.byte(16) = 0x54;
      gTraceCanFdMsg.byte(17) = 0x00;
      gTraceCanFdMsg.byte(18) = 0x00;
      gTraceCanFdMsg.byte(19) = 0x00;
      gTraceCanFdMsg.byte(20) = 0xFF;
      gTraceCanFdMsg.byte(21) = 0xF0;
      gTraceCanFdMsg.byte(22) = 0x00;
      gTraceCanFdMsg.byte(23) = 0x00;
      break;
    case 13:
      gTraceCurrentId = 0x99;
      gTraceCurrentLength = 48;
      gTraceCanFdMsg.byte(0) = 0x31;
      gTraceCanFdMsg.byte(1) = 0x2E;
      gTraceCanFdMsg.byte(2) = 0x68;
      gTraceCanFdMsg.byte(3) = 0x95;
      gTraceCanFdMsg.byte(4) = 0x11;
      gTraceCanFdMsg.byte(5) = 0x11;
      gTraceCanFdMsg.byte(6) = 0x11;
      gTraceCanFdMsg.byte(7) = 0x11;
      gTraceCanFdMsg.byte(8) = 0x00;
      gTraceCanFdMsg.byte(9) = 0x00;
      gTraceCanFdMsg.byte(10) = 0x00;
      gTraceCanFdMsg.byte(11) = 0x00;
      gTraceCanFdMsg.byte(12) = 0x00;
      gTraceCanFdMsg.byte(13) = 0x00;
      gTraceCanFdMsg.byte(14) = 0x00;
      gTraceCanFdMsg.byte(15) = 0x1A;
      gTraceCanFdMsg.byte(16) = 0x70;
      gTraceCanFdMsg.byte(17) = 0xC8;
      gTraceCanFdMsg.byte(18) = 0x15;
      gTraceCanFdMsg.byte(19) = 0x00;
      gTraceCanFdMsg.byte(20) = 0x50;
      gTraceCanFdMsg.byte(21) = 0x00;
      gTraceCanFdMsg.byte(22) = 0x00;
      gTraceCanFdMsg.byte(23) = 0x00;
      gTraceCanFdMsg.byte(24) = 0x00;
      gTraceCanFdMsg.byte(25) = 0x00;
      gTraceCanFdMsg.byte(26) = 0x00;
      gTraceCanFdMsg.byte(27) = 0x00;
      gTraceCanFdMsg.byte(28) = 0x00;
      gTraceCanFdMsg.byte(29) = 0x00;
      gTraceCanFdMsg.byte(30) = 0x00;
      gTraceCanFdMsg.byte(31) = 0x00;
      gTraceCanFdMsg.byte(32) = 0x00;
      gTraceCanFdMsg.byte(33) = 0x00;
      gTraceCanFdMsg.byte(34) = 0x00;
      gTraceCanFdMsg.byte(35) = 0x00;
      gTraceCanFdMsg.byte(36) = 0x00;
      gTraceCanFdMsg.byte(37) = 0x00;
      gTraceCanFdMsg.byte(38) = 0x00;
      gTraceCanFdMsg.byte(39) = 0x00;
      gTraceCanFdMsg.byte(40) = 0x00;
      gTraceCanFdMsg.byte(41) = 0x00;
      gTraceCanFdMsg.byte(42) = 0x00;
      gTraceCanFdMsg.byte(43) = 0x00;
      gTraceCanFdMsg.byte(44) = 0x00;
      gTraceCanFdMsg.byte(45) = 0x00;
      gTraceCanFdMsg.byte(46) = 0x00;
      gTraceCanFdMsg.byte(47) = 0x00;
      break;
    case 14:
      gTraceCurrentId = 0xA8;
      gTraceCurrentLength = 24;
      gTraceCanFdMsg.byte(0) = 0x85;
      gTraceCanFdMsg.byte(1) = 0x01;
      gTraceCanFdMsg.byte(2) = 0x00;
      gTraceCanFdMsg.byte(3) = 0x00;
      gTraceCanFdMsg.byte(4) = 0x00;
      gTraceCanFdMsg.byte(5) = 0x00;
      gTraceCanFdMsg.byte(6) = 0x00;
      gTraceCanFdMsg.byte(7) = 0x00;
      gTraceCanFdMsg.byte(8) = 0xA3;
      gTraceCanFdMsg.byte(9) = 0x01;
      gTraceCanFdMsg.byte(10) = 0x00;
      gTraceCanFdMsg.byte(11) = 0x00;
      gTraceCanFdMsg.byte(12) = 0x00;
      gTraceCanFdMsg.byte(13) = 0x00;
      gTraceCanFdMsg.byte(14) = 0x00;
      gTraceCanFdMsg.byte(15) = 0x00;
      gTraceCanFdMsg.byte(16) = 0x14;
      gTraceCanFdMsg.byte(17) = 0x01;
      gTraceCanFdMsg.byte(18) = 0x00;
      gTraceCanFdMsg.byte(19) = 0x00;
      gTraceCanFdMsg.byte(20) = 0x00;
      gTraceCanFdMsg.byte(21) = 0x00;
      gTraceCanFdMsg.byte(22) = 0x6C;
      gTraceCanFdMsg.byte(23) = 0x6C;
      break;
    case 15:
      gTraceCurrentId = 0x102;
      gTraceCurrentLength = 48;
      gTraceCanFdMsg.byte(0) = 0xC0;
      gTraceCanFdMsg.byte(1) = 0x08;
      gTraceCanFdMsg.byte(2) = 0x0D;
      gTraceCanFdMsg.byte(3) = 0x62;
      gTraceCanFdMsg.byte(4) = 0x50;
      gTraceCanFdMsg.byte(5) = 0x46;
      gTraceCanFdMsg.byte(6) = 0x33;
      gTraceCanFdMsg.byte(7) = 0x20;
      gTraceCanFdMsg.byte(8) = 0x00;
      gTraceCanFdMsg.byte(9) = 0x08;
      gTraceCanFdMsg.byte(10) = 0x38;
      gTraceCanFdMsg.byte(11) = 0xE0;
      gTraceCanFdMsg.byte(12) = 0x00;
      gTraceCanFdMsg.byte(13) = 0x07;
      gTraceCanFdMsg.byte(14) = 0x00;
      gTraceCanFdMsg.byte(15) = 0x00;
      gTraceCanFdMsg.byte(16) = 0xD7;
      gTraceCanFdMsg.byte(17) = 0x08;
      gTraceCanFdMsg.byte(18) = 0xA0;
      gTraceCanFdMsg.byte(19) = 0x00;
      gTraceCanFdMsg.byte(20) = 0xA0;
      gTraceCanFdMsg.byte(21) = 0x00;
      gTraceCanFdMsg.byte(22) = 0x00;
      gTraceCanFdMsg.byte(23) = 0x00;
      gTraceCanFdMsg.byte(24) = 0x54;
      gTraceCanFdMsg.byte(25) = 0x08;
      gTraceCanFdMsg.byte(26) = 0xA0;
      gTraceCanFdMsg.byte(27) = 0x00;
      gTraceCanFdMsg.byte(28) = 0x4E;
      gTraceCanFdMsg.byte(29) = 0x20;
      gTraceCanFdMsg.byte(30) = 0x01;
      gTraceCanFdMsg.byte(31) = 0x06;
      gTraceCanFdMsg.byte(32) = 0x80;
      gTraceCanFdMsg.byte(33) = 0x08;
      gTraceCanFdMsg.byte(34) = 0x00;
      gTraceCanFdMsg.byte(35) = 0x00;
      gTraceCanFdMsg.byte(36) = 0x0D;
      gTraceCanFdMsg.byte(37) = 0x00;
      gTraceCanFdMsg.byte(38) = 0x00;
      gTraceCanFdMsg.byte(39) = 0x18;
      gTraceCanFdMsg.byte(40) = 0x47;
      gTraceCanFdMsg.byte(41) = 0x08;
      gTraceCanFdMsg.byte(42) = 0x64;
      gTraceCanFdMsg.byte(43) = 0x00;
      gTraceCanFdMsg.byte(44) = 0x14;
      gTraceCanFdMsg.byte(45) = 0x34;
      gTraceCanFdMsg.byte(46) = 0xA0;
      gTraceCanFdMsg.byte(47) = 0x00;
      break;
    case 16:
      gTraceCurrentId = 0x108;
      gTraceCurrentLength = 16;
      gTraceCanFdMsg.byte(0) = 0x06;
      gTraceCanFdMsg.byte(1) = 0x03;
      gTraceCanFdMsg.byte(2) = 0x3D;
      gTraceCanFdMsg.byte(3) = 0x1F;
      gTraceCanFdMsg.byte(4) = 0xE2;
      gTraceCanFdMsg.byte(5) = 0xBC;
      gTraceCanFdMsg.byte(6) = 0x50;
      gTraceCanFdMsg.byte(7) = 0x04;
      gTraceCanFdMsg.byte(8) = 0x3B;
      gTraceCanFdMsg.byte(9) = 0x03;
      gTraceCanFdMsg.byte(10) = 0x7F;
      gTraceCanFdMsg.byte(11) = 0xFF;
      gTraceCanFdMsg.byte(12) = 0x8B;
      gTraceCanFdMsg.byte(13) = 0x95;
      gTraceCanFdMsg.byte(14) = 0x20;
      gTraceCanFdMsg.byte(15) = 0x00;
      break;
    case 17:
      gTraceCurrentId = 0x115;
      gTraceCurrentLength = 24;
      gTraceCanFdMsg.byte(0) = 0x00;
      gTraceCanFdMsg.byte(1) = 0x00;
      gTraceCanFdMsg.byte(2) = 0x00;
      gTraceCanFdMsg.byte(3) = 0x3F;
      gTraceCanFdMsg.byte(4) = 0xFF;
      gTraceCanFdMsg.byte(5) = 0x3F;
      gTraceCanFdMsg.byte(6) = 0xFF;
      gTraceCanFdMsg.byte(7) = 0x00;
      gTraceCanFdMsg.byte(8) = 0x00;
      gTraceCanFdMsg.byte(9) = 0x00;
      gTraceCanFdMsg.byte(10) = 0x3F;
      gTraceCanFdMsg.byte(11) = 0xFF;
      gTraceCanFdMsg.byte(12) = 0x3F;
      gTraceCanFdMsg.byte(13) = 0xFF;
      gTraceCanFdMsg.byte(14) = 0x00;
      gTraceCanFdMsg.byte(15) = 0x00;
      gTraceCanFdMsg.byte(16) = 0x00;
      gTraceCanFdMsg.byte(17) = 0x00;
      gTraceCanFdMsg.byte(18) = 0x00;
      gTraceCanFdMsg.byte(19) = 0x00;
      gTraceCanFdMsg.byte(20) = 0x00;
      gTraceCanFdMsg.byte(21) = 0x00;
      gTraceCanFdMsg.byte(22) = 0x00;
      gTraceCanFdMsg.byte(23) = 0x00;
      break;
    case 18:
      gTraceCurrentId = 0x119;
      gTraceCurrentLength = 8;
      gTraceCanFdMsg.byte(0) = 0x03;
      gTraceCanFdMsg.byte(1) = 0x04;
      gTraceCanFdMsg.byte(2) = 0x52;
      gTraceCanFdMsg.byte(3) = 0x00;
      gTraceCanFdMsg.byte(4) = 0xB7;
      gTraceCanFdMsg.byte(5) = 0x0D;
      gTraceCanFdMsg.byte(6) = 0x6A;
      gTraceCanFdMsg.byte(7) = 0x00;
      break;
    case 19:
      gTraceCurrentId = 0x141;
      gTraceCurrentLength = 8;
      gTraceCanFdMsg.byte(0) = 0xA0;
      gTraceCanFdMsg.byte(1) = 0x04;
      gTraceCanFdMsg.byte(2) = 0xF0;
      gTraceCanFdMsg.byte(3) = 0x00;
      gTraceCanFdMsg.byte(4) = 0x00;
      gTraceCanFdMsg.byte(5) = 0x54;
      gTraceCanFdMsg.byte(6) = 0xFF;
      gTraceCanFdMsg.byte(7) = 0xB0;
      break;
    case 20:
      gTraceCurrentId = 0x146;
      gTraceCurrentLength = 8;
      gTraceCanFdMsg.byte(0) = 0x9B;
      gTraceCanFdMsg.byte(1) = 0x26;
      gTraceCanFdMsg.byte(2) = 0x7F;
      gTraceCanFdMsg.byte(3) = 0xFF;
      gTraceCanFdMsg.byte(4) = 0x96;
      gTraceCanFdMsg.byte(5) = 0x1A;
      gTraceCanFdMsg.byte(6) = 0x47;
      gTraceCanFdMsg.byte(7) = 0xF8;
      break;
    case 21:
      gTraceCurrentId = 0x147;
      gTraceCurrentLength = 24;
      gTraceCanFdMsg.byte(0) = 0x0F;
      gTraceCanFdMsg.byte(1) = 0x06;
      gTraceCanFdMsg.byte(2) = 0x7F;
      gTraceCanFdMsg.byte(3) = 0xE0;
      gTraceCanFdMsg.byte(4) = 0x55;
      gTraceCanFdMsg.byte(5) = 0xDA;
      gTraceCanFdMsg.byte(6) = 0x03;
      gTraceCanFdMsg.byte(7) = 0xFC;
      gTraceCanFdMsg.byte(8) = 0x00;
      gTraceCanFdMsg.byte(9) = 0x00;
      gTraceCanFdMsg.byte(10) = 0x00;
      gTraceCanFdMsg.byte(11) = 0x1F;
      gTraceCanFdMsg.byte(12) = 0xFB;
      gTraceCanFdMsg.byte(13) = 0xFF;
      gTraceCanFdMsg.byte(14) = 0x7F;
      gTraceCanFdMsg.byte(15) = 0xE0;
      gTraceCanFdMsg.byte(16) = 0x00;
      gTraceCanFdMsg.byte(17) = 0x00;
      gTraceCanFdMsg.byte(18) = 0x00;
      gTraceCanFdMsg.byte(19) = 0x00;
      gTraceCanFdMsg.byte(20) = 0x00;
      gTraceCanFdMsg.byte(21) = 0x00;
      gTraceCanFdMsg.byte(22) = 0x00;
      gTraceCanFdMsg.byte(23) = 0x08;
      break;
    case 22:
      gTraceCurrentId = 0x14F;
      gTraceCurrentLength = 24;
      gTraceCanFdMsg.byte(0) = 0xCF;
      gTraceCanFdMsg.byte(1) = 0x00;
      gTraceCanFdMsg.byte(2) = 0x03;
      gTraceCanFdMsg.byte(3) = 0x00;
      gTraceCanFdMsg.byte(4) = 0x00;
      gTraceCanFdMsg.byte(5) = 0x01;
      gTraceCanFdMsg.byte(6) = 0x00;
      gTraceCanFdMsg.byte(7) = 0x00;
      gTraceCanFdMsg.byte(8) = 0x23;
      gTraceCanFdMsg.byte(9) = 0x00;
      gTraceCanFdMsg.byte(10) = 0x60;
      gTraceCanFdMsg.byte(11) = 0xFF;
      gTraceCanFdMsg.byte(12) = 0xFF;
      gTraceCanFdMsg.byte(13) = 0x80;
      gTraceCanFdMsg.byte(14) = 0x00;
      gTraceCanFdMsg.byte(15) = 0x00;
      gTraceCanFdMsg.byte(16) = 0x83;
      gTraceCanFdMsg.byte(17) = 0x00;
      gTraceCanFdMsg.byte(18) = 0x00;
      gTraceCanFdMsg.byte(19) = 0x00;
      gTraceCanFdMsg.byte(20) = 0x00;
      gTraceCanFdMsg.byte(21) = 0x00;
      gTraceCanFdMsg.byte(22) = 0x00;
      gTraceCanFdMsg.byte(23) = 0x00;
      break;
    case 23:
      gTraceCurrentId = 0x16A;
      gTraceCurrentLength = 16;
      gTraceCanFdMsg.byte(0) = 0x5F;
      gTraceCanFdMsg.byte(1) = 0x08;
      gTraceCanFdMsg.byte(2) = 0x7E;
      gTraceCanFdMsg.byte(3) = 0xF4;
      gTraceCanFdMsg.byte(4) = 0x86;
      gTraceCanFdMsg.byte(5) = 0x47;
      gTraceCanFdMsg.byte(6) = 0xD0;
      gTraceCanFdMsg.byte(7) = 0x41;
      gTraceCanFdMsg.byte(8) = 0xFD;
      gTraceCanFdMsg.byte(9) = 0x08;
      gTraceCanFdMsg.byte(10) = 0x00;
      gTraceCanFdMsg.byte(11) = 0x64;
      gTraceCanFdMsg.byte(12) = 0x00;
      gTraceCanFdMsg.byte(13) = 0x00;
      gTraceCanFdMsg.byte(14) = 0x00;
      gTraceCanFdMsg.byte(15) = 0x00;
      break;
    case 24:
      gTraceCurrentId = 0x16B;
      gTraceCurrentLength = 64;
      gTraceCanFdMsg.byte(0) = 0x40;
      gTraceCanFdMsg.byte(1) = 0x09;
      gTraceCanFdMsg.byte(2) = 0xFF;
      gTraceCanFdMsg.byte(3) = 0xFF;
      gTraceCanFdMsg.byte(4) = 0x82;
      gTraceCanFdMsg.byte(5) = 0xFF;
      gTraceCanFdMsg.byte(6) = 0xFF;
      gTraceCanFdMsg.byte(7) = 0x12;
      gTraceCanFdMsg.byte(8) = 0x83;
      gTraceCanFdMsg.byte(9) = 0x09;
      gTraceCanFdMsg.byte(10) = 0x01;
      gTraceCanFdMsg.byte(11) = 0x80;
      gTraceCanFdMsg.byte(12) = 0x00;
      gTraceCanFdMsg.byte(13) = 0x00;
      gTraceCanFdMsg.byte(14) = 0x40;
      gTraceCanFdMsg.byte(15) = 0x00;
      gTraceCanFdMsg.byte(16) = 0x0C;
      gTraceCanFdMsg.byte(17) = 0x09;
      gTraceCanFdMsg.byte(18) = 0x00;
      gTraceCanFdMsg.byte(19) = 0x00;
      gTraceCanFdMsg.byte(20) = 0x00;
      gTraceCanFdMsg.byte(21) = 0x00;
      gTraceCanFdMsg.byte(22) = 0x00;
      gTraceCanFdMsg.byte(23) = 0x00;
      gTraceCanFdMsg.byte(24) = 0xEB;
      gTraceCanFdMsg.byte(25) = 0x09;
      gTraceCanFdMsg.byte(26) = 0x00;
      gTraceCanFdMsg.byte(27) = 0x00;
      gTraceCanFdMsg.byte(28) = 0x21;
      gTraceCanFdMsg.byte(29) = 0x20;
      gTraceCanFdMsg.byte(30) = 0x00;
      gTraceCanFdMsg.byte(31) = 0x00;
      gTraceCanFdMsg.byte(32) = 0x78;
      gTraceCanFdMsg.byte(33) = 0x09;
      gTraceCanFdMsg.byte(34) = 0x00;
      gTraceCanFdMsg.byte(35) = 0x00;
      gTraceCanFdMsg.byte(36) = 0x00;
      gTraceCanFdMsg.byte(37) = 0x1F;
      gTraceCanFdMsg.byte(38) = 0x40;
      gTraceCanFdMsg.byte(39) = 0x00;
      gTraceCanFdMsg.byte(40) = 0xA4;
      gTraceCanFdMsg.byte(41) = 0x09;
      gTraceCanFdMsg.byte(42) = 0x07;
      gTraceCanFdMsg.byte(43) = 0xD0;
      gTraceCanFdMsg.byte(44) = 0x80;
      gTraceCanFdMsg.byte(45) = 0x00;
      gTraceCanFdMsg.byte(46) = 0x00;
      gTraceCanFdMsg.byte(47) = 0x00;
      gTraceCanFdMsg.byte(48) = 0x0C;
      gTraceCanFdMsg.byte(49) = 0x09;
      gTraceCanFdMsg.byte(50) = 0x00;
      gTraceCanFdMsg.byte(51) = 0x00;
      gTraceCanFdMsg.byte(52) = 0x00;
      gTraceCanFdMsg.byte(53) = 0x00;
      gTraceCanFdMsg.byte(54) = 0x00;
      gTraceCanFdMsg.byte(55) = 0x00;
      gTraceCanFdMsg.byte(56) = 0x0C;
      gTraceCanFdMsg.byte(57) = 0x09;
      gTraceCanFdMsg.byte(58) = 0x00;
      gTraceCanFdMsg.byte(59) = 0x00;
      gTraceCanFdMsg.byte(60) = 0x00;
      gTraceCanFdMsg.byte(61) = 0x00;
      gTraceCanFdMsg.byte(62) = 0x00;
      gTraceCanFdMsg.byte(63) = 0x00;
      break;
    case 25:
      gTraceCurrentId = 0x171;
      gTraceCurrentLength = 16;
      gTraceCanFdMsg.byte(0) = 0x8A;
      gTraceCanFdMsg.byte(1) = 0x03;
      gTraceCanFdMsg.byte(2) = 0x00;
      gTraceCanFdMsg.byte(3) = 0x88;
      gTraceCanFdMsg.byte(4) = 0x08;
      gTraceCanFdMsg.byte(5) = 0x01;
      gTraceCanFdMsg.byte(6) = 0x00;
      gTraceCanFdMsg.byte(7) = 0x00;
      gTraceCanFdMsg.byte(8) = 0x00;
      gTraceCanFdMsg.byte(9) = 0x00;
      gTraceCanFdMsg.byte(10) = 0x00;
      gTraceCanFdMsg.byte(11) = 0x00;
      gTraceCanFdMsg.byte(12) = 0x00;
      gTraceCanFdMsg.byte(13) = 0x00;
      gTraceCanFdMsg.byte(14) = 0x00;
      gTraceCanFdMsg.byte(15) = 0x00;
      break;
    case 26:
      gTraceCurrentId = 0x181;
      gTraceCurrentLength = 8;
      gTraceCanFdMsg.byte(0) = 0xC4;
      gTraceCanFdMsg.byte(1) = 0x03;
      gTraceCanFdMsg.byte(2) = 0xA0;
      gTraceCanFdMsg.byte(3) = 0x01;
      gTraceCanFdMsg.byte(4) = 0x00;
      gTraceCanFdMsg.byte(5) = 0x00;
      gTraceCanFdMsg.byte(6) = 0x03;
      gTraceCanFdMsg.byte(7) = 0xE8;
      break;
    case 27:
      gTraceCurrentId = 0x182;
      gTraceCurrentLength = 8;
      gTraceCanFdMsg.byte(0) = 0x00;
      gTraceCanFdMsg.byte(1) = 0x00;
      gTraceCanFdMsg.byte(2) = 0x01;
      gTraceCanFdMsg.byte(3) = 0xFE;
      gTraceCanFdMsg.byte(4) = 0x00;
      gTraceCanFdMsg.byte(5) = 0x00;
      gTraceCanFdMsg.byte(6) = 0x00;
      gTraceCanFdMsg.byte(7) = 0x00;
      break;
    case 28:
      gTraceCurrentId = 0x191;
      gTraceCurrentLength = 8;
      gTraceCanFdMsg.byte(0) = 0xA3;
      gTraceCanFdMsg.byte(1) = 0x03;
      gTraceCanFdMsg.byte(2) = 0x8A;
      gTraceCanFdMsg.byte(3) = 0x8D;
      gTraceCanFdMsg.byte(4) = 0xAC;
      gTraceCanFdMsg.byte(5) = 0x00;
      gTraceCanFdMsg.byte(6) = 0x00;
      gTraceCanFdMsg.byte(7) = 0x00;
      break;
    case 29:
      gTraceCurrentId = 0x1A1;
      gTraceCurrentLength = 32;
      gTraceCanFdMsg.byte(0) = 0x48;
      gTraceCanFdMsg.byte(1) = 0x03;
      gTraceCanFdMsg.byte(2) = 0x57;
      gTraceCanFdMsg.byte(3) = 0x80;
      gTraceCanFdMsg.byte(4) = 0x09;
      gTraceCanFdMsg.byte(5) = 0xC4;
      gTraceCanFdMsg.byte(6) = 0x57;
      gTraceCanFdMsg.byte(7) = 0x80;
      gTraceCanFdMsg.byte(8) = 0x5C;
      gTraceCanFdMsg.byte(9) = 0x03;
      gTraceCanFdMsg.byte(10) = 0x57;
      gTraceCanFdMsg.byte(11) = 0x80;
      gTraceCanFdMsg.byte(12) = 0x7F;
      gTraceCanFdMsg.byte(13) = 0xFF;
      gTraceCanFdMsg.byte(14) = 0x00;
      gTraceCanFdMsg.byte(15) = 0x00;
      gTraceCanFdMsg.byte(16) = 0x51;
      gTraceCanFdMsg.byte(17) = 0x03;
      gTraceCanFdMsg.byte(18) = 0xFA;
      gTraceCanFdMsg.byte(19) = 0x00;
      gTraceCanFdMsg.byte(20) = 0x10;
      gTraceCanFdMsg.byte(21) = 0x0F;
      gTraceCanFdMsg.byte(22) = 0x10;
      gTraceCanFdMsg.byte(23) = 0x00;
      gTraceCanFdMsg.byte(24) = 0x00;
      gTraceCanFdMsg.byte(25) = 0x00;
      gTraceCanFdMsg.byte(26) = 0x00;
      gTraceCanFdMsg.byte(27) = 0x00;
      gTraceCanFdMsg.byte(28) = 0x00;
      gTraceCanFdMsg.byte(29) = 0x00;
      gTraceCanFdMsg.byte(30) = 0x00;
      gTraceCanFdMsg.byte(31) = 0x00;
      break;
    case 30:
      gTraceCurrentId = 0x1B5;
      gTraceCurrentLength = 32;
      gTraceCanFdMsg.byte(0) = 0xB8;
      gTraceCanFdMsg.byte(1) = 0x03;
      gTraceCanFdMsg.byte(2) = 0x7D;
      gTraceCanFdMsg.byte(3) = 0x00;
      gTraceCanFdMsg.byte(4) = 0x09;
      gTraceCanFdMsg.byte(5) = 0xC4;
      gTraceCanFdMsg.byte(6) = 0x7D;
      gTraceCanFdMsg.byte(7) = 0x00;
      gTraceCanFdMsg.byte(8) = 0xF7;
      gTraceCanFdMsg.byte(9) = 0x03;
      gTraceCanFdMsg.byte(10) = 0x7D;
      gTraceCanFdMsg.byte(11) = 0x00;
      gTraceCanFdMsg.byte(12) = 0x7F;
      gTraceCanFdMsg.byte(13) = 0xFF;
      gTraceCanFdMsg.byte(14) = 0x00;
      gTraceCanFdMsg.byte(15) = 0x00;
      gTraceCanFdMsg.byte(16) = 0x8F;
      gTraceCanFdMsg.byte(17) = 0x03;
      gTraceCanFdMsg.byte(18) = 0xFA;
      gTraceCanFdMsg.byte(19) = 0x00;
      gTraceCanFdMsg.byte(20) = 0x10;
      gTraceCanFdMsg.byte(21) = 0x00;
      gTraceCanFdMsg.byte(22) = 0x00;
      gTraceCanFdMsg.byte(23) = 0x00;
      gTraceCanFdMsg.byte(24) = 0x00;
      gTraceCanFdMsg.byte(25) = 0x00;
      gTraceCanFdMsg.byte(26) = 0x00;
      gTraceCanFdMsg.byte(27) = 0x00;
      gTraceCanFdMsg.byte(28) = 0x00;
      gTraceCanFdMsg.byte(29) = 0x00;
      gTraceCanFdMsg.byte(30) = 0x00;
      gTraceCanFdMsg.byte(31) = 0x00;
      break;
    case 31:
      gTraceCurrentId = 0x1D5;
      gTraceCurrentLength = 32;
      gTraceCanFdMsg.byte(0) = 0xF7;
      gTraceCanFdMsg.byte(1) = 0x06;
      gTraceCanFdMsg.byte(2) = 0x50;
      gTraceCanFdMsg.byte(3) = 0x00;
      gTraceCanFdMsg.byte(4) = 0x78;
      gTraceCanFdMsg.byte(5) = 0x57;
      gTraceCanFdMsg.byte(6) = 0x82;
      gTraceCanFdMsg.byte(7) = 0x00;
      gTraceCanFdMsg.byte(8) = 0xC8;
      gTraceCanFdMsg.byte(9) = 0x06;
      gTraceCanFdMsg.byte(10) = 0x7F;
      gTraceCanFdMsg.byte(11) = 0xFF;
      gTraceCanFdMsg.byte(12) = 0x57;
      gTraceCanFdMsg.byte(13) = 0x80;
      gTraceCanFdMsg.byte(14) = 0x55;
      gTraceCanFdMsg.byte(15) = 0x80;
      gTraceCanFdMsg.byte(16) = 0x03;
      gTraceCanFdMsg.byte(17) = 0x06;
      gTraceCanFdMsg.byte(18) = 0x7F;
      gTraceCanFdMsg.byte(19) = 0xE1;
      gTraceCanFdMsg.byte(20) = 0x00;
      gTraceCanFdMsg.byte(21) = 0x00;
      gTraceCanFdMsg.byte(22) = 0x00;
      gTraceCanFdMsg.byte(23) = 0x00;
      gTraceCanFdMsg.byte(24) = 0x00;
      gTraceCanFdMsg.byte(25) = 0x00;
      gTraceCanFdMsg.byte(26) = 0x00;
      gTraceCanFdMsg.byte(27) = 0x78;
      gTraceCanFdMsg.byte(28) = 0x05;
      gTraceCanFdMsg.byte(29) = 0x00;
      gTraceCanFdMsg.byte(30) = 0x00;
      gTraceCanFdMsg.byte(31) = 0x00;
      break;
    case 32:
      gTraceCurrentId = 0x1E5;
      gTraceCurrentLength = 48;
      gTraceCanFdMsg.byte(0) = 0xD9;
      gTraceCanFdMsg.byte(1) = 0x01;
      gTraceCanFdMsg.byte(2) = 0x53;
      gTraceCanFdMsg.byte(3) = 0xC2;
      gTraceCanFdMsg.byte(4) = 0x94;
      gTraceCanFdMsg.byte(5) = 0x7D;
      gTraceCanFdMsg.byte(6) = 0x02;
      gTraceCanFdMsg.byte(7) = 0x00;
      gTraceCanFdMsg.byte(8) = 0x9A;
      gTraceCanFdMsg.byte(9) = 0x01;
      gTraceCanFdMsg.byte(10) = 0x7D;
      gTraceCanFdMsg.byte(11) = 0x00;
      gTraceCanFdMsg.byte(12) = 0x55;
      gTraceCanFdMsg.byte(13) = 0x80;
      gTraceCanFdMsg.byte(14) = 0x7F;
      gTraceCanFdMsg.byte(15) = 0xFF;
      gTraceCanFdMsg.byte(16) = 0x7B;
      gTraceCanFdMsg.byte(17) = 0x01;
      gTraceCanFdMsg.byte(18) = 0x00;
      gTraceCanFdMsg.byte(19) = 0x00;
      gTraceCanFdMsg.byte(20) = 0x7F;
      gTraceCanFdMsg.byte(21) = 0xE0;
      gTraceCanFdMsg.byte(22) = 0x01;
      gTraceCanFdMsg.byte(23) = 0xBE;
      gTraceCanFdMsg.byte(24) = 0xA9;
      gTraceCanFdMsg.byte(25) = 0x01;
      gTraceCanFdMsg.byte(26) = 0x00;
      gTraceCanFdMsg.byte(27) = 0x00;
      gTraceCanFdMsg.byte(28) = 0x00;
      gTraceCanFdMsg.byte(29) = 0x00;
      gTraceCanFdMsg.byte(30) = 0x00;
      gTraceCanFdMsg.byte(31) = 0x00;
      gTraceCanFdMsg.byte(32) = 0x00;
      gTraceCanFdMsg.byte(33) = 0x00;
      gTraceCanFdMsg.byte(34) = 0x00;
      gTraceCanFdMsg.byte(35) = 0x00;
      gTraceCanFdMsg.byte(36) = 0x00;
      gTraceCanFdMsg.byte(37) = 0x4E;
      gTraceCanFdMsg.byte(38) = 0x20;
      gTraceCanFdMsg.byte(39) = 0x00;
      gTraceCanFdMsg.byte(40) = 0x00;
      gTraceCanFdMsg.byte(41) = 0x00;
      gTraceCanFdMsg.byte(42) = 0x00;
      gTraceCanFdMsg.byte(43) = 0x00;
      gTraceCanFdMsg.byte(44) = 0x00;
      gTraceCanFdMsg.byte(45) = 0x00;
      gTraceCanFdMsg.byte(46) = 0x00;
      gTraceCanFdMsg.byte(47) = 0x00;
      break;
    case 33:
      gTraceCurrentId = 0x203;
      gTraceCurrentLength = 24;
      gTraceCanFdMsg.byte(0) = 0xB7;
      gTraceCanFdMsg.byte(1) = 0x0B;
      gTraceCanFdMsg.byte(2) = 0x02;
      gTraceCanFdMsg.byte(3) = 0xCA;
      gTraceCanFdMsg.byte(4) = 0xE0;
      gTraceCanFdMsg.byte(5) = 0x00;
      gTraceCanFdMsg.byte(6) = 0x00;
      gTraceCanFdMsg.byte(7) = 0x00;
      gTraceCanFdMsg.byte(8) = 0xCF;
      gTraceCanFdMsg.byte(9) = 0x0B;
      gTraceCanFdMsg.byte(10) = 0x00;
      gTraceCanFdMsg.byte(11) = 0x4A;
      gTraceCanFdMsg.byte(12) = 0x12;
      gTraceCanFdMsg.byte(13) = 0x10;
      gTraceCanFdMsg.byte(14) = 0x00;
      gTraceCanFdMsg.byte(15) = 0x00;
      gTraceCanFdMsg.byte(16) = 0x00;
      gTraceCanFdMsg.byte(17) = 0x00;
      gTraceCanFdMsg.byte(18) = 0x00;
      gTraceCanFdMsg.byte(19) = 0x12;
      gTraceCanFdMsg.byte(20) = 0x95;
      gTraceCanFdMsg.byte(21) = 0xC0;
      gTraceCanFdMsg.byte(22) = 0x01;
      gTraceCanFdMsg.byte(23) = 0x00;
      break;
    case 34:
      gTraceCurrentId = 0x205;
      gTraceCurrentLength = 8;
      gTraceCanFdMsg.byte(0) = 0x00;
      gTraceCanFdMsg.byte(1) = 0x00;
      gTraceCanFdMsg.byte(2) = 0x00;
      gTraceCanFdMsg.byte(3) = 0x00;
      gTraceCanFdMsg.byte(4) = 0x00;
      gTraceCanFdMsg.byte(5) = 0x00;
      gTraceCanFdMsg.byte(6) = 0x00;
      gTraceCanFdMsg.byte(7) = 0x00;
      break;
    case 35:
      gTraceCurrentId = 0x208;
      gTraceCurrentLength = 48;
      gTraceCanFdMsg.byte(0) = 0xE3;
      gTraceCanFdMsg.byte(1) = 0x04;
      gTraceCanFdMsg.byte(2) = 0x00;
      gTraceCanFdMsg.byte(3) = 0x00;
      gTraceCanFdMsg.byte(4) = 0x00;
      gTraceCanFdMsg.byte(5) = 0x0D;
      gTraceCanFdMsg.byte(6) = 0x9C;
      gTraceCanFdMsg.byte(7) = 0x40;
      gTraceCanFdMsg.byte(8) = 0x8B;
      gTraceCanFdMsg.byte(9) = 0x04;
      gTraceCanFdMsg.byte(10) = 0x24;
      gTraceCanFdMsg.byte(11) = 0x00;
      gTraceCanFdMsg.byte(12) = 0x00;
      gTraceCanFdMsg.byte(13) = 0x44;
      gTraceCanFdMsg.byte(14) = 0x43;
      gTraceCanFdMsg.byte(15) = 0xFC;
      gTraceCanFdMsg.byte(16) = 0x9A;
      gTraceCanFdMsg.byte(17) = 0x24;
      gTraceCanFdMsg.byte(18) = 0xFC;
      gTraceCanFdMsg.byte(19) = 0x44;
      gTraceCanFdMsg.byte(20) = 0x44;
      gTraceCanFdMsg.byte(21) = 0x43;
      gTraceCanFdMsg.byte(22) = 0x02;
      gTraceCanFdMsg.byte(23) = 0x00;
      gTraceCanFdMsg.byte(24) = 0xFE;
      gTraceCanFdMsg.byte(25) = 0x04;
      gTraceCanFdMsg.byte(26) = 0x00;
      gTraceCanFdMsg.byte(27) = 0x35;
      gTraceCanFdMsg.byte(28) = 0xA8;
      gTraceCanFdMsg.byte(29) = 0x00;
      gTraceCanFdMsg.byte(30) = 0x00;
      gTraceCanFdMsg.byte(31) = 0x02;
      gTraceCanFdMsg.byte(32) = 0x44;
      gTraceCanFdMsg.byte(33) = 0x04;
      gTraceCanFdMsg.byte(34) = 0x00;
      gTraceCanFdMsg.byte(35) = 0x04;
      gTraceCanFdMsg.byte(36) = 0x00;
      gTraceCanFdMsg.byte(37) = 0x00;
      gTraceCanFdMsg.byte(38) = 0x00;
      gTraceCanFdMsg.byte(39) = 0x00;
      gTraceCanFdMsg.byte(40) = 0x00;
      gTraceCanFdMsg.byte(41) = 0x00;
      gTraceCanFdMsg.byte(42) = 0x4E;
      gTraceCanFdMsg.byte(43) = 0xC0;
      gTraceCanFdMsg.byte(44) = 0x4E;
      gTraceCanFdMsg.byte(45) = 0x20;
      gTraceCanFdMsg.byte(46) = 0x02;
      gTraceCanFdMsg.byte(47) = 0x02;
      break;
    case 36:
      gTraceCurrentId = 0x20B;
      gTraceCurrentLength = 48;
      gTraceCanFdMsg.byte(0) = 0x46;
      gTraceCanFdMsg.byte(1) = 0x04;
      gTraceCanFdMsg.byte(2) = 0x0B;
      gTraceCanFdMsg.byte(3) = 0xE4;
      gTraceCanFdMsg.byte(4) = 0x1A;
      gTraceCanFdMsg.byte(5) = 0x15;
      gTraceCanFdMsg.byte(6) = 0x00;
      gTraceCanFdMsg.byte(7) = 0xA4;
      gTraceCanFdMsg.byte(8) = 0x48;
      gTraceCanFdMsg.byte(9) = 0x04;
      gTraceCanFdMsg.byte(10) = 0xC3;
      gTraceCanFdMsg.byte(11) = 0x00;
      gTraceCanFdMsg.byte(12) = 0x00;
      gTraceCanFdMsg.byte(13) = 0xB2;
      gTraceCanFdMsg.byte(14) = 0x14;
      gTraceCanFdMsg.byte(15) = 0x81;
      gTraceCanFdMsg.byte(16) = 0x2D;
      gTraceCanFdMsg.byte(17) = 0x04;
      gTraceCanFdMsg.byte(18) = 0x00;
      gTraceCanFdMsg.byte(19) = 0x20;
      gTraceCanFdMsg.byte(20) = 0x2F;
      gTraceCanFdMsg.byte(21) = 0xE0;
      gTraceCanFdMsg.byte(22) = 0x00;
      gTraceCanFdMsg.byte(23) = 0x00;
      gTraceCanFdMsg.byte(24) = 0x00;
      gTraceCanFdMsg.byte(25) = 0x04;
      gTraceCanFdMsg.byte(26) = 0x0B;
      gTraceCanFdMsg.byte(27) = 0x68;
      gTraceCanFdMsg.byte(28) = 0x32;
      gTraceCanFdMsg.byte(29) = 0x64;
      gTraceCanFdMsg.byte(30) = 0x32;
      gTraceCanFdMsg.byte(31) = 0x32;
      gTraceCanFdMsg.byte(32) = 0x6C;
      gTraceCanFdMsg.byte(33) = 0x04;
      gTraceCanFdMsg.byte(34) = 0xA6;
      gTraceCanFdMsg.byte(35) = 0x00;
      gTraceCanFdMsg.byte(36) = 0x00;
      gTraceCanFdMsg.byte(37) = 0x00;
      gTraceCanFdMsg.byte(38) = 0x26;
      gTraceCanFdMsg.byte(39) = 0xD0;
      gTraceCanFdMsg.byte(40) = 0x00;
      gTraceCanFdMsg.byte(41) = 0x04;
      gTraceCanFdMsg.byte(42) = 0x68;
      gTraceCanFdMsg.byte(43) = 0x55;
      gTraceCanFdMsg.byte(44) = 0x20;
      gTraceCanFdMsg.byte(45) = 0x12;
      gTraceCanFdMsg.byte(46) = 0x48;
      gTraceCanFdMsg.byte(47) = 0x17;
      break;
    case 37:
      gTraceCurrentId = 0x224;
      gTraceCurrentLength = 24;
      gTraceCanFdMsg.byte(0) = 0x15;
      gTraceCanFdMsg.byte(1) = 0x0A;
      gTraceCanFdMsg.byte(2) = 0xEA;
      gTraceCanFdMsg.byte(3) = 0x60;
      gTraceCanFdMsg.byte(4) = 0x75;
      gTraceCanFdMsg.byte(5) = 0x30;
      gTraceCanFdMsg.byte(6) = 0x00;
      gTraceCanFdMsg.byte(7) = 0x00;
      gTraceCanFdMsg.byte(8) = 0x3A;
      gTraceCanFdMsg.byte(9) = 0x0A;
      gTraceCanFdMsg.byte(10) = 0x27;
      gTraceCanFdMsg.byte(11) = 0x10;
      gTraceCanFdMsg.byte(12) = 0xEA;
      gTraceCanFdMsg.byte(13) = 0x60;
      gTraceCanFdMsg.byte(14) = 0x75;
      gTraceCanFdMsg.byte(15) = 0x30;
      gTraceCanFdMsg.byte(16) = 0x36;
      gTraceCanFdMsg.byte(17) = 0x0A;
      gTraceCanFdMsg.byte(18) = 0x00;
      gTraceCanFdMsg.byte(19) = 0x27;
      gTraceCanFdMsg.byte(20) = 0x10;
      gTraceCanFdMsg.byte(21) = 0x01;
      gTraceCanFdMsg.byte(22) = 0x00;
      gTraceCanFdMsg.byte(23) = 0x00;
      break;
    case 38:
      gTraceCurrentId = 0x225;
      gTraceCurrentLength = 8;
      gTraceCanFdMsg.byte(0) = 0x00;
      gTraceCanFdMsg.byte(1) = 0x00;
      gTraceCanFdMsg.byte(2) = 0x00;
      gTraceCanFdMsg.byte(3) = 0x00;
      gTraceCanFdMsg.byte(4) = 0x00;
      gTraceCanFdMsg.byte(5) = 0x00;
      gTraceCanFdMsg.byte(6) = 0x00;
      gTraceCanFdMsg.byte(7) = 0x00;
      break;
    case 39:
      gTraceCurrentId = 0x226;
      gTraceCurrentLength = 16;
      gTraceCanFdMsg.byte(0) = 0x00;
      gTraceCanFdMsg.byte(1) = 0x00;
      gTraceCanFdMsg.byte(2) = 0xFF;
      gTraceCanFdMsg.byte(3) = 0xF0;
      gTraceCanFdMsg.byte(4) = 0x00;
      gTraceCanFdMsg.byte(5) = 0x00;
      gTraceCanFdMsg.byte(6) = 0x00;
      gTraceCanFdMsg.byte(7) = 0x00;
      gTraceCanFdMsg.byte(8) = 0x00;
      gTraceCanFdMsg.byte(9) = 0x00;
      gTraceCanFdMsg.byte(10) = 0x00;
      gTraceCanFdMsg.byte(11) = 0x00;
      gTraceCanFdMsg.byte(12) = 0x00;
      gTraceCanFdMsg.byte(13) = 0x00;
      gTraceCanFdMsg.byte(14) = 0x00;
      gTraceCanFdMsg.byte(15) = 0x00;
      break;
    case 40:
      gTraceCurrentId = 0x22B;
      gTraceCurrentLength = 48;
      gTraceCanFdMsg.byte(0) = 0xBF;
      gTraceCanFdMsg.byte(1) = 0x01;
      gTraceCanFdMsg.byte(2) = 0xC4;
      gTraceCanFdMsg.byte(3) = 0x00;
      gTraceCanFdMsg.byte(4) = 0x00;
      gTraceCanFdMsg.byte(5) = 0x00;
      gTraceCanFdMsg.byte(6) = 0xFF;
      gTraceCanFdMsg.byte(7) = 0x10;
      gTraceCanFdMsg.byte(8) = 0x45;
      gTraceCanFdMsg.byte(9) = 0x01;
      gTraceCanFdMsg.byte(10) = 0x7A;
      gTraceCanFdMsg.byte(11) = 0x12;
      gTraceCanFdMsg.byte(12) = 0x80;
      gTraceCanFdMsg.byte(13) = 0x00;
      gTraceCanFdMsg.byte(14) = 0x80;
      gTraceCanFdMsg.byte(15) = 0x00;
      gTraceCanFdMsg.byte(16) = 0x99;
      gTraceCanFdMsg.byte(17) = 0x01;
      gTraceCanFdMsg.byte(18) = 0x80;
      gTraceCanFdMsg.byte(19) = 0x00;
      gTraceCanFdMsg.byte(20) = 0x80;
      gTraceCanFdMsg.byte(21) = 0x00;
      gTraceCanFdMsg.byte(22) = 0x00;
      gTraceCanFdMsg.byte(23) = 0x00;
      gTraceCanFdMsg.byte(24) = 0xE4;
      gTraceCanFdMsg.byte(25) = 0x01;
      gTraceCanFdMsg.byte(26) = 0x00;
      gTraceCanFdMsg.byte(27) = 0x80;
      gTraceCanFdMsg.byte(28) = 0x00;
      gTraceCanFdMsg.byte(29) = 0x06;
      gTraceCanFdMsg.byte(30) = 0x40;
      gTraceCanFdMsg.byte(31) = 0x40;
      gTraceCanFdMsg.byte(32) = 0xDE;
      gTraceCanFdMsg.byte(33) = 0x01;
      gTraceCanFdMsg.byte(34) = 0x00;
      gTraceCanFdMsg.byte(35) = 0x00;
      gTraceCanFdMsg.byte(36) = 0x00;
      gTraceCanFdMsg.byte(37) = 0x00;
      gTraceCanFdMsg.byte(38) = 0x00;
      gTraceCanFdMsg.byte(39) = 0x00;
      gTraceCanFdMsg.byte(40) = 0xDE;
      gTraceCanFdMsg.byte(41) = 0x01;
      gTraceCanFdMsg.byte(42) = 0x00;
      gTraceCanFdMsg.byte(43) = 0x00;
      gTraceCanFdMsg.byte(44) = 0x00;
      gTraceCanFdMsg.byte(45) = 0x00;
      gTraceCanFdMsg.byte(46) = 0x00;
      gTraceCanFdMsg.byte(47) = 0x00;
      break;
    case 41:
      gTraceCurrentId = 0x23B;
      gTraceCurrentLength = 8;
      gTraceCanFdMsg.byte(0) = 0x55;
      gTraceCanFdMsg.byte(1) = 0x05;
      gTraceCanFdMsg.byte(2) = 0x00;
      gTraceCanFdMsg.byte(3) = 0x00;
      gTraceCanFdMsg.byte(4) = 0x00;
      gTraceCanFdMsg.byte(5) = 0x00;
      gTraceCanFdMsg.byte(6) = 0x00;
      gTraceCanFdMsg.byte(7) = 0x00;
      break;
    case 42:
      gTraceCurrentId = 0x24B;
      gTraceCurrentLength = 48;
      gTraceCanFdMsg.byte(0) = 0x5E;
      gTraceCanFdMsg.byte(1) = 0x01;
      gTraceCanFdMsg.byte(2) = 0x00;
      gTraceCanFdMsg.byte(3) = 0x00;
      gTraceCanFdMsg.byte(4) = 0x00;
      gTraceCanFdMsg.byte(5) = 0x00;
      gTraceCanFdMsg.byte(6) = 0x00;
      gTraceCanFdMsg.byte(7) = 0x00;
      gTraceCanFdMsg.byte(8) = 0xF1;
      gTraceCanFdMsg.byte(9) = 0x01;
      gTraceCanFdMsg.byte(10) = 0x00;
      gTraceCanFdMsg.byte(11) = 0x00;
      gTraceCanFdMsg.byte(12) = 0x00;
      gTraceCanFdMsg.byte(13) = 0x00;
      gTraceCanFdMsg.byte(14) = 0x00;
      gTraceCanFdMsg.byte(15) = 0x00;
      gTraceCanFdMsg.byte(16) = 0xE8;
      gTraceCanFdMsg.byte(17) = 0x01;
      gTraceCanFdMsg.byte(18) = 0x00;
      gTraceCanFdMsg.byte(19) = 0x00;
      gTraceCanFdMsg.byte(20) = 0x00;
      gTraceCanFdMsg.byte(21) = 0x00;
      gTraceCanFdMsg.byte(22) = 0x25;
      gTraceCanFdMsg.byte(23) = 0x86;
      gTraceCanFdMsg.byte(24) = 0xBB;
      gTraceCanFdMsg.byte(25) = 0x01;
      gTraceCanFdMsg.byte(26) = 0x25;
      gTraceCanFdMsg.byte(27) = 0x86;
      gTraceCanFdMsg.byte(28) = 0x25;
      gTraceCanFdMsg.byte(29) = 0x86;
      gTraceCanFdMsg.byte(30) = 0x25;
      gTraceCanFdMsg.byte(31) = 0x86;
      gTraceCanFdMsg.byte(32) = 0xDE;
      gTraceCanFdMsg.byte(33) = 0x01;
      gTraceCanFdMsg.byte(34) = 0x00;
      gTraceCanFdMsg.byte(35) = 0x00;
      gTraceCanFdMsg.byte(36) = 0x00;
      gTraceCanFdMsg.byte(37) = 0x00;
      gTraceCanFdMsg.byte(38) = 0x00;
      gTraceCanFdMsg.byte(39) = 0x00;
      gTraceCanFdMsg.byte(40) = 0xDE;
      gTraceCanFdMsg.byte(41) = 0x01;
      gTraceCanFdMsg.byte(42) = 0x00;
      gTraceCanFdMsg.byte(43) = 0x00;
      gTraceCanFdMsg.byte(44) = 0x00;
      gTraceCanFdMsg.byte(45) = 0x00;
      gTraceCanFdMsg.byte(46) = 0x00;
      gTraceCanFdMsg.byte(47) = 0x00;
      break;
    case 43:
      gTraceCurrentId = 0x25B;
      gTraceCurrentLength = 8;
      gTraceCanFdMsg.byte(0) = 0x3A;
      gTraceCanFdMsg.byte(1) = 0x00;
      gTraceCanFdMsg.byte(2) = 0x01;
      gTraceCanFdMsg.byte(3) = 0x70;
      gTraceCanFdMsg.byte(4) = 0x00;
      gTraceCanFdMsg.byte(5) = 0x00;
      gTraceCanFdMsg.byte(6) = 0x00;
      gTraceCanFdMsg.byte(7) = 0x00;
      break;
    case 44:
      gTraceCurrentId = 0x264;
      gTraceCurrentLength = 24;
      gTraceCanFdMsg.byte(0) = 0x82;
      gTraceCanFdMsg.byte(1) = 0x02;
      gTraceCanFdMsg.byte(2) = 0x28;
      gTraceCanFdMsg.byte(3) = 0x50;
      gTraceCanFdMsg.byte(4) = 0x00;
      gTraceCanFdMsg.byte(5) = 0x51;
      gTraceCanFdMsg.byte(6) = 0x00;
      gTraceCanFdMsg.byte(7) = 0x00;
      gTraceCanFdMsg.byte(8) = 0x62;
      gTraceCanFdMsg.byte(9) = 0x02;
      gTraceCanFdMsg.byte(10) = 0x28;
      gTraceCanFdMsg.byte(11) = 0x10;
      gTraceCanFdMsg.byte(12) = 0x80;
      gTraceCanFdMsg.byte(13) = 0x19;
      gTraceCanFdMsg.byte(14) = 0x00;
      gTraceCanFdMsg.byte(15) = 0x00;
      gTraceCanFdMsg.byte(16) = 0x00;
      gTraceCanFdMsg.byte(17) = 0x00;
      gTraceCanFdMsg.byte(18) = 0x00;
      gTraceCanFdMsg.byte(19) = 0x00;
      gTraceCanFdMsg.byte(20) = 0x00;
      gTraceCanFdMsg.byte(21) = 0x00;
      gTraceCanFdMsg.byte(22) = 0x00;
      gTraceCanFdMsg.byte(23) = 0x00;
      break;
    case 45:
      gTraceCurrentId = 0x26B;
      gTraceCurrentLength = 8;
      gTraceCanFdMsg.byte(0) = 0x4F;
      gTraceCanFdMsg.byte(1) = 0x02;
      gTraceCanFdMsg.byte(2) = 0x0B;
      gTraceCanFdMsg.byte(3) = 0xB7;
      gTraceCanFdMsg.byte(4) = 0x46;
      gTraceCanFdMsg.byte(5) = 0x40;
      gTraceCanFdMsg.byte(6) = 0x00;
      gTraceCanFdMsg.byte(7) = 0x00;
      break;
    case 46:
      gTraceCurrentId = 0x274;
      gTraceCurrentLength = 8;
      gTraceCanFdMsg.byte(0) = 0xDA;
      gTraceCanFdMsg.byte(1) = 0x08;
      gTraceCanFdMsg.byte(2) = 0x3B;
      gTraceCanFdMsg.byte(3) = 0x50;
      gTraceCanFdMsg.byte(4) = 0x53;
      gTraceCanFdMsg.byte(5) = 0x0C;
      gTraceCanFdMsg.byte(6) = 0x00;
      gTraceCanFdMsg.byte(7) = 0x00;
      break;
    case 47:
      gTraceCurrentId = 0x2B4;
      gTraceCurrentLength = 8;
      gTraceCanFdMsg.byte(0) = 0x00;
      gTraceCanFdMsg.byte(1) = 0x00;
      gTraceCanFdMsg.byte(2) = 0x44;
      gTraceCanFdMsg.byte(3) = 0x43;
      gTraceCanFdMsg.byte(4) = 0x00;
      gTraceCanFdMsg.byte(5) = 0x00;
      gTraceCanFdMsg.byte(6) = 0x00;
      gTraceCanFdMsg.byte(7) = 0x00;
      break;
    case 48:
      gTraceCurrentId = 0x308;
      gTraceCurrentLength = 8;
      gTraceCanFdMsg.byte(0) = 0x28;
      gTraceCanFdMsg.byte(1) = 0x0D;
      gTraceCanFdMsg.byte(2) = 0x50;
      gTraceCanFdMsg.byte(3) = 0xA4;
      gTraceCanFdMsg.byte(4) = 0xF6;
      gTraceCanFdMsg.byte(5) = 0x50;
      gTraceCanFdMsg.byte(6) = 0x05;
      gTraceCanFdMsg.byte(7) = 0x0A;
      break;
    case 49:
      gTraceCurrentId = 0x309;
      gTraceCurrentLength = 8;
      gTraceCanFdMsg.byte(0) = 0x00;
      gTraceCanFdMsg.byte(1) = 0x00;
      gTraceCanFdMsg.byte(2) = 0x00;
      gTraceCanFdMsg.byte(3) = 0x7F;
      gTraceCanFdMsg.byte(4) = 0xFF;
      gTraceCanFdMsg.byte(5) = 0x41;
      gTraceCanFdMsg.byte(6) = 0x41;
      gTraceCanFdMsg.byte(7) = 0x4A;
      break;
    case 50:
      gTraceCurrentId = 0x30A;
      gTraceCurrentLength = 32;
      gTraceCanFdMsg.byte(0) = 0xB9;
      gTraceCanFdMsg.byte(1) = 0x0C;
      gTraceCanFdMsg.byte(2) = 0x00;
      gTraceCanFdMsg.byte(3) = 0x78;
      gTraceCanFdMsg.byte(4) = 0x00;
      gTraceCanFdMsg.byte(5) = 0x78;
      gTraceCanFdMsg.byte(6) = 0x03;
      gTraceCanFdMsg.byte(7) = 0x00;
      gTraceCanFdMsg.byte(8) = 0x31;
      gTraceCanFdMsg.byte(9) = 0x0C;
      gTraceCanFdMsg.byte(10) = 0x78;
      gTraceCanFdMsg.byte(11) = 0x02;
      gTraceCanFdMsg.byte(12) = 0x00;
      gTraceCanFdMsg.byte(13) = 0x8C;
      gTraceCanFdMsg.byte(14) = 0x00;
      gTraceCanFdMsg.byte(15) = 0xD2;
      gTraceCanFdMsg.byte(16) = 0x00;
      gTraceCanFdMsg.byte(17) = 0x00;
      gTraceCanFdMsg.byte(18) = 0x00;
      gTraceCanFdMsg.byte(19) = 0x82;
      gTraceCanFdMsg.byte(20) = 0x00;
      gTraceCanFdMsg.byte(21) = 0xBE;
      gTraceCanFdMsg.byte(22) = 0x00;
      gTraceCanFdMsg.byte(23) = 0x00;
      gTraceCanFdMsg.byte(24) = 0x00;
      gTraceCanFdMsg.byte(25) = 0x00;
      gTraceCanFdMsg.byte(26) = 0x55;
      gTraceCanFdMsg.byte(27) = 0x53;
      gTraceCanFdMsg.byte(28) = 0x41;
      gTraceCanFdMsg.byte(29) = 0x40;
      gTraceCanFdMsg.byte(30) = 0x3E;
      gTraceCanFdMsg.byte(31) = 0x80;
      break;
    case 51:
      gTraceCurrentId = 0x30F;
      gTraceCurrentLength = 8;
      gTraceCanFdMsg.byte(0) = 0x8C;
      gTraceCanFdMsg.byte(1) = 0x08;
      gTraceCanFdMsg.byte(2) = 0x00;
      gTraceCanFdMsg.byte(3) = 0x00;
      gTraceCanFdMsg.byte(4) = 0x00;
      gTraceCanFdMsg.byte(5) = 0x02;
      gTraceCanFdMsg.byte(6) = 0x00;
      gTraceCanFdMsg.byte(7) = 0x04;
      break;
    case 52:
      gTraceCurrentId = 0x312;
      gTraceCurrentLength = 8;
      gTraceCanFdMsg.byte(0) = 0x00;
      gTraceCanFdMsg.byte(1) = 0x00;
      gTraceCanFdMsg.byte(2) = 0x7F;
      gTraceCanFdMsg.byte(3) = 0xE5;
      gTraceCanFdMsg.byte(4) = 0x58;
      gTraceCanFdMsg.byte(5) = 0x7F;
      gTraceCanFdMsg.byte(6) = 0x80;
      gTraceCanFdMsg.byte(7) = 0x64;
      break;
    case 53:
      gTraceCurrentId = 0x31A;
      gTraceCurrentLength = 24;
      gTraceCanFdMsg.byte(0) = 0x00;
      gTraceCanFdMsg.byte(1) = 0x00;
      gTraceCanFdMsg.byte(2) = 0x00;
      gTraceCanFdMsg.byte(3) = 0x00;
      gTraceCanFdMsg.byte(4) = 0x00;
      gTraceCanFdMsg.byte(5) = 0x00;
      gTraceCanFdMsg.byte(6) = 0x00;
      gTraceCanFdMsg.byte(7) = 0x00;
      gTraceCanFdMsg.byte(8) = 0x00;
      gTraceCanFdMsg.byte(9) = 0x00;
      gTraceCanFdMsg.byte(10) = 0x00;
      gTraceCanFdMsg.byte(11) = 0x00;
      gTraceCanFdMsg.byte(12) = 0x00;
      gTraceCanFdMsg.byte(13) = 0x00;
      gTraceCanFdMsg.byte(14) = 0x00;
      gTraceCanFdMsg.byte(15) = 0x00;
      gTraceCanFdMsg.byte(16) = 0x00;
      gTraceCanFdMsg.byte(17) = 0x00;
      gTraceCanFdMsg.byte(18) = 0x00;
      gTraceCanFdMsg.byte(19) = 0x00;
      gTraceCanFdMsg.byte(20) = 0x00;
      gTraceCanFdMsg.byte(21) = 0x00;
      gTraceCanFdMsg.byte(22) = 0x00;
      gTraceCanFdMsg.byte(23) = 0x00;
      break;
    case 54:
      gTraceCurrentId = 0x321;
      gTraceCurrentLength = 16;
      gTraceCanFdMsg.byte(0) = 0x00;
      gTraceCanFdMsg.byte(1) = 0x00;
      gTraceCanFdMsg.byte(2) = 0x14;
      gTraceCanFdMsg.byte(3) = 0x82;
      gTraceCanFdMsg.byte(4) = 0x08;
      gTraceCanFdMsg.byte(5) = 0xB0;
      gTraceCanFdMsg.byte(6) = 0x00;
      gTraceCanFdMsg.byte(7) = 0x00;
      gTraceCanFdMsg.byte(8) = 0x00;
      gTraceCanFdMsg.byte(9) = 0x00;
      gTraceCanFdMsg.byte(10) = 0x00;
      gTraceCanFdMsg.byte(11) = 0x00;
      gTraceCanFdMsg.byte(12) = 0x00;
      gTraceCanFdMsg.byte(13) = 0x00;
      gTraceCanFdMsg.byte(14) = 0x00;
      gTraceCanFdMsg.byte(15) = 0x00;
      break;
    case 55:
      gTraceCurrentId = 0x328;
      gTraceCurrentLength = 16;
      gTraceCanFdMsg.byte(0) = 0xAA;
      gTraceCanFdMsg.byte(1) = 0x0A;
      gTraceCanFdMsg.byte(2) = 0x28;
      gTraceCanFdMsg.byte(3) = 0x00;
      gTraceCanFdMsg.byte(4) = 0x11;
      gTraceCanFdMsg.byte(5) = 0xE4;
      gTraceCanFdMsg.byte(6) = 0x80;
      gTraceCanFdMsg.byte(7) = 0x4A;
      gTraceCanFdMsg.byte(8) = 0x00;
      gTraceCanFdMsg.byte(9) = 0x00;
      gTraceCanFdMsg.byte(10) = 0x97;
      gTraceCanFdMsg.byte(11) = 0x6F;
      gTraceCanFdMsg.byte(12) = 0x2B;
      gTraceCanFdMsg.byte(13) = 0x42;
      gTraceCanFdMsg.byte(14) = 0x00;
      gTraceCanFdMsg.byte(15) = 0x00;
      break;
    case 56:
      gTraceCurrentId = 0x32B;
      gTraceCurrentLength = 16;
      gTraceCanFdMsg.byte(0) = 0x07;
      gTraceCanFdMsg.byte(1) = 0x08;
      gTraceCanFdMsg.byte(2) = 0x26;
      gTraceCanFdMsg.byte(3) = 0x0C;
      gTraceCanFdMsg.byte(4) = 0x66;
      gTraceCanFdMsg.byte(5) = 0x22;
      gTraceCanFdMsg.byte(6) = 0x0C;
      gTraceCanFdMsg.byte(7) = 0x63;
      gTraceCanFdMsg.byte(8) = 0x00;
      gTraceCanFdMsg.byte(9) = 0x08;
      gTraceCanFdMsg.byte(10) = 0x30;
      gTraceCanFdMsg.byte(11) = 0x00;
      gTraceCanFdMsg.byte(12) = 0x1F;
      gTraceCanFdMsg.byte(13) = 0xB8;
      gTraceCanFdMsg.byte(14) = 0xEA;
      gTraceCanFdMsg.byte(15) = 0x00;
      break;
    case 57:
      gTraceCurrentId = 0x332;
      gTraceCurrentLength = 16;
      gTraceCanFdMsg.byte(0) = 0x2A;
      gTraceCanFdMsg.byte(1) = 0x0A;
      gTraceCanFdMsg.byte(2) = 0x0F;
      gTraceCanFdMsg.byte(3) = 0x18;
      gTraceCanFdMsg.byte(4) = 0x6D;
      gTraceCanFdMsg.byte(5) = 0x56;
      gTraceCanFdMsg.byte(6) = 0x7F;
      gTraceCanFdMsg.byte(7) = 0xE0;
      gTraceCanFdMsg.byte(8) = 0x89;
      gTraceCanFdMsg.byte(9) = 0x0A;
      gTraceCanFdMsg.byte(10) = 0x00;
      gTraceCanFdMsg.byte(11) = 0x00;
      gTraceCanFdMsg.byte(12) = 0x00;
      gTraceCanFdMsg.byte(13) = 0x00;
      gTraceCanFdMsg.byte(14) = 0x00;
      gTraceCanFdMsg.byte(15) = 0x00;
      break;
    case 58:
      gTraceCurrentId = 0x338;
      gTraceCurrentLength = 16;
      gTraceCanFdMsg.byte(0) = 0x1B;
      gTraceCanFdMsg.byte(1) = 0x0A;
      gTraceCanFdMsg.byte(2) = 0x00;
      gTraceCanFdMsg.byte(3) = 0x00;
      gTraceCanFdMsg.byte(4) = 0x00;
      gTraceCanFdMsg.byte(5) = 0x00;
      gTraceCanFdMsg.byte(6) = 0x00;
      gTraceCanFdMsg.byte(7) = 0x00;
      gTraceCanFdMsg.byte(8) = 0x00;
      gTraceCanFdMsg.byte(9) = 0x00;
      gTraceCanFdMsg.byte(10) = 0x0F;
      gTraceCanFdMsg.byte(11) = 0x00;
      gTraceCanFdMsg.byte(12) = 0x00;
      gTraceCanFdMsg.byte(13) = 0x00;
      gTraceCanFdMsg.byte(14) = 0x00;
      gTraceCanFdMsg.byte(15) = 0x00;
      break;
    case 59:
      gTraceCurrentId = 0x33B;
      gTraceCurrentLength = 64;
      gTraceCanFdMsg.byte(0) = 0x0C;
      gTraceCanFdMsg.byte(1) = 0x64;
      gTraceCanFdMsg.byte(2) = 0x0C;
      gTraceCanFdMsg.byte(3) = 0x65;
      gTraceCanFdMsg.byte(4) = 0x0C;
      gTraceCanFdMsg.byte(5) = 0x65;
      gTraceCanFdMsg.byte(6) = 0x0C;
      gTraceCanFdMsg.byte(7) = 0x65;
      gTraceCanFdMsg.byte(8) = 0x0C;
      gTraceCanFdMsg.byte(9) = 0x64;
      gTraceCanFdMsg.byte(10) = 0x0C;
      gTraceCanFdMsg.byte(11) = 0x65;
      gTraceCanFdMsg.byte(12) = 0x0C;
      gTraceCanFdMsg.byte(13) = 0x64;
      gTraceCanFdMsg.byte(14) = 0x0C;
      gTraceCanFdMsg.byte(15) = 0x64;
      gTraceCanFdMsg.byte(16) = 0x0C;
      gTraceCanFdMsg.byte(17) = 0x64;
      gTraceCanFdMsg.byte(18) = 0x0C;
      gTraceCanFdMsg.byte(19) = 0x65;
      gTraceCanFdMsg.byte(20) = 0x0C;
      gTraceCanFdMsg.byte(21) = 0x65;
      gTraceCanFdMsg.byte(22) = 0x0C;
      gTraceCanFdMsg.byte(23) = 0x64;
      gTraceCanFdMsg.byte(24) = 0x0C;
      gTraceCanFdMsg.byte(25) = 0x65;
      gTraceCanFdMsg.byte(26) = 0x0C;
      gTraceCanFdMsg.byte(27) = 0x66;
      gTraceCanFdMsg.byte(28) = 0x0C;
      gTraceCanFdMsg.byte(29) = 0x65;
      gTraceCanFdMsg.byte(30) = 0x0C;
      gTraceCanFdMsg.byte(31) = 0x65;
      gTraceCanFdMsg.byte(32) = 0x0C;
      gTraceCanFdMsg.byte(33) = 0x64;
      gTraceCanFdMsg.byte(34) = 0x0C;
      gTraceCanFdMsg.byte(35) = 0x64;
      gTraceCanFdMsg.byte(36) = 0x0C;
      gTraceCanFdMsg.byte(37) = 0x64;
      gTraceCanFdMsg.byte(38) = 0x0C;
      gTraceCanFdMsg.byte(39) = 0x64;
      gTraceCanFdMsg.byte(40) = 0x0C;
      gTraceCanFdMsg.byte(41) = 0x64;
      gTraceCanFdMsg.byte(42) = 0x0C;
      gTraceCanFdMsg.byte(43) = 0x64;
      gTraceCanFdMsg.byte(44) = 0x0C;
      gTraceCanFdMsg.byte(45) = 0x64;
      gTraceCanFdMsg.byte(46) = 0x0C;
      gTraceCanFdMsg.byte(47) = 0x64;
      gTraceCanFdMsg.byte(48) = 0x0C;
      gTraceCanFdMsg.byte(49) = 0x64;
      gTraceCanFdMsg.byte(50) = 0x0C;
      gTraceCanFdMsg.byte(51) = 0x65;
      gTraceCanFdMsg.byte(52) = 0x0C;
      gTraceCanFdMsg.byte(53) = 0x65;
      gTraceCanFdMsg.byte(54) = 0x0C;
      gTraceCanFdMsg.byte(55) = 0x65;
      gTraceCanFdMsg.byte(56) = 0x0C;
      gTraceCanFdMsg.byte(57) = 0x65;
      gTraceCanFdMsg.byte(58) = 0x0C;
      gTraceCanFdMsg.byte(59) = 0x65;
      gTraceCanFdMsg.byte(60) = 0x00;
      gTraceCanFdMsg.byte(61) = 0x3D;
      gTraceCanFdMsg.byte(62) = 0x1E;
      gTraceCanFdMsg.byte(63) = 0xFF;
      break;
    case 60:
      gTraceCurrentId = 0x360;
      gTraceCurrentLength = 8;
      gTraceCanFdMsg.byte(0) = 0x20;
      gTraceCanFdMsg.byte(1) = 0x0A;
      gTraceCanFdMsg.byte(2) = 0x00;
      gTraceCanFdMsg.byte(3) = 0x00;
      gTraceCanFdMsg.byte(4) = 0x00;
      gTraceCanFdMsg.byte(5) = 0x00;
      gTraceCanFdMsg.byte(6) = 0x00;
      gTraceCanFdMsg.byte(7) = 0x00;
      break;
    case 61:
      gTraceCurrentId = 0x368;
      gTraceCurrentLength = 32;
      gTraceCanFdMsg.byte(0) = 0x46;
      gTraceCanFdMsg.byte(1) = 0x01;
      gTraceCanFdMsg.byte(2) = 0xAC;
      gTraceCanFdMsg.byte(3) = 0x11;
      gTraceCanFdMsg.byte(4) = 0x11;
      gTraceCanFdMsg.byte(5) = 0x11;
      gTraceCanFdMsg.byte(6) = 0x11;
      gTraceCanFdMsg.byte(7) = 0x00;
      gTraceCanFdMsg.byte(8) = 0x00;
      gTraceCanFdMsg.byte(9) = 0x00;
      gTraceCanFdMsg.byte(10) = 0x11;
      gTraceCanFdMsg.byte(11) = 0x11;
      gTraceCanFdMsg.byte(12) = 0x11;
      gTraceCanFdMsg.byte(13) = 0x11;
      gTraceCanFdMsg.byte(14) = 0x11;
      gTraceCanFdMsg.byte(15) = 0x00;
      gTraceCanFdMsg.byte(16) = 0x00;
      gTraceCanFdMsg.byte(17) = 0x00;
      gTraceCanFdMsg.byte(18) = 0x11;
      gTraceCanFdMsg.byte(19) = 0x11;
      gTraceCanFdMsg.byte(20) = 0x10;
      gTraceCanFdMsg.byte(21) = 0x24;
      gTraceCanFdMsg.byte(22) = 0x00;
      gTraceCanFdMsg.byte(23) = 0x00;
      gTraceCanFdMsg.byte(24) = 0x00;
      gTraceCanFdMsg.byte(25) = 0x00;
      gTraceCanFdMsg.byte(26) = 0x00;
      gTraceCanFdMsg.byte(27) = 0x00;
      gTraceCanFdMsg.byte(28) = 0x00;
      gTraceCanFdMsg.byte(29) = 0x00;
      gTraceCanFdMsg.byte(30) = 0x00;
      gTraceCanFdMsg.byte(31) = 0x00;
      break;
    case 62:
      gTraceCurrentId = 0x374;
      gTraceCurrentLength = 64;
      gTraceCanFdMsg.byte(0) = 0x00;
      gTraceCanFdMsg.byte(1) = 0x00;
      gTraceCanFdMsg.byte(2) = 0x23;
      gTraceCanFdMsg.byte(3) = 0x3D;
      gTraceCanFdMsg.byte(4) = 0x59;
      gTraceCanFdMsg.byte(5) = 0x0F;
      gTraceCanFdMsg.byte(6) = 0x0A;
      gTraceCanFdMsg.byte(7) = 0x4C;
      gTraceCanFdMsg.byte(8) = 0x00;
      gTraceCanFdMsg.byte(9) = 0x37;
      gTraceCanFdMsg.byte(10) = 0x41;
      gTraceCanFdMsg.byte(11) = 0x00;
      gTraceCanFdMsg.byte(12) = 0x00;
      gTraceCanFdMsg.byte(13) = 0x00;
      gTraceCanFdMsg.byte(14) = 0x00;
      gTraceCanFdMsg.byte(15) = 0x02;
      gTraceCanFdMsg.byte(16) = 0x00;
      gTraceCanFdMsg.byte(17) = 0x00;
      gTraceCanFdMsg.byte(18) = 0x00;
      gTraceCanFdMsg.byte(19) = 0x00;
      gTraceCanFdMsg.byte(20) = 0x02;
      gTraceCanFdMsg.byte(21) = 0x00;
      gTraceCanFdMsg.byte(22) = 0x51;
      gTraceCanFdMsg.byte(23) = 0x03;
      gTraceCanFdMsg.byte(24) = 0x00;
      gTraceCanFdMsg.byte(25) = 0x00;
      gTraceCanFdMsg.byte(26) = 0x00;
      gTraceCanFdMsg.byte(27) = 0x00;
      gTraceCanFdMsg.byte(28) = 0x00;
      gTraceCanFdMsg.byte(29) = 0x00;
      gTraceCanFdMsg.byte(30) = 0x00;
      gTraceCanFdMsg.byte(31) = 0x00;
      gTraceCanFdMsg.byte(32) = 0x00;
      gTraceCanFdMsg.byte(33) = 0x00;
      gTraceCanFdMsg.byte(34) = 0x00;
      gTraceCanFdMsg.byte(35) = 0x00;
      gTraceCanFdMsg.byte(36) = 0x00;
      gTraceCanFdMsg.byte(37) = 0xE7;
      gTraceCanFdMsg.byte(38) = 0x00;
      gTraceCanFdMsg.byte(39) = 0x00;
      gTraceCanFdMsg.byte(40) = 0x00;
      gTraceCanFdMsg.byte(41) = 0x00;
      gTraceCanFdMsg.byte(42) = 0x49;
      gTraceCanFdMsg.byte(43) = 0x04;
      gTraceCanFdMsg.byte(44) = 0x58;
      gTraceCanFdMsg.byte(45) = 0x53;
      gTraceCanFdMsg.byte(46) = 0x00;
      gTraceCanFdMsg.byte(47) = 0x33;
      gTraceCanFdMsg.byte(48) = 0x00;
      gTraceCanFdMsg.byte(49) = 0x00;
      gTraceCanFdMsg.byte(50) = 0x57;
      gTraceCanFdMsg.byte(51) = 0x58;
      gTraceCanFdMsg.byte(52) = 0x5D;
      gTraceCanFdMsg.byte(53) = 0x00;
      gTraceCanFdMsg.byte(54) = 0x00;
      gTraceCanFdMsg.byte(55) = 0x14;
      gTraceCanFdMsg.byte(56) = 0x00;
      gTraceCanFdMsg.byte(57) = 0x00;
      gTraceCanFdMsg.byte(58) = 0x00;
      gTraceCanFdMsg.byte(59) = 0x00;
      gTraceCanFdMsg.byte(60) = 0x00;
      gTraceCanFdMsg.byte(61) = 0x52;
      gTraceCanFdMsg.byte(62) = 0x00;
      gTraceCanFdMsg.byte(63) = 0x00;
      break;
    case 63:
      gTraceCurrentId = 0x3AB;
      gTraceCurrentLength = 8;
      gTraceCanFdMsg.byte(0) = 0x00;
      gTraceCanFdMsg.byte(1) = 0x00;
      gTraceCanFdMsg.byte(2) = 0x00;
      gTraceCanFdMsg.byte(3) = 0x00;
      gTraceCanFdMsg.byte(4) = 0x00;
      gTraceCanFdMsg.byte(5) = 0x00;
      gTraceCanFdMsg.byte(6) = 0x00;
      gTraceCanFdMsg.byte(7) = 0x00;
      break;
    case 64:
      gTraceCurrentId = 0x3B6;
      gTraceCurrentLength = 32;
      gTraceCanFdMsg.byte(0) = 0x00;
      gTraceCanFdMsg.byte(1) = 0x00;
      gTraceCanFdMsg.byte(2) = 0x00;
      gTraceCanFdMsg.byte(3) = 0x00;
      gTraceCanFdMsg.byte(4) = 0x00;
      gTraceCanFdMsg.byte(5) = 0x0A;
      gTraceCanFdMsg.byte(6) = 0x00;
      gTraceCanFdMsg.byte(7) = 0x00;
      gTraceCanFdMsg.byte(8) = 0x00;
      gTraceCanFdMsg.byte(9) = 0x00;
      gTraceCanFdMsg.byte(10) = 0x00;
      gTraceCanFdMsg.byte(11) = 0x00;
      gTraceCanFdMsg.byte(12) = 0x01;
      gTraceCanFdMsg.byte(13) = 0x00;
      gTraceCanFdMsg.byte(14) = 0x00;
      gTraceCanFdMsg.byte(15) = 0x00;
      gTraceCanFdMsg.byte(16) = 0x00;
      gTraceCanFdMsg.byte(17) = 0x00;
      gTraceCanFdMsg.byte(18) = 0x00;
      gTraceCanFdMsg.byte(19) = 0x00;
      gTraceCanFdMsg.byte(20) = 0x00;
      gTraceCanFdMsg.byte(21) = 0x65;
      gTraceCanFdMsg.byte(22) = 0x00;
      gTraceCanFdMsg.byte(23) = 0x00;
      gTraceCanFdMsg.byte(24) = 0x00;
      gTraceCanFdMsg.byte(25) = 0x00;
      gTraceCanFdMsg.byte(26) = 0x00;
      gTraceCanFdMsg.byte(27) = 0x00;
      gTraceCanFdMsg.byte(28) = 0x00;
      gTraceCanFdMsg.byte(29) = 0x00;
      gTraceCanFdMsg.byte(30) = 0x00;
      gTraceCanFdMsg.byte(31) = 0x00;
      break;
    case 65:
      gTraceCurrentId = 0x402;
      gTraceCurrentLength = 8;
      gTraceCanFdMsg.byte(0) = 0x00;
      gTraceCanFdMsg.byte(1) = 0x00;
      gTraceCanFdMsg.byte(2) = 0x00;
      gTraceCanFdMsg.byte(3) = 0x00;
      gTraceCanFdMsg.byte(4) = 0x00;
      gTraceCanFdMsg.byte(5) = 0x00;
      gTraceCanFdMsg.byte(6) = 0x00;
      gTraceCanFdMsg.byte(7) = 0x00;
      break;
    case 66:
      gTraceCurrentId = 0x403;
      gTraceCurrentLength = 8;
      gTraceCanFdMsg.byte(0) = 0x00;
      gTraceCanFdMsg.byte(1) = 0x00;
      gTraceCanFdMsg.byte(2) = 0x05;
      gTraceCanFdMsg.byte(3) = 0x80;
      gTraceCanFdMsg.byte(4) = 0x8A;
      gTraceCanFdMsg.byte(5) = 0x00;
      gTraceCanFdMsg.byte(6) = 0x43;
      gTraceCanFdMsg.byte(7) = 0xD0;
      break;
    case 67:
      gTraceCurrentId = 0x40A;
      gTraceCurrentLength = 8;
      gTraceCanFdMsg.byte(0) = 0xFD;
      gTraceCanFdMsg.byte(1) = 0x05;
      gTraceCanFdMsg.byte(2) = 0x80;
      gTraceCanFdMsg.byte(3) = 0x12;
      gTraceCanFdMsg.byte(4) = 0x41;
      gTraceCanFdMsg.byte(5) = 0x24;
      gTraceCanFdMsg.byte(6) = 0x08;
      gTraceCanFdMsg.byte(7) = 0x01;
      break;
    case 68:
      gTraceCurrentId = 0x40B;
      gTraceCurrentLength = 8;
      gTraceCanFdMsg.byte(0) = 0x00;
      gTraceCanFdMsg.byte(1) = 0x00;
      gTraceCanFdMsg.byte(2) = 0x00;
      gTraceCanFdMsg.byte(3) = 0x00;
      gTraceCanFdMsg.byte(4) = 0x00;
      gTraceCanFdMsg.byte(5) = 0x00;
      gTraceCanFdMsg.byte(6) = 0x00;
      gTraceCanFdMsg.byte(7) = 0x00;
      break;
    case 69:
      gTraceCurrentId = 0x40C;
      gTraceCurrentLength = 8;
      gTraceCanFdMsg.byte(0) = 0x00;
      gTraceCanFdMsg.byte(1) = 0x00;
      gTraceCanFdMsg.byte(2) = 0x00;
      gTraceCanFdMsg.byte(3) = 0x0F;
      gTraceCanFdMsg.byte(4) = 0x9B;
      gTraceCanFdMsg.byte(5) = 0x00;
      gTraceCanFdMsg.byte(6) = 0x00;
      gTraceCanFdMsg.byte(7) = 0x00;
      break;
    case 70:
      gTraceCurrentId = 0x411;
      gTraceCurrentLength = 64;
      gTraceCanFdMsg.byte(0) = 0x00;
      gTraceCanFdMsg.byte(1) = 0x00;
      gTraceCanFdMsg.byte(2) = 0x00;
      gTraceCanFdMsg.byte(3) = 0x00;
      gTraceCanFdMsg.byte(4) = 0x00;
      gTraceCanFdMsg.byte(5) = 0x00;
      gTraceCanFdMsg.byte(6) = 0x00;
      gTraceCanFdMsg.byte(7) = 0x00;
      gTraceCanFdMsg.byte(8) = 0x00;
      gTraceCanFdMsg.byte(9) = 0x00;
      gTraceCanFdMsg.byte(10) = 0x00;
      gTraceCanFdMsg.byte(11) = 0x0C;
      gTraceCanFdMsg.byte(12) = 0x40;
      gTraceCanFdMsg.byte(13) = 0x00;
      gTraceCanFdMsg.byte(14) = 0x03;
      gTraceCanFdMsg.byte(15) = 0xF1;
      gTraceCanFdMsg.byte(16) = 0x00;
      gTraceCanFdMsg.byte(17) = 0x00;
      gTraceCanFdMsg.byte(18) = 0x00;
      gTraceCanFdMsg.byte(19) = 0x00;
      gTraceCanFdMsg.byte(20) = 0x0D;
      gTraceCanFdMsg.byte(21) = 0x62;
      gTraceCanFdMsg.byte(22) = 0x00;
      gTraceCanFdMsg.byte(23) = 0x00;
      gTraceCanFdMsg.byte(24) = 0x00;
      gTraceCanFdMsg.byte(25) = 0x00;
      gTraceCanFdMsg.byte(26) = 0x27;
      gTraceCanFdMsg.byte(27) = 0x10;
      gTraceCanFdMsg.byte(28) = 0x01;
      gTraceCanFdMsg.byte(29) = 0xFB;
      gTraceCanFdMsg.byte(30) = 0x23;
      gTraceCanFdMsg.byte(31) = 0xA8;
      gTraceCanFdMsg.byte(32) = 0x00;
      gTraceCanFdMsg.byte(33) = 0x00;
      gTraceCanFdMsg.byte(34) = 0x00;
      gTraceCanFdMsg.byte(35) = 0x00;
      gTraceCanFdMsg.byte(36) = 0x27;
      gTraceCanFdMsg.byte(37) = 0x10;
      gTraceCanFdMsg.byte(38) = 0x00;
      gTraceCanFdMsg.byte(39) = 0x00;
      gTraceCanFdMsg.byte(40) = 0x00;
      gTraceCanFdMsg.byte(41) = 0x00;
      gTraceCanFdMsg.byte(42) = 0x9C;
      gTraceCanFdMsg.byte(43) = 0x40;
      gTraceCanFdMsg.byte(44) = 0x00;
      gTraceCanFdMsg.byte(45) = 0x00;
      gTraceCanFdMsg.byte(46) = 0x00;
      gTraceCanFdMsg.byte(47) = 0x00;
      gTraceCanFdMsg.byte(48) = 0x00;
      gTraceCanFdMsg.byte(49) = 0x00;
      gTraceCanFdMsg.byte(50) = 0x00;
      gTraceCanFdMsg.byte(51) = 0x00;
      gTraceCanFdMsg.byte(52) = 0x00;
      gTraceCanFdMsg.byte(53) = 0x00;
      gTraceCanFdMsg.byte(54) = 0x00;
      gTraceCanFdMsg.byte(55) = 0x00;
      gTraceCanFdMsg.byte(56) = 0x00;
      gTraceCanFdMsg.byte(57) = 0x00;
      gTraceCanFdMsg.byte(58) = 0xC3;
      gTraceCanFdMsg.byte(59) = 0x0A;
      gTraceCanFdMsg.byte(60) = 0x00;
      gTraceCanFdMsg.byte(61) = 0x00;
      gTraceCanFdMsg.byte(62) = 0x00;
      gTraceCanFdMsg.byte(63) = 0x00;
      break;
    case 71:
      gTraceCurrentId = 0x414;
      gTraceCurrentLength = 8;
      gTraceCanFdMsg.byte(0) = 0x00;
      gTraceCanFdMsg.byte(1) = 0x00;
      gTraceCanFdMsg.byte(2) = 0x10;
      gTraceCanFdMsg.byte(3) = 0x48;
      gTraceCanFdMsg.byte(4) = 0x28;
      gTraceCanFdMsg.byte(5) = 0x50;
      gTraceCanFdMsg.byte(6) = 0x00;
      gTraceCanFdMsg.byte(7) = 0x00;
      break;
    case 72:
      gTraceCurrentId = 0x41F;
      gTraceCurrentLength = 16;
      gTraceCanFdMsg.byte(0) = 0x00;
      gTraceCanFdMsg.byte(1) = 0x04;
      gTraceCanFdMsg.byte(2) = 0x00;
      gTraceCanFdMsg.byte(3) = 0x00;
      gTraceCanFdMsg.byte(4) = 0x01;
      gTraceCanFdMsg.byte(5) = 0x00;
      gTraceCanFdMsg.byte(6) = 0x00;
      gTraceCanFdMsg.byte(7) = 0x00;
      gTraceCanFdMsg.byte(8) = 0x0B;
      gTraceCanFdMsg.byte(9) = 0x04;
      gTraceCanFdMsg.byte(10) = 0x00;
      gTraceCanFdMsg.byte(11) = 0x00;
      gTraceCanFdMsg.byte(12) = 0x00;
      gTraceCanFdMsg.byte(13) = 0x00;
      gTraceCanFdMsg.byte(14) = 0x0D;
      gTraceCanFdMsg.byte(15) = 0x00;
      break;
    case 73:
      gTraceCurrentId = 0x421;
      gTraceCurrentLength = 32;
      gTraceCanFdMsg.byte(0) = 0x00;
      gTraceCanFdMsg.byte(1) = 0x00;
      gTraceCanFdMsg.byte(2) = 0x00;
      gTraceCanFdMsg.byte(3) = 0x00;
      gTraceCanFdMsg.byte(4) = 0x00;
      gTraceCanFdMsg.byte(5) = 0x00;
      gTraceCanFdMsg.byte(6) = 0x00;
      gTraceCanFdMsg.byte(7) = 0x00;
      gTraceCanFdMsg.byte(8) = 0x00;
      gTraceCanFdMsg.byte(9) = 0x40;
      gTraceCanFdMsg.byte(10) = 0x00;
      gTraceCanFdMsg.byte(11) = 0x00;
      gTraceCanFdMsg.byte(12) = 0x00;
      gTraceCanFdMsg.byte(13) = 0x00;
      gTraceCanFdMsg.byte(14) = 0x00;
      gTraceCanFdMsg.byte(15) = 0x00;
      gTraceCanFdMsg.byte(16) = 0x00;
      gTraceCanFdMsg.byte(17) = 0x1F;
      gTraceCanFdMsg.byte(18) = 0xB8;
      gTraceCanFdMsg.byte(19) = 0xEA;
      gTraceCanFdMsg.byte(20) = 0x00;
      gTraceCanFdMsg.byte(21) = 0x00;
      gTraceCanFdMsg.byte(22) = 0x00;
      gTraceCanFdMsg.byte(23) = 0x00;
      gTraceCanFdMsg.byte(24) = 0x03;
      gTraceCanFdMsg.byte(25) = 0x1F;
      gTraceCanFdMsg.byte(26) = 0x00;
      gTraceCanFdMsg.byte(27) = 0x00;
      gTraceCanFdMsg.byte(28) = 0x00;
      gTraceCanFdMsg.byte(29) = 0x00;
      gTraceCanFdMsg.byte(30) = 0x00;
      gTraceCanFdMsg.byte(31) = 0x00;
      break;
    case 74:
      gTraceCurrentId = 0x43E;
      gTraceCurrentLength = 16;
      gTraceCanFdMsg.byte(0) = 0x56;
      gTraceCanFdMsg.byte(1) = 0x05;
      gTraceCanFdMsg.byte(2) = 0x00;
      gTraceCanFdMsg.byte(3) = 0x00;
      gTraceCanFdMsg.byte(4) = 0x00;
      gTraceCanFdMsg.byte(5) = 0x00;
      gTraceCanFdMsg.byte(6) = 0x00;
      gTraceCanFdMsg.byte(7) = 0x00;
      gTraceCanFdMsg.byte(8) = 0x00;
      gTraceCanFdMsg.byte(9) = 0x05;
      gTraceCanFdMsg.byte(10) = 0x00;
      gTraceCanFdMsg.byte(11) = 0x00;
      gTraceCanFdMsg.byte(12) = 0x00;
      gTraceCanFdMsg.byte(13) = 0x00;
      gTraceCanFdMsg.byte(14) = 0x16;
      gTraceCanFdMsg.byte(15) = 0x38;
      break;
    case 75:
      gTraceCurrentId = 0x440;
      gTraceCurrentLength = 16;
      gTraceCanFdMsg.byte(0) = 0x00;
      gTraceCanFdMsg.byte(1) = 0x00;
      gTraceCanFdMsg.byte(2) = 0x7F;
      gTraceCanFdMsg.byte(3) = 0xA3;
      gTraceCanFdMsg.byte(4) = 0xFC;
      gTraceCanFdMsg.byte(5) = 0x7F;
      gTraceCanFdMsg.byte(6) = 0xC0;
      gTraceCanFdMsg.byte(7) = 0x00;
      gTraceCanFdMsg.byte(8) = 0xAD;
      gTraceCanFdMsg.byte(9) = 0x06;
      gTraceCanFdMsg.byte(10) = 0x41;
      gTraceCanFdMsg.byte(11) = 0x41;
      gTraceCanFdMsg.byte(12) = 0x4B;
      gTraceCanFdMsg.byte(13) = 0x64;
      gTraceCanFdMsg.byte(14) = 0x00;
      gTraceCanFdMsg.byte(15) = 0x00;
      break;
    case 76:
      gTraceCurrentId = 0x44B;
      gTraceCurrentLength = 8;
      gTraceCanFdMsg.byte(0) = 0x44;
      gTraceCanFdMsg.byte(1) = 0x06;
      gTraceCanFdMsg.byte(2) = 0x49;
      gTraceCanFdMsg.byte(3) = 0x24;
      gTraceCanFdMsg.byte(4) = 0x1A;
      gTraceCanFdMsg.byte(5) = 0x00;
      gTraceCanFdMsg.byte(6) = 0x28;
      gTraceCanFdMsg.byte(7) = 0x4A;
      break;
    case 77:
      gTraceCurrentId = 0x44E;
      gTraceCurrentLength = 8;
      gTraceCanFdMsg.byte(0) = 0x00;
      gTraceCanFdMsg.byte(1) = 0x00;
      gTraceCanFdMsg.byte(2) = 0x00;
      gTraceCanFdMsg.byte(3) = 0x00;
      gTraceCanFdMsg.byte(4) = 0x00;
      gTraceCanFdMsg.byte(5) = 0x00;
      gTraceCanFdMsg.byte(6) = 0x00;
      gTraceCanFdMsg.byte(7) = 0x00;
      break;
    case 78:
      gTraceCurrentId = 0x44F;
      gTraceCurrentLength = 24;
      gTraceCanFdMsg.byte(0) = 0x00;
      gTraceCanFdMsg.byte(1) = 0x00;
      gTraceCanFdMsg.byte(2) = 0x7F;
      gTraceCanFdMsg.byte(3) = 0xE3;
      gTraceCanFdMsg.byte(4) = 0xFF;
      gTraceCanFdMsg.byte(5) = 0x7F;
      gTraceCanFdMsg.byte(6) = 0xE0;
      gTraceCanFdMsg.byte(7) = 0x12;
      gTraceCanFdMsg.byte(8) = 0x89;
      gTraceCanFdMsg.byte(9) = 0x05;
      gTraceCanFdMsg.byte(10) = 0x4A;
      gTraceCanFdMsg.byte(11) = 0x4A;
      gTraceCanFdMsg.byte(12) = 0x4A;
      gTraceCanFdMsg.byte(13) = 0x4A;
      gTraceCanFdMsg.byte(14) = 0x4B;
      gTraceCanFdMsg.byte(15) = 0x28;
      gTraceCanFdMsg.byte(16) = 0x00;
      gTraceCanFdMsg.byte(17) = 0x00;
      gTraceCanFdMsg.byte(18) = 0x02;
      gTraceCanFdMsg.byte(19) = 0x80;
      gTraceCanFdMsg.byte(20) = 0x0A;
      gTraceCanFdMsg.byte(21) = 0x64;
      gTraceCanFdMsg.byte(22) = 0x00;
      gTraceCanFdMsg.byte(23) = 0x00;
      break;
    case 79:
      gTraceCurrentId = 0x452;
      gTraceCurrentLength = 8;
      gTraceCanFdMsg.byte(0) = 0x9B;
      gTraceCanFdMsg.byte(1) = 0x0D;
      gTraceCanFdMsg.byte(2) = 0x48;
      gTraceCanFdMsg.byte(3) = 0x2B;
      gTraceCanFdMsg.byte(4) = 0xC0;
      gTraceCanFdMsg.byte(5) = 0x58;
      gTraceCanFdMsg.byte(6) = 0x00;
      gTraceCanFdMsg.byte(7) = 0x62;
      break;
    case 80:
      gTraceCurrentId = 0x459;
      gTraceCurrentLength = 64;
      gTraceCanFdMsg.byte(0) = 0x00;
      gTraceCanFdMsg.byte(1) = 0x00;
      gTraceCanFdMsg.byte(2) = 0x00;
      gTraceCanFdMsg.byte(3) = 0x00;
      gTraceCanFdMsg.byte(4) = 0x10;
      gTraceCanFdMsg.byte(5) = 0x01;
      gTraceCanFdMsg.byte(6) = 0x00;
      gTraceCanFdMsg.byte(7) = 0x01;
      gTraceCanFdMsg.byte(8) = 0x00;
      gTraceCanFdMsg.byte(9) = 0x00;
      gTraceCanFdMsg.byte(10) = 0x1A;
      gTraceCanFdMsg.byte(11) = 0x03;
      gTraceCanFdMsg.byte(12) = 0x1F;
      gTraceCanFdMsg.byte(13) = 0x00;
      gTraceCanFdMsg.byte(14) = 0x00;
      gTraceCanFdMsg.byte(15) = 0x00;
      gTraceCanFdMsg.byte(16) = 0x00;
      gTraceCanFdMsg.byte(17) = 0x00;
      gTraceCanFdMsg.byte(18) = 0x00;
      gTraceCanFdMsg.byte(19) = 0x00;
      gTraceCanFdMsg.byte(20) = 0x00;
      gTraceCanFdMsg.byte(21) = 0x00;
      gTraceCanFdMsg.byte(22) = 0x00;
      gTraceCanFdMsg.byte(23) = 0x00;
      gTraceCanFdMsg.byte(24) = 0x00;
      gTraceCanFdMsg.byte(25) = 0x00;
      gTraceCanFdMsg.byte(26) = 0x00;
      gTraceCanFdMsg.byte(27) = 0x00;
      gTraceCanFdMsg.byte(28) = 0x00;
      gTraceCanFdMsg.byte(29) = 0x00;
      gTraceCanFdMsg.byte(30) = 0x00;
      gTraceCanFdMsg.byte(31) = 0x00;
      gTraceCanFdMsg.byte(32) = 0x00;
      gTraceCanFdMsg.byte(33) = 0x00;
      gTraceCanFdMsg.byte(34) = 0x00;
      gTraceCanFdMsg.byte(35) = 0x00;
      gTraceCanFdMsg.byte(36) = 0x00;
      gTraceCanFdMsg.byte(37) = 0x00;
      gTraceCanFdMsg.byte(38) = 0x00;
      gTraceCanFdMsg.byte(39) = 0x00;
      gTraceCanFdMsg.byte(40) = 0x00;
      gTraceCanFdMsg.byte(41) = 0x00;
      gTraceCanFdMsg.byte(42) = 0x00;
      gTraceCanFdMsg.byte(43) = 0x00;
      gTraceCanFdMsg.byte(44) = 0x00;
      gTraceCanFdMsg.byte(45) = 0x00;
      gTraceCanFdMsg.byte(46) = 0x00;
      gTraceCanFdMsg.byte(47) = 0x00;
      gTraceCanFdMsg.byte(48) = 0x00;
      gTraceCanFdMsg.byte(49) = 0x00;
      gTraceCanFdMsg.byte(50) = 0x00;
      gTraceCanFdMsg.byte(51) = 0x00;
      gTraceCanFdMsg.byte(52) = 0x00;
      gTraceCanFdMsg.byte(53) = 0x00;
      gTraceCanFdMsg.byte(54) = 0x00;
      gTraceCanFdMsg.byte(55) = 0x00;
      gTraceCanFdMsg.byte(56) = 0x00;
      gTraceCanFdMsg.byte(57) = 0x00;
      gTraceCanFdMsg.byte(58) = 0x00;
      gTraceCanFdMsg.byte(59) = 0x00;
      gTraceCanFdMsg.byte(60) = 0x00;
      gTraceCanFdMsg.byte(61) = 0x00;
      gTraceCanFdMsg.byte(62) = 0x00;
      gTraceCanFdMsg.byte(63) = 0x00;
      break;
    case 81:
      gTraceCurrentId = 0x45A;
      gTraceCurrentLength = 16;
      gTraceCanFdMsg.byte(0) = 0x00;
      gTraceCanFdMsg.byte(1) = 0x00;
      gTraceCanFdMsg.byte(2) = 0x00;
      gTraceCanFdMsg.byte(3) = 0x00;
      gTraceCanFdMsg.byte(4) = 0x00;
      gTraceCanFdMsg.byte(5) = 0x00;
      gTraceCanFdMsg.byte(6) = 0x00;
      gTraceCanFdMsg.byte(7) = 0x00;
      gTraceCanFdMsg.byte(8) = 0x00;
      gTraceCanFdMsg.byte(9) = 0x00;
      gTraceCanFdMsg.byte(10) = 0x00;
      gTraceCanFdMsg.byte(11) = 0x00;
      gTraceCanFdMsg.byte(12) = 0x00;
      gTraceCanFdMsg.byte(13) = 0x00;
      gTraceCanFdMsg.byte(14) = 0x00;
      gTraceCanFdMsg.byte(15) = 0x00;
      break;
    case 82:
      gTraceCurrentId = 0x45B;
      gTraceCurrentLength = 8;
      gTraceCanFdMsg.byte(0) = 0xDF;
      gTraceCanFdMsg.byte(1) = 0x06;
      gTraceCanFdMsg.byte(2) = 0x49;
      gTraceCanFdMsg.byte(3) = 0x14;
      gTraceCanFdMsg.byte(4) = 0x12;
      gTraceCanFdMsg.byte(5) = 0x25;
      gTraceCanFdMsg.byte(6) = 0x98;
      gTraceCanFdMsg.byte(7) = 0x4B;
      break;
    case 83:
      gTraceCurrentId = 0x45E;
      gTraceCurrentLength = 8;
      gTraceCanFdMsg.byte(0) = 0x00;
      gTraceCanFdMsg.byte(1) = 0x00;
      gTraceCanFdMsg.byte(2) = 0x00;
      gTraceCanFdMsg.byte(3) = 0x00;
      gTraceCanFdMsg.byte(4) = 0x00;
      gTraceCanFdMsg.byte(5) = 0x00;
      gTraceCanFdMsg.byte(6) = 0x00;
      gTraceCanFdMsg.byte(7) = 0x00;
      break;
    case 84:
      gTraceCurrentId = 0x460;
      gTraceCurrentLength = 8;
      gTraceCanFdMsg.byte(0) = 0x00;
      gTraceCanFdMsg.byte(1) = 0x00;
      gTraceCanFdMsg.byte(2) = 0x00;
      gTraceCanFdMsg.byte(3) = 0x00;
      gTraceCanFdMsg.byte(4) = 0x00;
      gTraceCanFdMsg.byte(5) = 0x00;
      gTraceCanFdMsg.byte(6) = 0x00;
      gTraceCanFdMsg.byte(7) = 0x00;
      break;
    case 85:
      gTraceCurrentId = 0x467;
      gTraceCurrentLength = 24;
      gTraceCanFdMsg.byte(0) = 0x00;
      gTraceCanFdMsg.byte(1) = 0x00;
      gTraceCanFdMsg.byte(2) = 0x0D;
      gTraceCanFdMsg.byte(3) = 0x80;
      gTraceCanFdMsg.byte(4) = 0x00;
      gTraceCanFdMsg.byte(5) = 0x25;
      gTraceCanFdMsg.byte(6) = 0x00;
      gTraceCanFdMsg.byte(7) = 0x00;
      gTraceCanFdMsg.byte(8) = 0x74;
      gTraceCanFdMsg.byte(9) = 0x05;
      gTraceCanFdMsg.byte(10) = 0x05;
      gTraceCanFdMsg.byte(11) = 0x80;
      gTraceCanFdMsg.byte(12) = 0x11;
      gTraceCanFdMsg.byte(13) = 0x41;
      gTraceCanFdMsg.byte(14) = 0x10;
      gTraceCanFdMsg.byte(15) = 0x40;
      gTraceCanFdMsg.byte(16) = 0x00;
      gTraceCanFdMsg.byte(17) = 0x00;
      gTraceCanFdMsg.byte(18) = 0x50;
      gTraceCanFdMsg.byte(19) = 0x00;
      gTraceCanFdMsg.byte(20) = 0x00;
      gTraceCanFdMsg.byte(21) = 0x00;
      gTraceCanFdMsg.byte(22) = 0x00;
      gTraceCanFdMsg.byte(23) = 0x00;
      break;
    case 86:
      gTraceCurrentId = 0x477;
      gTraceCurrentLength = 8;
      gTraceCanFdMsg.byte(0) = 0x81;
      gTraceCanFdMsg.byte(1) = 0x05;
      gTraceCanFdMsg.byte(2) = 0x52;
      gTraceCanFdMsg.byte(3) = 0x20;
      gTraceCanFdMsg.byte(4) = 0x00;
      gTraceCanFdMsg.byte(5) = 0x01;
      gTraceCanFdMsg.byte(6) = 0x00;
      gTraceCanFdMsg.byte(7) = 0x00;
      break;
    case 87:
      gTraceCurrentId = 0x478;
      gTraceCurrentLength = 8;
      gTraceCanFdMsg.byte(0) = 0x00;
      gTraceCanFdMsg.byte(1) = 0x00;
      gTraceCanFdMsg.byte(2) = 0xC6;
      gTraceCanFdMsg.byte(3) = 0x40;
      gTraceCanFdMsg.byte(4) = 0x00;
      gTraceCanFdMsg.byte(5) = 0x00;
      gTraceCanFdMsg.byte(6) = 0x00;
      gTraceCanFdMsg.byte(7) = 0x00;
      break;
    case 88:
      gTraceCurrentId = 0x47B;
      gTraceCurrentLength = 8;
      gTraceCanFdMsg.byte(0) = 0xF5;
      gTraceCanFdMsg.byte(1) = 0x05;
      gTraceCanFdMsg.byte(2) = 0x07;
      gTraceCanFdMsg.byte(3) = 0xC9;
      gTraceCanFdMsg.byte(4) = 0x46;
      gTraceCanFdMsg.byte(5) = 0x52;
      gTraceCanFdMsg.byte(6) = 0x01;
      gTraceCanFdMsg.byte(7) = 0x00;
      break;
    case 89:
      gTraceCurrentId = 0x483;
      gTraceCurrentLength = 16;
      gTraceCanFdMsg.byte(0) = 0x00;
      gTraceCanFdMsg.byte(1) = 0x00;
      gTraceCanFdMsg.byte(2) = 0x98;
      gTraceCanFdMsg.byte(3) = 0x99;
      gTraceCanFdMsg.byte(4) = 0x49;
      gTraceCanFdMsg.byte(5) = 0x64;
      gTraceCanFdMsg.byte(6) = 0x14;
      gTraceCanFdMsg.byte(7) = 0x00;
      gTraceCanFdMsg.byte(8) = 0x00;
      gTraceCanFdMsg.byte(9) = 0x00;
      gTraceCanFdMsg.byte(10) = 0x5D;
      gTraceCanFdMsg.byte(11) = 0xC5;
      gTraceCanFdMsg.byte(12) = 0xDC;
      gTraceCanFdMsg.byte(13) = 0x5D;
      gTraceCanFdMsg.byte(14) = 0xC5;
      gTraceCanFdMsg.byte(15) = 0xDC;
      break;
    case 90:
      gTraceCurrentId = 0x486;
      gTraceCurrentLength = 8;
      gTraceCanFdMsg.byte(0) = 0x00;
      gTraceCanFdMsg.byte(1) = 0x00;
      gTraceCanFdMsg.byte(2) = 0x7F;
      gTraceCanFdMsg.byte(3) = 0xC0;
      gTraceCanFdMsg.byte(4) = 0x80;
      gTraceCanFdMsg.byte(5) = 0x00;
      gTraceCanFdMsg.byte(6) = 0x7F;
      gTraceCanFdMsg.byte(7) = 0xE0;
      break;
    case 91:
      gTraceCurrentId = 0x489;
      gTraceCurrentLength = 8;
      gTraceCanFdMsg.byte(0) = 0x00;
      gTraceCanFdMsg.byte(1) = 0x00;
      gTraceCanFdMsg.byte(2) = 0x49;
      gTraceCanFdMsg.byte(3) = 0x00;
      gTraceCanFdMsg.byte(4) = 0x00;
      gTraceCanFdMsg.byte(5) = 0x00;
      gTraceCanFdMsg.byte(6) = 0x00;
      gTraceCanFdMsg.byte(7) = 0x00;
      break;
    case 92:
      gTraceCurrentId = 0x48A;
      gTraceCurrentLength = 8;
      gTraceCanFdMsg.byte(0) = 0x2A;
      gTraceCanFdMsg.byte(1) = 0x13;
      gTraceCanFdMsg.byte(2) = 0x00;
      gTraceCanFdMsg.byte(3) = 0x00;
      gTraceCanFdMsg.byte(4) = 0x0C;
      gTraceCanFdMsg.byte(5) = 0x7A;
      gTraceCanFdMsg.byte(6) = 0x12;
      gTraceCanFdMsg.byte(7) = 0x08;
      break;
    case 93:
      gTraceCurrentId = 0x48B;
      gTraceCurrentLength = 8;
      gTraceCanFdMsg.byte(0) = 0x56;
      gTraceCanFdMsg.byte(1) = 0x06;
      gTraceCanFdMsg.byte(2) = 0x02;
      gTraceCanFdMsg.byte(3) = 0x7F;
      gTraceCanFdMsg.byte(4) = 0xFF;
      gTraceCanFdMsg.byte(5) = 0x57;
      gTraceCanFdMsg.byte(6) = 0x82;
      gTraceCanFdMsg.byte(7) = 0x47;
      break;
    case 94:
      gTraceCurrentId = 0x48E;
      gTraceCurrentLength = 8;
      gTraceCanFdMsg.byte(0) = 0x00;
      gTraceCanFdMsg.byte(1) = 0x00;
      gTraceCanFdMsg.byte(2) = 0x00;
      gTraceCanFdMsg.byte(3) = 0x00;
      gTraceCanFdMsg.byte(4) = 0x00;
      gTraceCanFdMsg.byte(5) = 0x00;
      gTraceCanFdMsg.byte(6) = 0x00;
      gTraceCanFdMsg.byte(7) = 0x00;
      break;
    case 95:
      gTraceCurrentId = 0x494;
      gTraceCurrentLength = 8;
      gTraceCanFdMsg.byte(0) = 0x00;
      gTraceCanFdMsg.byte(1) = 0x00;
      gTraceCanFdMsg.byte(2) = 0x9A;
      gTraceCanFdMsg.byte(3) = 0x8E;
      gTraceCanFdMsg.byte(4) = 0x8D;
      gTraceCanFdMsg.byte(5) = 0x02;
      gTraceCanFdMsg.byte(6) = 0x82;
      gTraceCanFdMsg.byte(7) = 0x51;
      break;
    case 96:
      gTraceCurrentId = 0x49C;
      gTraceCurrentLength = 8;
      gTraceCanFdMsg.byte(0) = 0x7A;
      gTraceCanFdMsg.byte(1) = 0x07;
      gTraceCanFdMsg.byte(2) = 0x01;
      gTraceCanFdMsg.byte(3) = 0x00;
      gTraceCanFdMsg.byte(4) = 0x01;
      gTraceCanFdMsg.byte(5) = 0x00;
      gTraceCanFdMsg.byte(6) = 0x00;
      gTraceCanFdMsg.byte(7) = 0x00;
      break;
    case 97:
      gTraceCurrentId = 0x49D;
      gTraceCurrentLength = 8;
      gTraceCanFdMsg.byte(0) = 0x3D;
      gTraceCanFdMsg.byte(1) = 0x0E;
      gTraceCanFdMsg.byte(2) = 0x01;
      gTraceCanFdMsg.byte(3) = 0x00;
      gTraceCanFdMsg.byte(4) = 0x00;
      gTraceCanFdMsg.byte(5) = 0x70;
      gTraceCanFdMsg.byte(6) = 0x08;
      gTraceCanFdMsg.byte(7) = 0x00;
      break;
    case 98:
      gTraceCurrentId = 0x49E;
      gTraceCurrentLength = 48;
      gTraceCanFdMsg.byte(0) = 0x8C;
      gTraceCanFdMsg.byte(1) = 0x05;
      gTraceCanFdMsg.byte(2) = 0x00;
      gTraceCanFdMsg.byte(3) = 0x00;
      gTraceCanFdMsg.byte(4) = 0x1B;
      gTraceCanFdMsg.byte(5) = 0x01;
      gTraceCanFdMsg.byte(6) = 0x63;
      gTraceCanFdMsg.byte(7) = 0x00;
      gTraceCanFdMsg.byte(8) = 0x00;
      gTraceCanFdMsg.byte(9) = 0x00;
      gTraceCanFdMsg.byte(10) = 0x00;
      gTraceCanFdMsg.byte(11) = 0x4E;
      gTraceCanFdMsg.byte(12) = 0x46;
      gTraceCanFdMsg.byte(13) = 0x42;
      gTraceCanFdMsg.byte(14) = 0x09;
      gTraceCanFdMsg.byte(15) = 0x00;
      gTraceCanFdMsg.byte(16) = 0x00;
      gTraceCanFdMsg.byte(17) = 0x00;
      gTraceCanFdMsg.byte(18) = 0x00;
      gTraceCanFdMsg.byte(19) = 0x00;
      gTraceCanFdMsg.byte(20) = 0x00;
      gTraceCanFdMsg.byte(21) = 0x00;
      gTraceCanFdMsg.byte(22) = 0x00;
      gTraceCanFdMsg.byte(23) = 0x00;
      gTraceCanFdMsg.byte(24) = 0xC6;
      gTraceCanFdMsg.byte(25) = 0x05;
      gTraceCanFdMsg.byte(26) = 0x00;
      gTraceCanFdMsg.byte(27) = 0x00;
      gTraceCanFdMsg.byte(28) = 0x00;
      gTraceCanFdMsg.byte(29) = 0x00;
      gTraceCanFdMsg.byte(30) = 0x00;
      gTraceCanFdMsg.byte(31) = 0x08;
      gTraceCanFdMsg.byte(32) = 0x00;
      gTraceCanFdMsg.byte(33) = 0x00;
      gTraceCanFdMsg.byte(34) = 0x95;
      gTraceCanFdMsg.byte(35) = 0xC0;
      gTraceCanFdMsg.byte(36) = 0x00;
      gTraceCanFdMsg.byte(37) = 0x00;
      gTraceCanFdMsg.byte(38) = 0x16;
      gTraceCanFdMsg.byte(39) = 0x00;
      gTraceCanFdMsg.byte(40) = 0x00;
      gTraceCanFdMsg.byte(41) = 0x00;
      gTraceCanFdMsg.byte(42) = 0x00;
      gTraceCanFdMsg.byte(43) = 0x00;
      gTraceCanFdMsg.byte(44) = 0x00;
      gTraceCanFdMsg.byte(45) = 0x00;
      gTraceCanFdMsg.byte(46) = 0x00;
      gTraceCanFdMsg.byte(47) = 0x00;
      break;
    case 99:
      gTraceCurrentId = 0x4A0;
      gTraceCurrentLength = 64;
      gTraceCanFdMsg.byte(0) = 0x00;
      gTraceCanFdMsg.byte(1) = 0x00;
      gTraceCanFdMsg.byte(2) = 0x8E;
      gTraceCanFdMsg.byte(3) = 0x55;
      gTraceCanFdMsg.byte(4) = 0x93;
      gTraceCanFdMsg.byte(5) = 0x00;
      gTraceCanFdMsg.byte(6) = 0x00;
      gTraceCanFdMsg.byte(7) = 0x00;
      gTraceCanFdMsg.byte(8) = 0x37;
      gTraceCanFdMsg.byte(9) = 0x00;
      gTraceCanFdMsg.byte(10) = 0x82;
      gTraceCanFdMsg.byte(11) = 0x3C;
      gTraceCanFdMsg.byte(12) = 0x00;
      gTraceCanFdMsg.byte(13) = 0x00;
      gTraceCanFdMsg.byte(14) = 0x00;
      gTraceCanFdMsg.byte(15) = 0x00;
      gTraceCanFdMsg.byte(16) = 0x00;
      gTraceCanFdMsg.byte(17) = 0x00;
      gTraceCanFdMsg.byte(18) = 0x0B;
      gTraceCanFdMsg.byte(19) = 0x72;
      gTraceCanFdMsg.byte(20) = 0x01;
      gTraceCanFdMsg.byte(21) = 0xF7;
      gTraceCanFdMsg.byte(22) = 0x00;
      gTraceCanFdMsg.byte(23) = 0x3C;
      gTraceCanFdMsg.byte(24) = 0x00;
      gTraceCanFdMsg.byte(25) = 0x00;
      gTraceCanFdMsg.byte(26) = 0x00;
      gTraceCanFdMsg.byte(27) = 0x59;
      gTraceCanFdMsg.byte(28) = 0x0F;
      gTraceCanFdMsg.byte(29) = 0x0A;
      gTraceCanFdMsg.byte(30) = 0x04;
      gTraceCanFdMsg.byte(31) = 0x4C;
      gTraceCanFdMsg.byte(32) = 0x00;
      gTraceCanFdMsg.byte(33) = 0x00;
      gTraceCanFdMsg.byte(34) = 0x00;
      gTraceCanFdMsg.byte(35) = 0x00;
      gTraceCanFdMsg.byte(36) = 0x45;
      gTraceCanFdMsg.byte(37) = 0x07;
      gTraceCanFdMsg.byte(38) = 0x00;
      gTraceCanFdMsg.byte(39) = 0x00;
      gTraceCanFdMsg.byte(40) = 0x00;
      gTraceCanFdMsg.byte(41) = 0x00;
      gTraceCanFdMsg.byte(42) = 0x00;
      gTraceCanFdMsg.byte(43) = 0x00;
      gTraceCanFdMsg.byte(44) = 0x00;
      gTraceCanFdMsg.byte(45) = 0x00;
      gTraceCanFdMsg.byte(46) = 0x00;
      gTraceCanFdMsg.byte(47) = 0x00;
      gTraceCanFdMsg.byte(48) = 0x00;
      gTraceCanFdMsg.byte(49) = 0x00;
      gTraceCanFdMsg.byte(50) = 0x04;
      gTraceCanFdMsg.byte(51) = 0x00;
      gTraceCanFdMsg.byte(52) = 0x00;
      gTraceCanFdMsg.byte(53) = 0x00;
      gTraceCanFdMsg.byte(54) = 0x00;
      gTraceCanFdMsg.byte(55) = 0x00;
      gTraceCanFdMsg.byte(56) = 0x00;
      gTraceCanFdMsg.byte(57) = 0x00;
      gTraceCanFdMsg.byte(58) = 0x00;
      gTraceCanFdMsg.byte(59) = 0x00;
      gTraceCanFdMsg.byte(60) = 0x00;
      gTraceCanFdMsg.byte(61) = 0x00;
      gTraceCanFdMsg.byte(62) = 0x00;
      gTraceCanFdMsg.byte(63) = 0x00;
      break;
    case 100:
      gTraceCurrentId = 0x4A8;
      gTraceCurrentLength = 32;
      gTraceCanFdMsg.byte(0) = 0x00;
      gTraceCanFdMsg.byte(1) = 0x00;
      gTraceCanFdMsg.byte(2) = 0x00;
      gTraceCanFdMsg.byte(3) = 0x00;
      gTraceCanFdMsg.byte(4) = 0x00;
      gTraceCanFdMsg.byte(5) = 0x00;
      gTraceCanFdMsg.byte(6) = 0x00;
      gTraceCanFdMsg.byte(7) = 0x00;
      gTraceCanFdMsg.byte(8) = 0x00;
      gTraceCanFdMsg.byte(9) = 0x00;
      gTraceCanFdMsg.byte(10) = 0x00;
      gTraceCanFdMsg.byte(11) = 0x00;
      gTraceCanFdMsg.byte(12) = 0x00;
      gTraceCanFdMsg.byte(13) = 0x00;
      gTraceCanFdMsg.byte(14) = 0x00;
      gTraceCanFdMsg.byte(15) = 0x00;
      gTraceCanFdMsg.byte(16) = 0x00;
      gTraceCanFdMsg.byte(17) = 0x00;
      gTraceCanFdMsg.byte(18) = 0x00;
      gTraceCanFdMsg.byte(19) = 0x00;
      gTraceCanFdMsg.byte(20) = 0x00;
      gTraceCanFdMsg.byte(21) = 0x00;
      gTraceCanFdMsg.byte(22) = 0x00;
      gTraceCanFdMsg.byte(23) = 0x00;
      gTraceCanFdMsg.byte(24) = 0xE2;
      gTraceCanFdMsg.byte(25) = 0x06;
      gTraceCanFdMsg.byte(26) = 0x00;
      gTraceCanFdMsg.byte(27) = 0x00;
      gTraceCanFdMsg.byte(28) = 0x00;
      gTraceCanFdMsg.byte(29) = 0x00;
      gTraceCanFdMsg.byte(30) = 0x00;
      gTraceCanFdMsg.byte(31) = 0x00;
      break;
    case 101:
      gTraceCurrentId = 0x4A9;
      gTraceCurrentLength = 8;
      gTraceCanFdMsg.byte(0) = 0xA7;
      gTraceCanFdMsg.byte(1) = 0x04;
      gTraceCanFdMsg.byte(2) = 0x00;
      gTraceCanFdMsg.byte(3) = 0x24;
      gTraceCanFdMsg.byte(4) = 0x10;
      gTraceCanFdMsg.byte(5) = 0x00;
      gTraceCanFdMsg.byte(6) = 0x00;
      gTraceCanFdMsg.byte(7) = 0x00;
      break;
    case 102:
      gTraceCurrentId = 0x4AC;
      gTraceCurrentLength = 16;
      gTraceCanFdMsg.byte(0) = 0x00;
      gTraceCanFdMsg.byte(1) = 0x00;
      gTraceCanFdMsg.byte(2) = 0x00;
      gTraceCanFdMsg.byte(3) = 0x10;
      gTraceCanFdMsg.byte(4) = 0xC0;
      gTraceCanFdMsg.byte(5) = 0x28;
      gTraceCanFdMsg.byte(6) = 0x00;
      gTraceCanFdMsg.byte(7) = 0x00;
      gTraceCanFdMsg.byte(8) = 0x00;
      gTraceCanFdMsg.byte(9) = 0x00;
      gTraceCanFdMsg.byte(10) = 0x00;
      gTraceCanFdMsg.byte(11) = 0x00;
      gTraceCanFdMsg.byte(12) = 0x00;
      gTraceCanFdMsg.byte(13) = 0x00;
      gTraceCanFdMsg.byte(14) = 0x00;
      gTraceCanFdMsg.byte(15) = 0x00;
      break;
    case 103:
      gTraceCurrentId = 0x4AD;
      gTraceCurrentLength = 8;
      gTraceCanFdMsg.byte(0) = 0x00;
      gTraceCanFdMsg.byte(1) = 0x00;
      gTraceCanFdMsg.byte(2) = 0x00;
      gTraceCanFdMsg.byte(3) = 0x06;
      gTraceCanFdMsg.byte(4) = 0x40;
      gTraceCanFdMsg.byte(5) = 0xCD;
      gTraceCanFdMsg.byte(6) = 0x00;
      gTraceCanFdMsg.byte(7) = 0x00;
      break;
    case 104:
      gTraceCurrentId = 0x4B2;
      gTraceCurrentLength = 8;
      gTraceCanFdMsg.byte(0) = 0x00;
      gTraceCanFdMsg.byte(1) = 0x00;
      gTraceCanFdMsg.byte(2) = 0x68;
      gTraceCanFdMsg.byte(3) = 0x00;
      gTraceCanFdMsg.byte(4) = 0x00;
      gTraceCanFdMsg.byte(5) = 0x00;
      gTraceCanFdMsg.byte(6) = 0x00;
      gTraceCanFdMsg.byte(7) = 0x00;
      break;
    case 105:
      gTraceCurrentId = 0x4B3;
      gTraceCurrentLength = 24;
      gTraceCanFdMsg.byte(0) = 0x00;
      gTraceCanFdMsg.byte(1) = 0x00;
      gTraceCanFdMsg.byte(2) = 0x7F;
      gTraceCanFdMsg.byte(3) = 0x7F;
      gTraceCanFdMsg.byte(4) = 0x7F;
      gTraceCanFdMsg.byte(5) = 0x7F;
      gTraceCanFdMsg.byte(6) = 0x7F;
      gTraceCanFdMsg.byte(7) = 0x7F;
      gTraceCanFdMsg.byte(8) = 0x00;
      gTraceCanFdMsg.byte(9) = 0x00;
      gTraceCanFdMsg.byte(10) = 0x7F;
      gTraceCanFdMsg.byte(11) = 0x7F;
      gTraceCanFdMsg.byte(12) = 0x7F;
      gTraceCanFdMsg.byte(13) = 0x7F;
      gTraceCanFdMsg.byte(14) = 0x7F;
      gTraceCanFdMsg.byte(15) = 0x7F;
      gTraceCanFdMsg.byte(16) = 0x00;
      gTraceCanFdMsg.byte(17) = 0x00;
      gTraceCanFdMsg.byte(18) = 0x00;
      gTraceCanFdMsg.byte(19) = 0x00;
      gTraceCanFdMsg.byte(20) = 0x00;
      gTraceCanFdMsg.byte(21) = 0x00;
      gTraceCanFdMsg.byte(22) = 0x00;
      gTraceCanFdMsg.byte(23) = 0x00;
      break;
    case 106:
      gTraceCurrentId = 0x4B4;
      gTraceCurrentLength = 8;
      gTraceCanFdMsg.byte(0) = 0x13;
      gTraceCanFdMsg.byte(1) = 0x05;
      gTraceCanFdMsg.byte(2) = 0x7D;
      gTraceCanFdMsg.byte(3) = 0x00;
      gTraceCanFdMsg.byte(4) = 0x00;
      gTraceCanFdMsg.byte(5) = 0x00;
      gTraceCanFdMsg.byte(6) = 0x28;
      gTraceCanFdMsg.byte(7) = 0x10;
      break;
    case 107:
      gTraceCurrentId = 0x4B7;
      gTraceCurrentLength = 64;
      gTraceCanFdMsg.byte(0) = 0x00;
      gTraceCanFdMsg.byte(1) = 0x00;
      gTraceCanFdMsg.byte(2) = 0x00;
      gTraceCanFdMsg.byte(3) = 0x00;
      gTraceCanFdMsg.byte(4) = 0x4A;
      gTraceCanFdMsg.byte(5) = 0x00;
      gTraceCanFdMsg.byte(6) = 0x00;
      gTraceCanFdMsg.byte(7) = 0x00;
      gTraceCanFdMsg.byte(8) = 0x00;
      gTraceCanFdMsg.byte(9) = 0x00;
      gTraceCanFdMsg.byte(10) = 0xE6;
      gTraceCanFdMsg.byte(11) = 0x00;
      gTraceCanFdMsg.byte(12) = 0x63;
      gTraceCanFdMsg.byte(13) = 0x77;
      gTraceCanFdMsg.byte(14) = 0x64;
      gTraceCanFdMsg.byte(15) = 0x78;
      gTraceCanFdMsg.byte(16) = 0x00;
      gTraceCanFdMsg.byte(17) = 0x00;
      gTraceCanFdMsg.byte(18) = 0x82;
      gTraceCanFdMsg.byte(19) = 0x03;
      gTraceCanFdMsg.byte(20) = 0x82;
      gTraceCanFdMsg.byte(21) = 0x00;
      gTraceCanFdMsg.byte(22) = 0x40;
      gTraceCanFdMsg.byte(23) = 0x00;
      gTraceCanFdMsg.byte(24) = 0x00;
      gTraceCanFdMsg.byte(25) = 0x00;
      gTraceCanFdMsg.byte(26) = 0x00;
      gTraceCanFdMsg.byte(27) = 0x00;
      gTraceCanFdMsg.byte(28) = 0x00;
      gTraceCanFdMsg.byte(29) = 0x57;
      gTraceCanFdMsg.byte(30) = 0x53;
      gTraceCanFdMsg.byte(31) = 0x10;
      gTraceCanFdMsg.byte(32) = 0x00;
      gTraceCanFdMsg.byte(33) = 0x00;
      gTraceCanFdMsg.byte(34) = 0x13;
      gTraceCanFdMsg.byte(35) = 0x80;
      gTraceCanFdMsg.byte(36) = 0x00;
      gTraceCanFdMsg.byte(37) = 0x00;
      gTraceCanFdMsg.byte(38) = 0x5C;
      gTraceCanFdMsg.byte(39) = 0x57;
      gTraceCanFdMsg.byte(40) = 0x00;
      gTraceCanFdMsg.byte(41) = 0x00;
      gTraceCanFdMsg.byte(42) = 0x00;
      gTraceCanFdMsg.byte(43) = 0x00;
      gTraceCanFdMsg.byte(44) = 0x00;
      gTraceCanFdMsg.byte(45) = 0x0C;
      gTraceCanFdMsg.byte(46) = 0x00;
      gTraceCanFdMsg.byte(47) = 0x00;
      gTraceCanFdMsg.byte(48) = 0x00;
      gTraceCanFdMsg.byte(49) = 0x00;
      gTraceCanFdMsg.byte(50) = 0x00;
      gTraceCanFdMsg.byte(51) = 0x00;
      gTraceCanFdMsg.byte(52) = 0x00;
      gTraceCanFdMsg.byte(53) = 0x00;
      gTraceCanFdMsg.byte(54) = 0x28;
      gTraceCanFdMsg.byte(55) = 0x20;
      gTraceCanFdMsg.byte(56) = 0x00;
      gTraceCanFdMsg.byte(57) = 0x00;
      gTraceCanFdMsg.byte(58) = 0x00;
      gTraceCanFdMsg.byte(59) = 0x00;
      gTraceCanFdMsg.byte(60) = 0x20;
      gTraceCanFdMsg.byte(61) = 0x00;
      gTraceCanFdMsg.byte(62) = 0x00;
      gTraceCanFdMsg.byte(63) = 0x00;
      break;
    case 108:
      gTraceCurrentId = 0x4B9;
      gTraceCurrentLength = 8;
      gTraceCanFdMsg.byte(0) = 0x4B;
      gTraceCanFdMsg.byte(1) = 0x05;
      gTraceCanFdMsg.byte(2) = 0x00;
      gTraceCanFdMsg.byte(3) = 0x00;
      gTraceCanFdMsg.byte(4) = 0x60;
      gTraceCanFdMsg.byte(5) = 0x38;
      gTraceCanFdMsg.byte(6) = 0x00;
      gTraceCanFdMsg.byte(7) = 0x00;
      break;
    case 109:
      gTraceCurrentId = 0x4BC;
      gTraceCurrentLength = 8;
      gTraceCanFdMsg.byte(0) = 0x72;
      gTraceCanFdMsg.byte(1) = 0x05;
      gTraceCanFdMsg.byte(2) = 0x80;
      gTraceCanFdMsg.byte(3) = 0x00;
      gTraceCanFdMsg.byte(4) = 0x80;
      gTraceCanFdMsg.byte(5) = 0x00;
      gTraceCanFdMsg.byte(6) = 0x00;
      gTraceCanFdMsg.byte(7) = 0x00;
      break;
    case 110:
      gTraceCurrentId = 0x4BD;
      gTraceCurrentLength = 8;
      gTraceCanFdMsg.byte(0) = 0x00;
      gTraceCanFdMsg.byte(1) = 0x00;
      gTraceCanFdMsg.byte(2) = 0x00;
      gTraceCanFdMsg.byte(3) = 0x00;
      gTraceCanFdMsg.byte(4) = 0x00;
      gTraceCanFdMsg.byte(5) = 0x00;
      gTraceCanFdMsg.byte(6) = 0x00;
      gTraceCanFdMsg.byte(7) = 0x00;
      break;
    case 111:
      gTraceCurrentId = 0x4C1;
      gTraceCurrentLength = 8;
      gTraceCanFdMsg.byte(0) = 0x7A;
      gTraceCanFdMsg.byte(1) = 0x07;
      gTraceCanFdMsg.byte(2) = 0x76;
      gTraceCanFdMsg.byte(3) = 0x04;
      gTraceCanFdMsg.byte(4) = 0x04;
      gTraceCanFdMsg.byte(5) = 0x23;
      gTraceCanFdMsg.byte(6) = 0x09;
      gTraceCanFdMsg.byte(7) = 0x60;
      break;
    case 112:
      gTraceCurrentId = 0x4C8;
      gTraceCurrentLength = 16;
      gTraceCanFdMsg.byte(0) = 0x00;
      gTraceCanFdMsg.byte(1) = 0x00;
      gTraceCanFdMsg.byte(2) = 0x26;
      gTraceCanFdMsg.byte(3) = 0x0C;
      gTraceCanFdMsg.byte(4) = 0x66;
      gTraceCanFdMsg.byte(5) = 0x22;
      gTraceCanFdMsg.byte(6) = 0x0C;
      gTraceCanFdMsg.byte(7) = 0x63;
      gTraceCanFdMsg.byte(8) = 0x00;
      gTraceCanFdMsg.byte(9) = 0x00;
      gTraceCanFdMsg.byte(10) = 0x30;
      gTraceCanFdMsg.byte(11) = 0x00;
      gTraceCanFdMsg.byte(12) = 0x00;
      gTraceCanFdMsg.byte(13) = 0x00;
      gTraceCanFdMsg.byte(14) = 0x00;
      gTraceCanFdMsg.byte(15) = 0x00;
      break;
    case 113:
      gTraceCurrentId = 0x4CD;
      gTraceCurrentLength = 8;
      gTraceCanFdMsg.byte(0) = 0x00;
      gTraceCanFdMsg.byte(1) = 0x17;
      gTraceCanFdMsg.byte(2) = 0x05;
      gTraceCanFdMsg.byte(3) = 0x01;
      gTraceCanFdMsg.byte(4) = 0x40;
      gTraceCanFdMsg.byte(5) = 0x50;
      gTraceCanFdMsg.byte(6) = 0x10;
      gTraceCanFdMsg.byte(7) = 0x00;
      break;
    case 114:
      gTraceCurrentId = 0x4CE;
      gTraceCurrentLength = 64;
      gTraceCanFdMsg.byte(0) = 0x0C;
      gTraceCanFdMsg.byte(1) = 0x64;
      gTraceCanFdMsg.byte(2) = 0x0C;
      gTraceCanFdMsg.byte(3) = 0x64;
      gTraceCanFdMsg.byte(4) = 0x0C;
      gTraceCanFdMsg.byte(5) = 0x64;
      gTraceCanFdMsg.byte(6) = 0x0C;
      gTraceCanFdMsg.byte(7) = 0x63;
      gTraceCanFdMsg.byte(8) = 0x0C;
      gTraceCanFdMsg.byte(9) = 0x65;
      gTraceCanFdMsg.byte(10) = 0x0C;
      gTraceCanFdMsg.byte(11) = 0x65;
      gTraceCanFdMsg.byte(12) = 0x0C;
      gTraceCanFdMsg.byte(13) = 0x65;
      gTraceCanFdMsg.byte(14) = 0x0C;
      gTraceCanFdMsg.byte(15) = 0x66;
      gTraceCanFdMsg.byte(16) = 0x0C;
      gTraceCanFdMsg.byte(17) = 0x65;
      gTraceCanFdMsg.byte(18) = 0x0C;
      gTraceCanFdMsg.byte(19) = 0x64;
      gTraceCanFdMsg.byte(20) = 0x0C;
      gTraceCanFdMsg.byte(21) = 0x64;
      gTraceCanFdMsg.byte(22) = 0x0C;
      gTraceCanFdMsg.byte(23) = 0x64;
      gTraceCanFdMsg.byte(24) = 0x0C;
      gTraceCanFdMsg.byte(25) = 0x64;
      gTraceCanFdMsg.byte(26) = 0x0C;
      gTraceCanFdMsg.byte(27) = 0x64;
      gTraceCanFdMsg.byte(28) = 0x0C;
      gTraceCanFdMsg.byte(29) = 0x64;
      gTraceCanFdMsg.byte(30) = 0x0C;
      gTraceCanFdMsg.byte(31) = 0x64;
      gTraceCanFdMsg.byte(32) = 0x0C;
      gTraceCanFdMsg.byte(33) = 0x63;
      gTraceCanFdMsg.byte(34) = 0x0C;
      gTraceCanFdMsg.byte(35) = 0x63;
      gTraceCanFdMsg.byte(36) = 0x0C;
      gTraceCanFdMsg.byte(37) = 0x64;
      gTraceCanFdMsg.byte(38) = 0x0C;
      gTraceCanFdMsg.byte(39) = 0x66;
      gTraceCanFdMsg.byte(40) = 0x0C;
      gTraceCanFdMsg.byte(41) = 0x65;
      gTraceCanFdMsg.byte(42) = 0x0C;
      gTraceCanFdMsg.byte(43) = 0x65;
      gTraceCanFdMsg.byte(44) = 0x0C;
      gTraceCanFdMsg.byte(45) = 0x65;
      gTraceCanFdMsg.byte(46) = 0x0C;
      gTraceCanFdMsg.byte(47) = 0x65;
      gTraceCanFdMsg.byte(48) = 0x0C;
      gTraceCanFdMsg.byte(49) = 0x64;
      gTraceCanFdMsg.byte(50) = 0x0C;
      gTraceCanFdMsg.byte(51) = 0x65;
      gTraceCanFdMsg.byte(52) = 0x0C;
      gTraceCanFdMsg.byte(53) = 0x64;
      gTraceCanFdMsg.byte(54) = 0x0C;
      gTraceCanFdMsg.byte(55) = 0x65;
      gTraceCanFdMsg.byte(56) = 0x0C;
      gTraceCanFdMsg.byte(57) = 0x65;
      gTraceCanFdMsg.byte(58) = 0x0C;
      gTraceCanFdMsg.byte(59) = 0x65;
      gTraceCanFdMsg.byte(60) = 0x00;
      gTraceCanFdMsg.byte(61) = 0x1F;
      gTraceCanFdMsg.byte(62) = 0x1E;
      gTraceCanFdMsg.byte(63) = 0xFF;
      break;
    case 115:
      gTraceCurrentId = 0x4D5;
      gTraceCurrentLength = 8;
      gTraceCanFdMsg.byte(0) = 0xCD;
      gTraceCanFdMsg.byte(1) = 0x02;
      gTraceCanFdMsg.byte(2) = 0x00;
      gTraceCanFdMsg.byte(3) = 0x00;
      gTraceCanFdMsg.byte(4) = 0x00;
      gTraceCanFdMsg.byte(5) = 0x00;
      gTraceCanFdMsg.byte(6) = 0x00;
      gTraceCanFdMsg.byte(7) = 0x00;
      break;
    case 116:
      gTraceCurrentId = 0x4D7;
      gTraceCurrentLength = 8;
      gTraceCanFdMsg.byte(0) = 0x00;
      gTraceCanFdMsg.byte(1) = 0x0F;
      gTraceCanFdMsg.byte(2) = 0x00;
      gTraceCanFdMsg.byte(3) = 0x00;
      gTraceCanFdMsg.byte(4) = 0x00;
      gTraceCanFdMsg.byte(5) = 0x00;
      gTraceCanFdMsg.byte(6) = 0x00;
      gTraceCanFdMsg.byte(7) = 0x00;
      break;
    case 117:
      gTraceCurrentId = 0x4D9;
      gTraceCurrentLength = 8;
      gTraceCanFdMsg.byte(0) = 0x00;
      gTraceCanFdMsg.byte(1) = 0x00;
      gTraceCanFdMsg.byte(2) = 0x00;
      gTraceCanFdMsg.byte(3) = 0x00;
      gTraceCanFdMsg.byte(4) = 0xC8;
      gTraceCanFdMsg.byte(5) = 0x00;
      gTraceCanFdMsg.byte(6) = 0x00;
      gTraceCanFdMsg.byte(7) = 0x00;
      break;
    case 118:
      gTraceCurrentId = 0x4E4;
      gTraceCurrentLength = 8;
      gTraceCanFdMsg.byte(0) = 0x00;
      gTraceCanFdMsg.byte(1) = 0x00;
      gTraceCanFdMsg.byte(2) = 0x00;
      gTraceCanFdMsg.byte(3) = 0x01;
      gTraceCanFdMsg.byte(4) = 0x68;
      gTraceCanFdMsg.byte(5) = 0x00;
      gTraceCanFdMsg.byte(6) = 0x00;
      gTraceCanFdMsg.byte(7) = 0x20;
      break;
    case 119:
      gTraceCurrentId = 0x4FB;
      gTraceCurrentLength = 64;
      gTraceCanFdMsg.byte(0) = 0x00;
      gTraceCanFdMsg.byte(1) = 0x00;
      gTraceCanFdMsg.byte(2) = 0x40;
      gTraceCanFdMsg.byte(3) = 0x1C;
      gTraceCanFdMsg.byte(4) = 0x00;
      gTraceCanFdMsg.byte(5) = 0x00;
      gTraceCanFdMsg.byte(6) = 0x00;
      gTraceCanFdMsg.byte(7) = 0x00;
      gTraceCanFdMsg.byte(8) = 0x00;
      gTraceCanFdMsg.byte(9) = 0x00;
      gTraceCanFdMsg.byte(10) = 0x00;
      gTraceCanFdMsg.byte(11) = 0x00;
      gTraceCanFdMsg.byte(12) = 0x00;
      gTraceCanFdMsg.byte(13) = 0x00;
      gTraceCanFdMsg.byte(14) = 0x00;
      gTraceCanFdMsg.byte(15) = 0x00;
      gTraceCanFdMsg.byte(16) = 0x00;
      gTraceCanFdMsg.byte(17) = 0x00;
      gTraceCanFdMsg.byte(18) = 0x00;
      gTraceCanFdMsg.byte(19) = 0x00;
      gTraceCanFdMsg.byte(20) = 0x0F;
      gTraceCanFdMsg.byte(21) = 0xA0;
      gTraceCanFdMsg.byte(22) = 0x0F;
      gTraceCanFdMsg.byte(23) = 0xA0;
      gTraceCanFdMsg.byte(24) = 0x00;
      gTraceCanFdMsg.byte(25) = 0x00;
      gTraceCanFdMsg.byte(26) = 0x00;
      gTraceCanFdMsg.byte(27) = 0x00;
      gTraceCanFdMsg.byte(28) = 0x0F;
      gTraceCanFdMsg.byte(29) = 0xA0;
      gTraceCanFdMsg.byte(30) = 0x00;
      gTraceCanFdMsg.byte(31) = 0x00;
      gTraceCanFdMsg.byte(32) = 0x00;
      gTraceCanFdMsg.byte(33) = 0x00;
      gTraceCanFdMsg.byte(34) = 0x0F;
      gTraceCanFdMsg.byte(35) = 0xA0;
      gTraceCanFdMsg.byte(36) = 0x00;
      gTraceCanFdMsg.byte(37) = 0x00;
      gTraceCanFdMsg.byte(38) = 0x1B;
      gTraceCanFdMsg.byte(39) = 0xDB;
      gTraceCanFdMsg.byte(40) = 0x00;
      gTraceCanFdMsg.byte(41) = 0x00;
      gTraceCanFdMsg.byte(42) = 0x00;
      gTraceCanFdMsg.byte(43) = 0x64;
      gTraceCanFdMsg.byte(44) = 0x00;
      gTraceCanFdMsg.byte(45) = 0x00;
      gTraceCanFdMsg.byte(46) = 0x00;
      gTraceCanFdMsg.byte(47) = 0x00;
      gTraceCanFdMsg.byte(48) = 0x00;
      gTraceCanFdMsg.byte(49) = 0x00;
      gTraceCanFdMsg.byte(50) = 0x00;
      gTraceCanFdMsg.byte(51) = 0x00;
      gTraceCanFdMsg.byte(52) = 0x00;
      gTraceCanFdMsg.byte(53) = 0x00;
      gTraceCanFdMsg.byte(54) = 0x00;
      gTraceCanFdMsg.byte(55) = 0x00;
      gTraceCanFdMsg.byte(56) = 0x00;
      gTraceCanFdMsg.byte(57) = 0x00;
      gTraceCanFdMsg.byte(58) = 0x00;
      gTraceCanFdMsg.byte(59) = 0x00;
      gTraceCanFdMsg.byte(60) = 0x00;
      gTraceCanFdMsg.byte(61) = 0x00;
      gTraceCanFdMsg.byte(62) = 0x00;
      gTraceCanFdMsg.byte(63) = 0x00;
      break;
    case 120:
      gTraceCurrentId = 0x500;
      gTraceCurrentLength = 8;
      gTraceCanFdMsg.byte(0) = 0x00;
      gTraceCanFdMsg.byte(1) = 0x00;
      gTraceCanFdMsg.byte(2) = 0x00;
      gTraceCanFdMsg.byte(3) = 0x00;
      gTraceCanFdMsg.byte(4) = 0x00;
      gTraceCanFdMsg.byte(5) = 0x00;
      gTraceCanFdMsg.byte(6) = 0x00;
      gTraceCanFdMsg.byte(7) = 0x00;
      break;
    case 121:
      gTraceCurrentId = 0x50A;
      gTraceCurrentLength = 8;
      gTraceCanFdMsg.byte(0) = 0x84;
      gTraceCanFdMsg.byte(1) = 0x0D;
      gTraceCanFdMsg.byte(2) = 0x00;
      gTraceCanFdMsg.byte(3) = 0x00;
      gTraceCanFdMsg.byte(4) = 0x00;
      gTraceCanFdMsg.byte(5) = 0x00;
      gTraceCanFdMsg.byte(6) = 0x32;
      gTraceCanFdMsg.byte(7) = 0x4F;
      break;
    case 122:
      gTraceCurrentId = 0x50B;
      gTraceCurrentLength = 8;
      gTraceCanFdMsg.byte(0) = 0xF2;
      gTraceCanFdMsg.byte(1) = 0x0D;
      gTraceCanFdMsg.byte(2) = 0x4E;
      gTraceCanFdMsg.byte(3) = 0x20;
      gTraceCanFdMsg.byte(4) = 0x06;
      gTraceCanFdMsg.byte(5) = 0x44;
      gTraceCanFdMsg.byte(6) = 0x43;
      gTraceCanFdMsg.byte(7) = 0x0D;
      break;
    case 123:
      gTraceCurrentId = 0x50C;
      gTraceCurrentLength = 8;
      gTraceCanFdMsg.byte(0) = 0x00;
      gTraceCanFdMsg.byte(1) = 0x00;
      gTraceCanFdMsg.byte(2) = 0x8A;
      gTraceCanFdMsg.byte(3) = 0x00;
      gTraceCanFdMsg.byte(4) = 0x00;
      gTraceCanFdMsg.byte(5) = 0x80;
      gTraceCanFdMsg.byte(6) = 0x28;
      gTraceCanFdMsg.byte(7) = 0x00;
      break;
    case 124:
      gTraceCurrentId = 0x50F;
      gTraceCurrentLength = 8;
      gTraceCanFdMsg.byte(0) = 0xB1;
      gTraceCanFdMsg.byte(1) = 0x0D;
      gTraceCanFdMsg.byte(2) = 0x00;
      gTraceCanFdMsg.byte(3) = 0x00;
      gTraceCanFdMsg.byte(4) = 0x04;
      gTraceCanFdMsg.byte(5) = 0x00;
      gTraceCanFdMsg.byte(6) = 0x00;
      gTraceCanFdMsg.byte(7) = 0x00;
      break;
    case 125:
      gTraceCurrentId = 0x510;
      gTraceCurrentLength = 8;
      gTraceCanFdMsg.byte(0) = 0x1A;
      gTraceCanFdMsg.byte(1) = 0x70;
      gTraceCanFdMsg.byte(2) = 0x08;
      gTraceCanFdMsg.byte(3) = 0x90;
      gTraceCanFdMsg.byte(4) = 0x34;
      gTraceCanFdMsg.byte(5) = 0x50;
      gTraceCanFdMsg.byte(6) = 0x00;
      gTraceCanFdMsg.byte(7) = 0x00;
      break;
    case 126:
      gTraceCurrentId = 0x513;
      gTraceCurrentLength = 8;
      gTraceCanFdMsg.byte(0) = 0x00;
      gTraceCanFdMsg.byte(1) = 0x0D;
      gTraceCanFdMsg.byte(2) = 0x0D;
      gTraceCanFdMsg.byte(3) = 0x63;
      gTraceCanFdMsg.byte(4) = 0x50;
      gTraceCanFdMsg.byte(5) = 0x46;
      gTraceCanFdMsg.byte(6) = 0x1B;
      gTraceCanFdMsg.byte(7) = 0x50;
      break;
    case 127:
      gTraceCurrentId = 0x514;
      gTraceCurrentLength = 32;
      gTraceCanFdMsg.byte(0) = 0x01;
      gTraceCanFdMsg.byte(1) = 0x41;
      gTraceCanFdMsg.byte(2) = 0x03;
      gTraceCanFdMsg.byte(3) = 0xC0;
      gTraceCanFdMsg.byte(4) = 0x00;
      gTraceCanFdMsg.byte(5) = 0x00;
      gTraceCanFdMsg.byte(6) = 0x00;
      gTraceCanFdMsg.byte(7) = 0x00;
      gTraceCanFdMsg.byte(8) = 0x00;
      gTraceCanFdMsg.byte(9) = 0x00;
      gTraceCanFdMsg.byte(10) = 0x00;
      gTraceCanFdMsg.byte(11) = 0x00;
      gTraceCanFdMsg.byte(12) = 0x00;
      gTraceCanFdMsg.byte(13) = 0x00;
      gTraceCanFdMsg.byte(14) = 0x00;
      gTraceCanFdMsg.byte(15) = 0x00;
      gTraceCanFdMsg.byte(16) = 0x00;
      gTraceCanFdMsg.byte(17) = 0x00;
      gTraceCanFdMsg.byte(18) = 0x00;
      gTraceCanFdMsg.byte(19) = 0x00;
      gTraceCanFdMsg.byte(20) = 0x00;
      gTraceCanFdMsg.byte(21) = 0x00;
      gTraceCanFdMsg.byte(22) = 0x00;
      gTraceCanFdMsg.byte(23) = 0x00;
      gTraceCanFdMsg.byte(24) = 0x00;
      gTraceCanFdMsg.byte(25) = 0x00;
      gTraceCanFdMsg.byte(26) = 0x00;
      gTraceCanFdMsg.byte(27) = 0x00;
      gTraceCanFdMsg.byte(28) = 0x00;
      gTraceCanFdMsg.byte(29) = 0x00;
      gTraceCanFdMsg.byte(30) = 0x00;
      gTraceCanFdMsg.byte(31) = 0x00;
      break;
    case 128:
      gTraceCurrentId = 0x523;
      gTraceCurrentLength = 16;
      gTraceCanFdMsg.byte(0) = 0x00;
      gTraceCanFdMsg.byte(1) = 0x00;
      gTraceCanFdMsg.byte(2) = 0x28;
      gTraceCanFdMsg.byte(3) = 0x23;
      gTraceCanFdMsg.byte(4) = 0x87;
      gTraceCanFdMsg.byte(5) = 0xD0;
      gTraceCanFdMsg.byte(6) = 0x7F;
      gTraceCanFdMsg.byte(7) = 0xFF;
      gTraceCanFdMsg.byte(8) = 0x00;
      gTraceCanFdMsg.byte(9) = 0x00;
      gTraceCanFdMsg.byte(10) = 0x01;
      gTraceCanFdMsg.byte(11) = 0x56;
      gTraceCanFdMsg.byte(12) = 0x03;
      gTraceCanFdMsg.byte(13) = 0xFF;
      gTraceCanFdMsg.byte(14) = 0x00;
      gTraceCanFdMsg.byte(15) = 0x00;
      break;
    case 129:
      gTraceCurrentId = 0x525;
      gTraceCurrentLength = 16;
      gTraceCanFdMsg.byte(0) = 0x00;
      gTraceCanFdMsg.byte(1) = 0x00;
      gTraceCanFdMsg.byte(2) = 0x05;
      gTraceCanFdMsg.byte(3) = 0x78;
      gTraceCanFdMsg.byte(4) = 0x7F;
      gTraceCanFdMsg.byte(5) = 0xFF;
      gTraceCanFdMsg.byte(6) = 0x01;
      gTraceCanFdMsg.byte(7) = 0x56;
      gTraceCanFdMsg.byte(8) = 0x00;
      gTraceCanFdMsg.byte(9) = 0x00;
      gTraceCanFdMsg.byte(10) = 0x7F;
      gTraceCanFdMsg.byte(11) = 0xE0;
      gTraceCanFdMsg.byte(12) = 0x00;
      gTraceCanFdMsg.byte(13) = 0x00;
      gTraceCanFdMsg.byte(14) = 0x00;
      gTraceCanFdMsg.byte(15) = 0x00;
      break;
    case 130:
      gTraceCurrentId = 0x52C;
      gTraceCurrentLength = 8;
      gTraceCanFdMsg.byte(0) = 0x52;
      gTraceCanFdMsg.byte(1) = 0x0A;
      gTraceCanFdMsg.byte(2) = 0x00;
      gTraceCanFdMsg.byte(3) = 0x00;
      gTraceCanFdMsg.byte(4) = 0x00;
      gTraceCanFdMsg.byte(5) = 0x00;
      gTraceCanFdMsg.byte(6) = 0x00;
      gTraceCanFdMsg.byte(7) = 0x00;
      break;
    case 131:
      gTraceCurrentId = 0x531;
      gTraceCurrentLength = 32;
      gTraceCanFdMsg.byte(0) = 0x00;
      gTraceCanFdMsg.byte(1) = 0xC1;
      gTraceCanFdMsg.byte(2) = 0x00;
      gTraceCanFdMsg.byte(3) = 0x00;
      gTraceCanFdMsg.byte(4) = 0x00;
      gTraceCanFdMsg.byte(5) = 0x00;
      gTraceCanFdMsg.byte(6) = 0x00;
      gTraceCanFdMsg.byte(7) = 0x00;
      gTraceCanFdMsg.byte(8) = 0x00;
      gTraceCanFdMsg.byte(9) = 0x00;
      gTraceCanFdMsg.byte(10) = 0x00;
      gTraceCanFdMsg.byte(11) = 0x00;
      gTraceCanFdMsg.byte(12) = 0x00;
      gTraceCanFdMsg.byte(13) = 0x00;
      gTraceCanFdMsg.byte(14) = 0x00;
      gTraceCanFdMsg.byte(15) = 0x00;
      gTraceCanFdMsg.byte(16) = 0x00;
      gTraceCanFdMsg.byte(17) = 0x00;
      gTraceCanFdMsg.byte(18) = 0x00;
      gTraceCanFdMsg.byte(19) = 0x00;
      gTraceCanFdMsg.byte(20) = 0x00;
      gTraceCanFdMsg.byte(21) = 0x00;
      gTraceCanFdMsg.byte(22) = 0x00;
      gTraceCanFdMsg.byte(23) = 0x00;
      gTraceCanFdMsg.byte(24) = 0x00;
      gTraceCanFdMsg.byte(25) = 0x00;
      gTraceCanFdMsg.byte(26) = 0x00;
      gTraceCanFdMsg.byte(27) = 0x00;
      gTraceCanFdMsg.byte(28) = 0x00;
      gTraceCanFdMsg.byte(29) = 0x00;
      gTraceCanFdMsg.byte(30) = 0x00;
      gTraceCanFdMsg.byte(31) = 0x00;
      break;
    case 132:
      gTraceCurrentId = 0x537;
      gTraceCurrentLength = 16;
      gTraceCanFdMsg.byte(0) = 0x00;
      gTraceCanFdMsg.byte(1) = 0x00;
      gTraceCanFdMsg.byte(2) = 0xD0;
      gTraceCanFdMsg.byte(3) = 0x00;
      gTraceCanFdMsg.byte(4) = 0x00;
      gTraceCanFdMsg.byte(5) = 0x00;
      gTraceCanFdMsg.byte(6) = 0x00;
      gTraceCanFdMsg.byte(7) = 0x00;
      gTraceCanFdMsg.byte(8) = 0x00;
      gTraceCanFdMsg.byte(9) = 0x00;
      gTraceCanFdMsg.byte(10) = 0x00;
      gTraceCanFdMsg.byte(11) = 0x00;
      gTraceCanFdMsg.byte(12) = 0x00;
      gTraceCanFdMsg.byte(13) = 0x00;
      gTraceCanFdMsg.byte(14) = 0x00;
      gTraceCanFdMsg.byte(15) = 0x00;
      break;
    case 133:
      gTraceCurrentId = 0x539;
      gTraceCurrentLength = 48;
      gTraceCanFdMsg.byte(0) = 0x00;
      gTraceCanFdMsg.byte(1) = 0x00;
      gTraceCanFdMsg.byte(2) = 0x00;
      gTraceCanFdMsg.byte(3) = 0x00;
      gTraceCanFdMsg.byte(4) = 0x00;
      gTraceCanFdMsg.byte(5) = 0x10;
      gTraceCanFdMsg.byte(6) = 0x34;
      gTraceCanFdMsg.byte(7) = 0x53;
      gTraceCanFdMsg.byte(8) = 0x00;
      gTraceCanFdMsg.byte(9) = 0x00;
      gTraceCanFdMsg.byte(10) = 0x00;
      gTraceCanFdMsg.byte(11) = 0x00;
      gTraceCanFdMsg.byte(12) = 0x00;
      gTraceCanFdMsg.byte(13) = 0x00;
      gTraceCanFdMsg.byte(14) = 0x16;
      gTraceCanFdMsg.byte(15) = 0x06;
      gTraceCanFdMsg.byte(16) = 0x00;
      gTraceCanFdMsg.byte(17) = 0x00;
      gTraceCanFdMsg.byte(18) = 0x1A;
      gTraceCanFdMsg.byte(19) = 0x01;
      gTraceCanFdMsg.byte(20) = 0x00;
      gTraceCanFdMsg.byte(21) = 0x01;
      gTraceCanFdMsg.byte(22) = 0x00;
      gTraceCanFdMsg.byte(23) = 0x00;
      gTraceCanFdMsg.byte(24) = 0x00;
      gTraceCanFdMsg.byte(25) = 0x00;
      gTraceCanFdMsg.byte(26) = 0x00;
      gTraceCanFdMsg.byte(27) = 0x00;
      gTraceCanFdMsg.byte(28) = 0x00;
      gTraceCanFdMsg.byte(29) = 0x00;
      gTraceCanFdMsg.byte(30) = 0x00;
      gTraceCanFdMsg.byte(31) = 0x00;
      gTraceCanFdMsg.byte(32) = 0x00;
      gTraceCanFdMsg.byte(33) = 0x00;
      gTraceCanFdMsg.byte(34) = 0x00;
      gTraceCanFdMsg.byte(35) = 0x00;
      gTraceCanFdMsg.byte(36) = 0x00;
      gTraceCanFdMsg.byte(37) = 0x00;
      gTraceCanFdMsg.byte(38) = 0x00;
      gTraceCanFdMsg.byte(39) = 0x00;
      gTraceCanFdMsg.byte(40) = 0x00;
      gTraceCanFdMsg.byte(41) = 0x00;
      gTraceCanFdMsg.byte(42) = 0x00;
      gTraceCanFdMsg.byte(43) = 0x00;
      gTraceCanFdMsg.byte(44) = 0x00;
      gTraceCanFdMsg.byte(45) = 0x00;
      gTraceCanFdMsg.byte(46) = 0x00;
      gTraceCanFdMsg.byte(47) = 0x00;
      break;
    case 134:
      gTraceCurrentId = 0x53A;
      gTraceCurrentLength = 8;
      gTraceCanFdMsg.byte(0) = 0x00;
      gTraceCanFdMsg.byte(1) = 0x0E;
      gTraceCanFdMsg.byte(2) = 0x00;
      gTraceCanFdMsg.byte(3) = 0x00;
      gTraceCanFdMsg.byte(4) = 0x7F;
      gTraceCanFdMsg.byte(5) = 0xFF;
      gTraceCanFdMsg.byte(6) = 0x00;
      gTraceCanFdMsg.byte(7) = 0x00;
      break;
    case 135:
      gTraceCurrentId = 0x53C;
      gTraceCurrentLength = 24;
      gTraceCanFdMsg.byte(0) = 0x30;
      gTraceCanFdMsg.byte(1) = 0x35;
      gTraceCanFdMsg.byte(2) = 0x44;
      gTraceCanFdMsg.byte(3) = 0x50;
      gTraceCanFdMsg.byte(4) = 0x42;
      gTraceCanFdMsg.byte(5) = 0x34;
      gTraceCanFdMsg.byte(6) = 0x46;
      gTraceCanFdMsg.byte(7) = 0x51;
      gTraceCanFdMsg.byte(8) = 0x44;
      gTraceCanFdMsg.byte(9) = 0x39;
      gTraceCanFdMsg.byte(10) = 0x32;
      gTraceCanFdMsg.byte(11) = 0x30;
      gTraceCanFdMsg.byte(12) = 0x30;
      gTraceCanFdMsg.byte(13) = 0x31;
      gTraceCanFdMsg.byte(14) = 0x47;
      gTraceCanFdMsg.byte(15) = 0x35;
      gTraceCanFdMsg.byte(16) = 0x39;
      gTraceCanFdMsg.byte(17) = 0x30;
      gTraceCanFdMsg.byte(18) = 0x30;
      gTraceCanFdMsg.byte(19) = 0x30;
      gTraceCanFdMsg.byte(20) = 0x30;
      gTraceCanFdMsg.byte(21) = 0x30;
      gTraceCanFdMsg.byte(22) = 0x30;
      gTraceCanFdMsg.byte(23) = 0x34;
      break;
    case 136:
      gTraceCurrentId = 0x53F;
      gTraceCurrentLength = 16;
      gTraceCanFdMsg.byte(0) = 0x00;
      gTraceCanFdMsg.byte(1) = 0x0E;
      gTraceCanFdMsg.byte(2) = 0x00;
      gTraceCanFdMsg.byte(3) = 0x03;
      gTraceCanFdMsg.byte(4) = 0x04;
      gTraceCanFdMsg.byte(5) = 0x00;
      gTraceCanFdMsg.byte(6) = 0x00;
      gTraceCanFdMsg.byte(7) = 0x02;
      gTraceCanFdMsg.byte(8) = 0x00;
      gTraceCanFdMsg.byte(9) = 0x00;
      gTraceCanFdMsg.byte(10) = 0x00;
      gTraceCanFdMsg.byte(11) = 0x00;
      gTraceCanFdMsg.byte(12) = 0x00;
      gTraceCanFdMsg.byte(13) = 0x00;
      gTraceCanFdMsg.byte(14) = 0x00;
      gTraceCanFdMsg.byte(15) = 0x00;
      break;
    case 137:
      gTraceCurrentId = 0x541;
      gTraceCurrentLength = 32;
      gTraceCanFdMsg.byte(0) = 0x00;
      gTraceCanFdMsg.byte(1) = 0x00;
      gTraceCanFdMsg.byte(2) = 0x00;
      gTraceCanFdMsg.byte(3) = 0x00;
      gTraceCanFdMsg.byte(4) = 0x00;
      gTraceCanFdMsg.byte(5) = 0x00;
      gTraceCanFdMsg.byte(6) = 0x00;
      gTraceCanFdMsg.byte(7) = 0x00;
      gTraceCanFdMsg.byte(8) = 0x00;
      gTraceCanFdMsg.byte(9) = 0x00;
      gTraceCanFdMsg.byte(10) = 0x00;
      gTraceCanFdMsg.byte(11) = 0x00;
      gTraceCanFdMsg.byte(12) = 0x00;
      gTraceCanFdMsg.byte(13) = 0x00;
      gTraceCanFdMsg.byte(14) = 0x00;
      gTraceCanFdMsg.byte(15) = 0x00;
      gTraceCanFdMsg.byte(16) = 0xC7;
      gTraceCanFdMsg.byte(17) = 0x04;
      gTraceCanFdMsg.byte(18) = 0x00;
      gTraceCanFdMsg.byte(19) = 0x00;
      gTraceCanFdMsg.byte(20) = 0x00;
      gTraceCanFdMsg.byte(21) = 0x00;
      gTraceCanFdMsg.byte(22) = 0x00;
      gTraceCanFdMsg.byte(23) = 0x00;
      gTraceCanFdMsg.byte(24) = 0x00;
      gTraceCanFdMsg.byte(25) = 0x00;
      gTraceCanFdMsg.byte(26) = 0x00;
      gTraceCanFdMsg.byte(27) = 0x00;
      gTraceCanFdMsg.byte(28) = 0x00;
      gTraceCanFdMsg.byte(29) = 0x00;
      gTraceCanFdMsg.byte(30) = 0x00;
      gTraceCanFdMsg.byte(31) = 0x00;
      break;
    case 138:
      gTraceCurrentId = 0x547;
      gTraceCurrentLength = 64;
      gTraceCanFdMsg.byte(0) = 0x00;
      gTraceCanFdMsg.byte(1) = 0x00;
      gTraceCanFdMsg.byte(2) = 0x00;
      gTraceCanFdMsg.byte(3) = 0x00;
      gTraceCanFdMsg.byte(4) = 0x00;
      gTraceCanFdMsg.byte(5) = 0x00;
      gTraceCanFdMsg.byte(6) = 0x00;
      gTraceCanFdMsg.byte(7) = 0x00;
      gTraceCanFdMsg.byte(8) = 0x00;
      gTraceCanFdMsg.byte(9) = 0x00;
      gTraceCanFdMsg.byte(10) = 0x00;
      gTraceCanFdMsg.byte(11) = 0x00;
      gTraceCanFdMsg.byte(12) = 0x00;
      gTraceCanFdMsg.byte(13) = 0x00;
      gTraceCanFdMsg.byte(14) = 0x00;
      gTraceCanFdMsg.byte(15) = 0x40;
      gTraceCanFdMsg.byte(16) = 0x00;
      gTraceCanFdMsg.byte(17) = 0x00;
      gTraceCanFdMsg.byte(18) = 0x00;
      gTraceCanFdMsg.byte(19) = 0x00;
      gTraceCanFdMsg.byte(20) = 0x00;
      gTraceCanFdMsg.byte(21) = 0x00;
      gTraceCanFdMsg.byte(22) = 0x00;
      gTraceCanFdMsg.byte(23) = 0x7F;
      gTraceCanFdMsg.byte(24) = 0x00;
      gTraceCanFdMsg.byte(25) = 0x00;
      gTraceCanFdMsg.byte(26) = 0x00;
      gTraceCanFdMsg.byte(27) = 0x00;
      gTraceCanFdMsg.byte(28) = 0x00;
      gTraceCanFdMsg.byte(29) = 0x5A;
      gTraceCanFdMsg.byte(30) = 0x0D;
      gTraceCanFdMsg.byte(31) = 0x7F;
      gTraceCanFdMsg.byte(32) = 0x00;
      gTraceCanFdMsg.byte(33) = 0x00;
      gTraceCanFdMsg.byte(34) = 0x00;
      gTraceCanFdMsg.byte(35) = 0x01;
      gTraceCanFdMsg.byte(36) = 0x00;
      gTraceCanFdMsg.byte(37) = 0x00;
      gTraceCanFdMsg.byte(38) = 0x01;
      gTraceCanFdMsg.byte(39) = 0x00;
      gTraceCanFdMsg.byte(40) = 0x00;
      gTraceCanFdMsg.byte(41) = 0x00;
      gTraceCanFdMsg.byte(42) = 0x00;
      gTraceCanFdMsg.byte(43) = 0x00;
      gTraceCanFdMsg.byte(44) = 0x00;
      gTraceCanFdMsg.byte(45) = 0x00;
      gTraceCanFdMsg.byte(46) = 0x00;
      gTraceCanFdMsg.byte(47) = 0x00;
      gTraceCanFdMsg.byte(48) = 0x00;
      gTraceCanFdMsg.byte(49) = 0x7F;
      gTraceCanFdMsg.byte(50) = 0xFF;
      gTraceCanFdMsg.byte(51) = 0x12;
      gTraceCanFdMsg.byte(52) = 0x00;
      gTraceCanFdMsg.byte(53) = 0x00;
      gTraceCanFdMsg.byte(54) = 0x00;
      gTraceCanFdMsg.byte(55) = 0x79;
      gTraceCanFdMsg.byte(56) = 0x00;
      gTraceCanFdMsg.byte(57) = 0x00;
      gTraceCanFdMsg.byte(58) = 0x00;
      gTraceCanFdMsg.byte(59) = 0x00;
      gTraceCanFdMsg.byte(60) = 0x00;
      gTraceCanFdMsg.byte(61) = 0x00;
      gTraceCanFdMsg.byte(62) = 0x00;
      gTraceCanFdMsg.byte(63) = 0x00;
      break;
    case 139:
      gTraceCurrentId = 0x553;
      gTraceCurrentLength = 8;
      gTraceCanFdMsg.byte(0) = 0x00;
      gTraceCanFdMsg.byte(1) = 0x00;
      gTraceCanFdMsg.byte(2) = 0x00;
      gTraceCanFdMsg.byte(3) = 0x00;
      gTraceCanFdMsg.byte(4) = 0x00;
      gTraceCanFdMsg.byte(5) = 0x02;
      gTraceCanFdMsg.byte(6) = 0x00;
      gTraceCanFdMsg.byte(7) = 0x00;
      break;
    case 140:
      gTraceCurrentId = 0x554;
      gTraceCurrentLength = 64;
      gTraceCanFdMsg.byte(0) = 0x00;
      gTraceCanFdMsg.byte(1) = 0x00;
      gTraceCanFdMsg.byte(2) = 0x00;
      gTraceCanFdMsg.byte(3) = 0x00;
      gTraceCanFdMsg.byte(4) = 0x00;
      gTraceCanFdMsg.byte(5) = 0x00;
      gTraceCanFdMsg.byte(6) = 0x00;
      gTraceCanFdMsg.byte(7) = 0x00;
      gTraceCanFdMsg.byte(8) = 0x00;
      gTraceCanFdMsg.byte(9) = 0x00;
      gTraceCanFdMsg.byte(10) = 0x00;
      gTraceCanFdMsg.byte(11) = 0x00;
      gTraceCanFdMsg.byte(12) = 0x00;
      gTraceCanFdMsg.byte(13) = 0xB4;
      gTraceCanFdMsg.byte(14) = 0x24;
      gTraceCanFdMsg.byte(15) = 0xC3;
      gTraceCanFdMsg.byte(16) = 0x00;
      gTraceCanFdMsg.byte(17) = 0x00;
      gTraceCanFdMsg.byte(18) = 0x00;
      gTraceCanFdMsg.byte(19) = 0x00;
      gTraceCanFdMsg.byte(20) = 0x00;
      gTraceCanFdMsg.byte(21) = 0x00;
      gTraceCanFdMsg.byte(22) = 0x00;
      gTraceCanFdMsg.byte(23) = 0x0D;
      gTraceCanFdMsg.byte(24) = 0x00;
      gTraceCanFdMsg.byte(25) = 0x00;
      gTraceCanFdMsg.byte(26) = 0x00;
      gTraceCanFdMsg.byte(27) = 0x00;
      gTraceCanFdMsg.byte(28) = 0x00;
      gTraceCanFdMsg.byte(29) = 0xF6;
      gTraceCanFdMsg.byte(30) = 0x08;
      gTraceCanFdMsg.byte(31) = 0x50;
      gTraceCanFdMsg.byte(32) = 0x00;
      gTraceCanFdMsg.byte(33) = 0x00;
      gTraceCanFdMsg.byte(34) = 0x00;
      gTraceCanFdMsg.byte(35) = 0x00;
      gTraceCanFdMsg.byte(36) = 0x00;
      gTraceCanFdMsg.byte(37) = 0x00;
      gTraceCanFdMsg.byte(38) = 0x00;
      gTraceCanFdMsg.byte(39) = 0x00;
      gTraceCanFdMsg.byte(40) = 0x00;
      gTraceCanFdMsg.byte(41) = 0x00;
      gTraceCanFdMsg.byte(42) = 0x00;
      gTraceCanFdMsg.byte(43) = 0x00;
      gTraceCanFdMsg.byte(44) = 0x00;
      gTraceCanFdMsg.byte(45) = 0x00;
      gTraceCanFdMsg.byte(46) = 0x00;
      gTraceCanFdMsg.byte(47) = 0x00;
      gTraceCanFdMsg.byte(48) = 0x00;
      gTraceCanFdMsg.byte(49) = 0x00;
      gTraceCanFdMsg.byte(50) = 0x00;
      gTraceCanFdMsg.byte(51) = 0x00;
      gTraceCanFdMsg.byte(52) = 0x00;
      gTraceCanFdMsg.byte(53) = 0x00;
      gTraceCanFdMsg.byte(54) = 0x00;
      gTraceCanFdMsg.byte(55) = 0x00;
      gTraceCanFdMsg.byte(56) = 0x00;
      gTraceCanFdMsg.byte(57) = 0x4C;
      gTraceCanFdMsg.byte(58) = 0x00;
      gTraceCanFdMsg.byte(59) = 0x00;
      gTraceCanFdMsg.byte(60) = 0x00;
      gTraceCanFdMsg.byte(61) = 0x00;
      gTraceCanFdMsg.byte(62) = 0x00;
      gTraceCanFdMsg.byte(63) = 0x00;
      break;
    case 141:
      gTraceCurrentId = 0x556;
      gTraceCurrentLength = 64;
      gTraceCanFdMsg.byte(0) = 0x00;
      gTraceCanFdMsg.byte(1) = 0x00;
      gTraceCanFdMsg.byte(2) = 0x00;
      gTraceCanFdMsg.byte(3) = 0x00;
      gTraceCanFdMsg.byte(4) = 0x00;
      gTraceCanFdMsg.byte(5) = 0x00;
      gTraceCanFdMsg.byte(6) = 0x00;
      gTraceCanFdMsg.byte(7) = 0x00;
      gTraceCanFdMsg.byte(8) = 0x00;
      gTraceCanFdMsg.byte(9) = 0x00;
      gTraceCanFdMsg.byte(10) = 0x00;
      gTraceCanFdMsg.byte(11) = 0x00;
      gTraceCanFdMsg.byte(12) = 0x00;
      gTraceCanFdMsg.byte(13) = 0x00;
      gTraceCanFdMsg.byte(14) = 0x00;
      gTraceCanFdMsg.byte(15) = 0x00;
      gTraceCanFdMsg.byte(16) = 0x00;
      gTraceCanFdMsg.byte(17) = 0x00;
      gTraceCanFdMsg.byte(18) = 0x00;
      gTraceCanFdMsg.byte(19) = 0x00;
      gTraceCanFdMsg.byte(20) = 0x00;
      gTraceCanFdMsg.byte(21) = 0x00;
      gTraceCanFdMsg.byte(22) = 0x00;
      gTraceCanFdMsg.byte(23) = 0x00;
      gTraceCanFdMsg.byte(24) = 0x00;
      gTraceCanFdMsg.byte(25) = 0x00;
      gTraceCanFdMsg.byte(26) = 0x00;
      gTraceCanFdMsg.byte(27) = 0x00;
      gTraceCanFdMsg.byte(28) = 0x00;
      gTraceCanFdMsg.byte(29) = 0x00;
      gTraceCanFdMsg.byte(30) = 0x00;
      gTraceCanFdMsg.byte(31) = 0x00;
      gTraceCanFdMsg.byte(32) = 0x00;
      gTraceCanFdMsg.byte(33) = 0x00;
      gTraceCanFdMsg.byte(34) = 0x00;
      gTraceCanFdMsg.byte(35) = 0x00;
      gTraceCanFdMsg.byte(36) = 0x00;
      gTraceCanFdMsg.byte(37) = 0x00;
      gTraceCanFdMsg.byte(38) = 0x00;
      gTraceCanFdMsg.byte(39) = 0x00;
      gTraceCanFdMsg.byte(40) = 0x00;
      gTraceCanFdMsg.byte(41) = 0x00;
      gTraceCanFdMsg.byte(42) = 0x00;
      gTraceCanFdMsg.byte(43) = 0x00;
      gTraceCanFdMsg.byte(44) = 0x00;
      gTraceCanFdMsg.byte(45) = 0x00;
      gTraceCanFdMsg.byte(46) = 0x00;
      gTraceCanFdMsg.byte(47) = 0x00;
      gTraceCanFdMsg.byte(48) = 0x00;
      gTraceCanFdMsg.byte(49) = 0x00;
      gTraceCanFdMsg.byte(50) = 0x00;
      gTraceCanFdMsg.byte(51) = 0x00;
      gTraceCanFdMsg.byte(52) = 0x00;
      gTraceCanFdMsg.byte(53) = 0x00;
      gTraceCanFdMsg.byte(54) = 0x00;
      gTraceCanFdMsg.byte(55) = 0x00;
      gTraceCanFdMsg.byte(56) = 0x00;
      gTraceCanFdMsg.byte(57) = 0x00;
      gTraceCanFdMsg.byte(58) = 0x00;
      gTraceCanFdMsg.byte(59) = 0x00;
      gTraceCanFdMsg.byte(60) = 0x00;
      gTraceCanFdMsg.byte(61) = 0x00;
      gTraceCanFdMsg.byte(62) = 0x00;
      gTraceCanFdMsg.byte(63) = 0x00;
      break;
    case 142:
      gTraceCurrentId = 0x578;
      gTraceCurrentLength = 16;
      gTraceCanFdMsg.byte(0) = 0x00;
      gTraceCanFdMsg.byte(1) = 0x00;
      gTraceCanFdMsg.byte(2) = 0x50;
      gTraceCanFdMsg.byte(3) = 0x02;
      gTraceCanFdMsg.byte(4) = 0x00;
      gTraceCanFdMsg.byte(5) = 0x02;
      gTraceCanFdMsg.byte(6) = 0x00;
      gTraceCanFdMsg.byte(7) = 0x00;
      gTraceCanFdMsg.byte(8) = 0x00;
      gTraceCanFdMsg.byte(9) = 0x00;
      gTraceCanFdMsg.byte(10) = 0x00;
      gTraceCanFdMsg.byte(11) = 0x00;
      gTraceCanFdMsg.byte(12) = 0x00;
      gTraceCanFdMsg.byte(13) = 0x00;
      gTraceCanFdMsg.byte(14) = 0x00;
      gTraceCanFdMsg.byte(15) = 0x04;
      break;
    case 143:
      gTraceCurrentId = 0x57A;
      gTraceCurrentLength = 8;
      gTraceCanFdMsg.byte(0) = 0x00;
      gTraceCanFdMsg.byte(1) = 0x00;
      gTraceCanFdMsg.byte(2) = 0x00;
      gTraceCanFdMsg.byte(3) = 0x00;
      gTraceCanFdMsg.byte(4) = 0x00;
      gTraceCanFdMsg.byte(5) = 0x00;
      gTraceCanFdMsg.byte(6) = 0x00;
      gTraceCanFdMsg.byte(7) = 0x00;
      break;
    case 144:
      gTraceCurrentId = 0x57B;
      gTraceCurrentLength = 8;
      gTraceCanFdMsg.byte(0) = 0x44;
      gTraceCanFdMsg.byte(1) = 0x0D;
      gTraceCanFdMsg.byte(2) = 0x00;
      gTraceCanFdMsg.byte(3) = 0x04;
      gTraceCanFdMsg.byte(4) = 0x7F;
      gTraceCanFdMsg.byte(5) = 0xFF;
      gTraceCanFdMsg.byte(6) = 0x27;
      gTraceCanFdMsg.byte(7) = 0x10;
      break;
    case 145:
      gTraceCurrentId = 0x57C;
      gTraceCurrentLength = 32;
      gTraceCanFdMsg.byte(0) = 0x00;
      gTraceCanFdMsg.byte(1) = 0x00;
      gTraceCanFdMsg.byte(2) = 0x00;
      gTraceCanFdMsg.byte(3) = 0x00;
      gTraceCanFdMsg.byte(4) = 0x00;
      gTraceCanFdMsg.byte(5) = 0x00;
      gTraceCanFdMsg.byte(6) = 0x00;
      gTraceCanFdMsg.byte(7) = 0x00;
      gTraceCanFdMsg.byte(8) = 0x00;
      gTraceCanFdMsg.byte(9) = 0x00;
      gTraceCanFdMsg.byte(10) = 0x00;
      gTraceCanFdMsg.byte(11) = 0x00;
      gTraceCanFdMsg.byte(12) = 0x00;
      gTraceCanFdMsg.byte(13) = 0x00;
      gTraceCanFdMsg.byte(14) = 0x00;
      gTraceCanFdMsg.byte(15) = 0x00;
      gTraceCanFdMsg.byte(16) = 0x00;
      gTraceCanFdMsg.byte(17) = 0x00;
      gTraceCanFdMsg.byte(18) = 0x00;
      gTraceCanFdMsg.byte(19) = 0x00;
      gTraceCanFdMsg.byte(20) = 0x00;
      gTraceCanFdMsg.byte(21) = 0x00;
      gTraceCanFdMsg.byte(22) = 0x00;
      gTraceCanFdMsg.byte(23) = 0x00;
      gTraceCanFdMsg.byte(24) = 0x00;
      gTraceCanFdMsg.byte(25) = 0x00;
      gTraceCanFdMsg.byte(26) = 0x00;
      gTraceCanFdMsg.byte(27) = 0x00;
      gTraceCanFdMsg.byte(28) = 0x00;
      gTraceCanFdMsg.byte(29) = 0x00;
      gTraceCanFdMsg.byte(30) = 0x00;
      gTraceCanFdMsg.byte(31) = 0x00;
      break;
    case 146:
      gTraceCurrentId = 0x57F;
      gTraceCurrentLength = 16;
      gTraceCanFdMsg.byte(0) = 0x00;
      gTraceCanFdMsg.byte(1) = 0x00;
      gTraceCanFdMsg.byte(2) = 0x00;
      gTraceCanFdMsg.byte(3) = 0x02;
      gTraceCanFdMsg.byte(4) = 0x04;
      gTraceCanFdMsg.byte(5) = 0x0A;
      gTraceCanFdMsg.byte(6) = 0x03;
      gTraceCanFdMsg.byte(7) = 0x00;
      gTraceCanFdMsg.byte(8) = 0x00;
      gTraceCanFdMsg.byte(9) = 0x00;
      gTraceCanFdMsg.byte(10) = 0x00;
      gTraceCanFdMsg.byte(11) = 0x00;
      gTraceCanFdMsg.byte(12) = 0x00;
      gTraceCanFdMsg.byte(13) = 0x00;
      gTraceCanFdMsg.byte(14) = 0x00;
      gTraceCanFdMsg.byte(15) = 0x00;
      break;
    case 147:
      gTraceCurrentId = 0x5AA;
      gTraceCurrentLength = 64;
      gTraceCanFdMsg.byte(0) = 0x00;
      gTraceCanFdMsg.byte(1) = 0x00;
      gTraceCanFdMsg.byte(2) = 0x0F;
      gTraceCanFdMsg.byte(3) = 0xA2;
      gTraceCanFdMsg.byte(4) = 0x00;
      gTraceCanFdMsg.byte(5) = 0x00;
      gTraceCanFdMsg.byte(6) = 0x00;
      gTraceCanFdMsg.byte(7) = 0x00;
      gTraceCanFdMsg.byte(8) = 0x00;
      gTraceCanFdMsg.byte(9) = 0x00;
      gTraceCanFdMsg.byte(10) = 0x0F;
      gTraceCanFdMsg.byte(11) = 0xA0;
      gTraceCanFdMsg.byte(12) = 0x00;
      gTraceCanFdMsg.byte(13) = 0x00;
      gTraceCanFdMsg.byte(14) = 0x80;
      gTraceCanFdMsg.byte(15) = 0x00;
      gTraceCanFdMsg.byte(16) = 0x00;
      gTraceCanFdMsg.byte(17) = 0x00;
      gTraceCanFdMsg.byte(18) = 0x00;
      gTraceCanFdMsg.byte(19) = 0x01;
      gTraceCanFdMsg.byte(20) = 0x74;
      gTraceCanFdMsg.byte(21) = 0x00;
      gTraceCanFdMsg.byte(22) = 0xFD;
      gTraceCanFdMsg.byte(23) = 0x30;
      gTraceCanFdMsg.byte(24) = 0x00;
      gTraceCanFdMsg.byte(25) = 0x00;
      gTraceCanFdMsg.byte(26) = 0x00;
      gTraceCanFdMsg.byte(27) = 0x00;
      gTraceCanFdMsg.byte(28) = 0x3C;
      gTraceCanFdMsg.byte(29) = 0x00;
      gTraceCanFdMsg.byte(30) = 0x00;
      gTraceCanFdMsg.byte(31) = 0x00;
      gTraceCanFdMsg.byte(32) = 0x00;
      gTraceCanFdMsg.byte(33) = 0x00;
      gTraceCanFdMsg.byte(34) = 0x00;
      gTraceCanFdMsg.byte(35) = 0x00;
      gTraceCanFdMsg.byte(36) = 0x00;
      gTraceCanFdMsg.byte(37) = 0x00;
      gTraceCanFdMsg.byte(38) = 0x01;
      gTraceCanFdMsg.byte(39) = 0x20;
      gTraceCanFdMsg.byte(40) = 0x00;
      gTraceCanFdMsg.byte(41) = 0x00;
      gTraceCanFdMsg.byte(42) = 0x00;
      gTraceCanFdMsg.byte(43) = 0x00;
      gTraceCanFdMsg.byte(44) = 0xC4;
      gTraceCanFdMsg.byte(45) = 0x00;
      gTraceCanFdMsg.byte(46) = 0x00;
      gTraceCanFdMsg.byte(47) = 0x00;
      gTraceCanFdMsg.byte(48) = 0x00;
      gTraceCanFdMsg.byte(49) = 0x00;
      gTraceCanFdMsg.byte(50) = 0x00;
      gTraceCanFdMsg.byte(51) = 0x00;
      gTraceCanFdMsg.byte(52) = 0x60;
      gTraceCanFdMsg.byte(53) = 0x00;
      gTraceCanFdMsg.byte(54) = 0x00;
      gTraceCanFdMsg.byte(55) = 0x00;
      gTraceCanFdMsg.byte(56) = 0x00;
      gTraceCanFdMsg.byte(57) = 0x00;
      gTraceCanFdMsg.byte(58) = 0x00;
      gTraceCanFdMsg.byte(59) = 0x00;
      gTraceCanFdMsg.byte(60) = 0x00;
      gTraceCanFdMsg.byte(61) = 0x00;
      gTraceCanFdMsg.byte(62) = 0x00;
      gTraceCanFdMsg.byte(63) = 0x00;
      break;
    case 148:
      gTraceCurrentId = 0x5AC;
      gTraceCurrentLength = 64;
      gTraceCanFdMsg.byte(0) = 0x00;
      gTraceCanFdMsg.byte(1) = 0x00;
      gTraceCanFdMsg.byte(2) = 0x00;
      gTraceCanFdMsg.byte(3) = 0x00;
      gTraceCanFdMsg.byte(4) = 0x00;
      gTraceCanFdMsg.byte(5) = 0x00;
      gTraceCanFdMsg.byte(6) = 0x00;
      gTraceCanFdMsg.byte(7) = 0x00;
      gTraceCanFdMsg.byte(8) = 0x00;
      gTraceCanFdMsg.byte(9) = 0x00;
      gTraceCanFdMsg.byte(10) = 0x00;
      gTraceCanFdMsg.byte(11) = 0x00;
      gTraceCanFdMsg.byte(12) = 0x40;
      gTraceCanFdMsg.byte(13) = 0x00;
      gTraceCanFdMsg.byte(14) = 0x00;
      gTraceCanFdMsg.byte(15) = 0x00;
      gTraceCanFdMsg.byte(16) = 0x00;
      gTraceCanFdMsg.byte(17) = 0x00;
      gTraceCanFdMsg.byte(18) = 0x00;
      gTraceCanFdMsg.byte(19) = 0x00;
      gTraceCanFdMsg.byte(20) = 0x0C;
      gTraceCanFdMsg.byte(21) = 0x64;
      gTraceCanFdMsg.byte(22) = 0x00;
      gTraceCanFdMsg.byte(23) = 0x00;
      gTraceCanFdMsg.byte(24) = 0x40;
      gTraceCanFdMsg.byte(25) = 0x00;
      gTraceCanFdMsg.byte(26) = 0x00;
      gTraceCanFdMsg.byte(27) = 0x00;
      gTraceCanFdMsg.byte(28) = 0x00;
      gTraceCanFdMsg.byte(29) = 0x00;
      gTraceCanFdMsg.byte(30) = 0x00;
      gTraceCanFdMsg.byte(31) = 0xFF;
      gTraceCanFdMsg.byte(32) = 0x00;
      gTraceCanFdMsg.byte(33) = 0x00;
      gTraceCanFdMsg.byte(34) = 0x00;
      gTraceCanFdMsg.byte(35) = 0x40;
      gTraceCanFdMsg.byte(36) = 0x00;
      gTraceCanFdMsg.byte(37) = 0x00;
      gTraceCanFdMsg.byte(38) = 0x00;
      gTraceCanFdMsg.byte(39) = 0x00;
      gTraceCanFdMsg.byte(40) = 0x00;
      gTraceCanFdMsg.byte(41) = 0x00;
      gTraceCanFdMsg.byte(42) = 0x00;
      gTraceCanFdMsg.byte(43) = 0x00;
      gTraceCanFdMsg.byte(44) = 0x00;
      gTraceCanFdMsg.byte(45) = 0x00;
      gTraceCanFdMsg.byte(46) = 0x00;
      gTraceCanFdMsg.byte(47) = 0x01;
      gTraceCanFdMsg.byte(48) = 0xD1;
      gTraceCanFdMsg.byte(49) = 0x5F;
      gTraceCanFdMsg.byte(50) = 0x00;
      gTraceCanFdMsg.byte(51) = 0x00;
      gTraceCanFdMsg.byte(52) = 0x00;
      gTraceCanFdMsg.byte(53) = 0x00;
      gTraceCanFdMsg.byte(54) = 0x00;
      gTraceCanFdMsg.byte(55) = 0x07;
      gTraceCanFdMsg.byte(56) = 0x00;
      gTraceCanFdMsg.byte(57) = 0x00;
      gTraceCanFdMsg.byte(58) = 0x00;
      gTraceCanFdMsg.byte(59) = 0x00;
      gTraceCanFdMsg.byte(60) = 0x00;
      gTraceCanFdMsg.byte(61) = 0x00;
      gTraceCanFdMsg.byte(62) = 0x00;
      gTraceCanFdMsg.byte(63) = 0x00;
      break;
    case 149:
      gTraceCurrentId = 0x5AD;
      gTraceCurrentLength = 16;
      gTraceCanFdMsg.byte(0) = 0x00;
      gTraceCanFdMsg.byte(1) = 0x00;
      gTraceCanFdMsg.byte(2) = 0x00;
      gTraceCanFdMsg.byte(3) = 0x00;
      gTraceCanFdMsg.byte(4) = 0x00;
      gTraceCanFdMsg.byte(5) = 0x00;
      gTraceCanFdMsg.byte(6) = 0x00;
      gTraceCanFdMsg.byte(7) = 0x00;
      gTraceCanFdMsg.byte(8) = 0x00;
      gTraceCanFdMsg.byte(9) = 0x00;
      gTraceCanFdMsg.byte(10) = 0x00;
      gTraceCanFdMsg.byte(11) = 0x00;
      gTraceCanFdMsg.byte(12) = 0x00;
      gTraceCanFdMsg.byte(13) = 0x00;
      gTraceCanFdMsg.byte(14) = 0x00;
      gTraceCanFdMsg.byte(15) = 0x00;
      break;
    case 150:
      gTraceCurrentId = 0x5C4;
      gTraceCurrentLength = 8;
      gTraceCanFdMsg.byte(0) = 0x00;
      gTraceCanFdMsg.byte(1) = 0x00;
      gTraceCanFdMsg.byte(2) = 0x7F;
      gTraceCanFdMsg.byte(3) = 0xFF;
      gTraceCanFdMsg.byte(4) = 0x7F;
      gTraceCanFdMsg.byte(5) = 0x82;
      gTraceCanFdMsg.byte(6) = 0x00;
      gTraceCanFdMsg.byte(7) = 0x00;
      break;
    case 151:
      gTraceCurrentId = 0x5C7;
      gTraceCurrentLength = 32;
      gTraceCanFdMsg.byte(0) = 0x00;
      gTraceCanFdMsg.byte(1) = 0x00;
      gTraceCanFdMsg.byte(2) = 0x00;
      gTraceCanFdMsg.byte(3) = 0x00;
      gTraceCanFdMsg.byte(4) = 0x00;
      gTraceCanFdMsg.byte(5) = 0x00;
      gTraceCanFdMsg.byte(6) = 0x00;
      gTraceCanFdMsg.byte(7) = 0x1A;
      gTraceCanFdMsg.byte(8) = 0x00;
      gTraceCanFdMsg.byte(9) = 0x00;
      gTraceCanFdMsg.byte(10) = 0x11;
      gTraceCanFdMsg.byte(11) = 0x56;
      gTraceCanFdMsg.byte(12) = 0x7F;
      gTraceCanFdMsg.byte(13) = 0x6F;
      gTraceCanFdMsg.byte(14) = 0xF8;
      gTraceCanFdMsg.byte(15) = 0x49;
      gTraceCanFdMsg.byte(16) = 0x00;
      gTraceCanFdMsg.byte(17) = 0x00;
      gTraceCanFdMsg.byte(18) = 0x49;
      gTraceCanFdMsg.byte(19) = 0x45;
      gTraceCanFdMsg.byte(20) = 0x46;
      gTraceCanFdMsg.byte(21) = 0x00;
      gTraceCanFdMsg.byte(22) = 0x00;
      gTraceCanFdMsg.byte(23) = 0x00;
      gTraceCanFdMsg.byte(24) = 0x00;
      gTraceCanFdMsg.byte(25) = 0x00;
      gTraceCanFdMsg.byte(26) = 0x00;
      gTraceCanFdMsg.byte(27) = 0x00;
      gTraceCanFdMsg.byte(28) = 0x00;
      gTraceCanFdMsg.byte(29) = 0x00;
      gTraceCanFdMsg.byte(30) = 0x00;
      gTraceCanFdMsg.byte(31) = 0x00;
      break;
    case 152:
      gTraceCurrentId = 0x5D0;
      gTraceCurrentLength = 32;
      gTraceCanFdMsg.byte(0) = 0x00;
      gTraceCanFdMsg.byte(1) = 0x00;
      gTraceCanFdMsg.byte(2) = 0x00;
      gTraceCanFdMsg.byte(3) = 0x00;
      gTraceCanFdMsg.byte(4) = 0x00;
      gTraceCanFdMsg.byte(5) = 0x00;
      gTraceCanFdMsg.byte(6) = 0x00;
      gTraceCanFdMsg.byte(7) = 0x00;
      gTraceCanFdMsg.byte(8) = 0x00;
      gTraceCanFdMsg.byte(9) = 0x00;
      gTraceCanFdMsg.byte(10) = 0x00;
      gTraceCanFdMsg.byte(11) = 0x00;
      gTraceCanFdMsg.byte(12) = 0x00;
      gTraceCanFdMsg.byte(13) = 0x00;
      gTraceCanFdMsg.byte(14) = 0x00;
      gTraceCanFdMsg.byte(15) = 0x00;
      gTraceCanFdMsg.byte(16) = 0x00;
      gTraceCanFdMsg.byte(17) = 0x00;
      gTraceCanFdMsg.byte(18) = 0x00;
      gTraceCanFdMsg.byte(19) = 0x00;
      gTraceCanFdMsg.byte(20) = 0x00;
      gTraceCanFdMsg.byte(21) = 0x00;
      gTraceCanFdMsg.byte(22) = 0x00;
      gTraceCanFdMsg.byte(23) = 0x00;
      gTraceCanFdMsg.byte(24) = 0x00;
      gTraceCanFdMsg.byte(25) = 0x00;
      gTraceCanFdMsg.byte(26) = 0x00;
      gTraceCanFdMsg.byte(27) = 0x00;
      gTraceCanFdMsg.byte(28) = 0x00;
      gTraceCanFdMsg.byte(29) = 0x00;
      gTraceCanFdMsg.byte(30) = 0x00;
      gTraceCanFdMsg.byte(31) = 0x00;
      break;
    case 153:
      gTraceCurrentId = 0x5D8;
      gTraceCurrentLength = 16;
      gTraceCanFdMsg.byte(0) = 0x00;
      gTraceCanFdMsg.byte(1) = 0x00;
      gTraceCanFdMsg.byte(2) = 0x00;
      gTraceCanFdMsg.byte(3) = 0x00;
      gTraceCanFdMsg.byte(4) = 0x00;
      gTraceCanFdMsg.byte(5) = 0x00;
      gTraceCanFdMsg.byte(6) = 0x00;
      gTraceCanFdMsg.byte(7) = 0x00;
      gTraceCanFdMsg.byte(8) = 0x00;
      gTraceCanFdMsg.byte(9) = 0x00;
      gTraceCanFdMsg.byte(10) = 0x00;
      gTraceCanFdMsg.byte(11) = 0x00;
      gTraceCanFdMsg.byte(12) = 0x00;
      gTraceCanFdMsg.byte(13) = 0x00;
      gTraceCanFdMsg.byte(14) = 0x00;
      gTraceCanFdMsg.byte(15) = 0x00;
      break;
    case 154:
      gTraceCurrentId = 0x5F2;
      gTraceCurrentLength = 32;
      gTraceCanFdMsg.byte(0) = 0x00;
      gTraceCanFdMsg.byte(1) = 0xC1;
      gTraceCanFdMsg.byte(2) = 0x00;
      gTraceCanFdMsg.byte(3) = 0x00;
      gTraceCanFdMsg.byte(4) = 0x00;
      gTraceCanFdMsg.byte(5) = 0x00;
      gTraceCanFdMsg.byte(6) = 0x00;
      gTraceCanFdMsg.byte(7) = 0x00;
      gTraceCanFdMsg.byte(8) = 0x00;
      gTraceCanFdMsg.byte(9) = 0x00;
      gTraceCanFdMsg.byte(10) = 0x00;
      gTraceCanFdMsg.byte(11) = 0x00;
      gTraceCanFdMsg.byte(12) = 0x00;
      gTraceCanFdMsg.byte(13) = 0x00;
      gTraceCanFdMsg.byte(14) = 0x00;
      gTraceCanFdMsg.byte(15) = 0x00;
      gTraceCanFdMsg.byte(16) = 0x00;
      gTraceCanFdMsg.byte(17) = 0x00;
      gTraceCanFdMsg.byte(18) = 0x00;
      gTraceCanFdMsg.byte(19) = 0x00;
      gTraceCanFdMsg.byte(20) = 0x00;
      gTraceCanFdMsg.byte(21) = 0x00;
      gTraceCanFdMsg.byte(22) = 0x00;
      gTraceCanFdMsg.byte(23) = 0x00;
      gTraceCanFdMsg.byte(24) = 0x00;
      gTraceCanFdMsg.byte(25) = 0x00;
      gTraceCanFdMsg.byte(26) = 0x00;
      gTraceCanFdMsg.byte(27) = 0x00;
      gTraceCanFdMsg.byte(28) = 0x00;
      gTraceCanFdMsg.byte(29) = 0x00;
      gTraceCanFdMsg.byte(30) = 0x00;
      gTraceCanFdMsg.byte(31) = 0x00;
      break;
    case 155:
      gTraceCurrentId = 0x5F4;
      gTraceCurrentLength = 32;
      gTraceCanFdMsg.byte(0) = 0x00;
      gTraceCanFdMsg.byte(1) = 0xC0;
      gTraceCanFdMsg.byte(2) = 0x00;
      gTraceCanFdMsg.byte(3) = 0x00;
      gTraceCanFdMsg.byte(4) = 0x00;
      gTraceCanFdMsg.byte(5) = 0x00;
      gTraceCanFdMsg.byte(6) = 0x00;
      gTraceCanFdMsg.byte(7) = 0x00;
      gTraceCanFdMsg.byte(8) = 0x00;
      gTraceCanFdMsg.byte(9) = 0x00;
      gTraceCanFdMsg.byte(10) = 0x00;
      gTraceCanFdMsg.byte(11) = 0x00;
      gTraceCanFdMsg.byte(12) = 0x00;
      gTraceCanFdMsg.byte(13) = 0x00;
      gTraceCanFdMsg.byte(14) = 0x00;
      gTraceCanFdMsg.byte(15) = 0x00;
      gTraceCanFdMsg.byte(16) = 0x00;
      gTraceCanFdMsg.byte(17) = 0x00;
      gTraceCanFdMsg.byte(18) = 0x00;
      gTraceCanFdMsg.byte(19) = 0x00;
      gTraceCanFdMsg.byte(20) = 0x00;
      gTraceCanFdMsg.byte(21) = 0x00;
      gTraceCanFdMsg.byte(22) = 0x00;
      gTraceCanFdMsg.byte(23) = 0x00;
      gTraceCanFdMsg.byte(24) = 0x00;
      gTraceCanFdMsg.byte(25) = 0x00;
      gTraceCanFdMsg.byte(26) = 0x00;
      gTraceCanFdMsg.byte(27) = 0x00;
      gTraceCanFdMsg.byte(28) = 0x00;
      gTraceCanFdMsg.byte(29) = 0x00;
      gTraceCanFdMsg.byte(30) = 0x00;
      gTraceCanFdMsg.byte(31) = 0x00;
      break;
    case 156:
      gTraceCurrentId = 0x5F5;
      gTraceCurrentLength = 8;
      gTraceCanFdMsg.byte(0) = 0xE0;
      gTraceCanFdMsg.byte(1) = 0x32;
      gTraceCanFdMsg.byte(2) = 0x37;
      gTraceCanFdMsg.byte(3) = 0x30;
      gTraceCanFdMsg.byte(4) = 0x30;
      gTraceCanFdMsg.byte(5) = 0x30;
      gTraceCanFdMsg.byte(6) = 0x32;
      gTraceCanFdMsg.byte(7) = 0x30;
      break;
    case 157:
      gTraceCurrentId = 0x5F6;
      gTraceCurrentLength = 32;
      gTraceCanFdMsg.byte(0) = 0x00;
      gTraceCanFdMsg.byte(1) = 0x00;
      gTraceCanFdMsg.byte(2) = 0x00;
      gTraceCanFdMsg.byte(3) = 0x00;
      gTraceCanFdMsg.byte(4) = 0x00;
      gTraceCanFdMsg.byte(5) = 0x00;
      gTraceCanFdMsg.byte(6) = 0x00;
      gTraceCanFdMsg.byte(7) = 0x00;
      gTraceCanFdMsg.byte(8) = 0x00;
      gTraceCanFdMsg.byte(9) = 0x00;
      gTraceCanFdMsg.byte(10) = 0x00;
      gTraceCanFdMsg.byte(11) = 0x00;
      gTraceCanFdMsg.byte(12) = 0x00;
      gTraceCanFdMsg.byte(13) = 0x00;
      gTraceCanFdMsg.byte(14) = 0x00;
      gTraceCanFdMsg.byte(15) = 0x00;
      gTraceCanFdMsg.byte(16) = 0x00;
      gTraceCanFdMsg.byte(17) = 0x00;
      gTraceCanFdMsg.byte(18) = 0x00;
      gTraceCanFdMsg.byte(19) = 0x00;
      gTraceCanFdMsg.byte(20) = 0x00;
      gTraceCanFdMsg.byte(21) = 0x00;
      gTraceCanFdMsg.byte(22) = 0x00;
      gTraceCanFdMsg.byte(23) = 0x00;
      gTraceCanFdMsg.byte(24) = 0x00;
      gTraceCanFdMsg.byte(25) = 0x00;
      gTraceCanFdMsg.byte(26) = 0x00;
      gTraceCanFdMsg.byte(27) = 0x00;
      gTraceCanFdMsg.byte(28) = 0x00;
      gTraceCanFdMsg.byte(29) = 0x00;
      gTraceCanFdMsg.byte(30) = 0x00;
      gTraceCanFdMsg.byte(31) = 0x00;
      break;
    case 158:
      gTraceCurrentId = 0x5F8;
      gTraceCurrentLength = 32;
      gTraceCanFdMsg.byte(0) = 0x00;
      gTraceCanFdMsg.byte(1) = 0x00;
      gTraceCanFdMsg.byte(2) = 0x00;
      gTraceCanFdMsg.byte(3) = 0x00;
      gTraceCanFdMsg.byte(4) = 0x00;
      gTraceCanFdMsg.byte(5) = 0x00;
      gTraceCanFdMsg.byte(6) = 0x00;
      gTraceCanFdMsg.byte(7) = 0x00;
      gTraceCanFdMsg.byte(8) = 0x00;
      gTraceCanFdMsg.byte(9) = 0x00;
      gTraceCanFdMsg.byte(10) = 0x00;
      gTraceCanFdMsg.byte(11) = 0x00;
      gTraceCanFdMsg.byte(12) = 0x00;
      gTraceCanFdMsg.byte(13) = 0x00;
      gTraceCanFdMsg.byte(14) = 0x00;
      gTraceCanFdMsg.byte(15) = 0x00;
      gTraceCanFdMsg.byte(16) = 0x00;
      gTraceCanFdMsg.byte(17) = 0x00;
      gTraceCanFdMsg.byte(18) = 0x00;
      gTraceCanFdMsg.byte(19) = 0x00;
      gTraceCanFdMsg.byte(20) = 0x00;
      gTraceCanFdMsg.byte(21) = 0x00;
      gTraceCanFdMsg.byte(22) = 0x00;
      gTraceCanFdMsg.byte(23) = 0x00;
      gTraceCanFdMsg.byte(24) = 0x00;
      gTraceCanFdMsg.byte(25) = 0x00;
      gTraceCanFdMsg.byte(26) = 0x00;
      gTraceCanFdMsg.byte(27) = 0x00;
      gTraceCanFdMsg.byte(28) = 0x00;
      gTraceCanFdMsg.byte(29) = 0x00;
      gTraceCanFdMsg.byte(30) = 0x00;
      gTraceCanFdMsg.byte(31) = 0x00;
      break;
    case 159:
      gTraceCurrentId = 0x5FA;
      gTraceCurrentLength = 32;
      gTraceCanFdMsg.byte(0) = 0x01;
      gTraceCanFdMsg.byte(1) = 0x01;
      gTraceCanFdMsg.byte(2) = 0x13;
      gTraceCanFdMsg.byte(3) = 0xF0;
      gTraceCanFdMsg.byte(4) = 0x00;
      gTraceCanFdMsg.byte(5) = 0x00;
      gTraceCanFdMsg.byte(6) = 0x00;
      gTraceCanFdMsg.byte(7) = 0x00;
      gTraceCanFdMsg.byte(8) = 0x00;
      gTraceCanFdMsg.byte(9) = 0x00;
      gTraceCanFdMsg.byte(10) = 0x00;
      gTraceCanFdMsg.byte(11) = 0x00;
      gTraceCanFdMsg.byte(12) = 0x00;
      gTraceCanFdMsg.byte(13) = 0x00;
      gTraceCanFdMsg.byte(14) = 0x00;
      gTraceCanFdMsg.byte(15) = 0x00;
      gTraceCanFdMsg.byte(16) = 0x00;
      gTraceCanFdMsg.byte(17) = 0x00;
      gTraceCanFdMsg.byte(18) = 0x00;
      gTraceCanFdMsg.byte(19) = 0x00;
      gTraceCanFdMsg.byte(20) = 0x00;
      gTraceCanFdMsg.byte(21) = 0x00;
      gTraceCanFdMsg.byte(22) = 0x00;
      gTraceCanFdMsg.byte(23) = 0x00;
      gTraceCanFdMsg.byte(24) = 0x00;
      gTraceCanFdMsg.byte(25) = 0x00;
      gTraceCanFdMsg.byte(26) = 0x00;
      gTraceCanFdMsg.byte(27) = 0x00;
      gTraceCanFdMsg.byte(28) = 0x00;
      gTraceCanFdMsg.byte(29) = 0x00;
      gTraceCanFdMsg.byte(30) = 0x00;
      gTraceCanFdMsg.byte(31) = 0x00;
      break;
    case 160:
      gTraceCurrentId = 0x5FB;
      gTraceCurrentLength = 32;
      gTraceCanFdMsg.byte(0) = 0x00;
      gTraceCanFdMsg.byte(1) = 0x0E;
      gTraceCanFdMsg.byte(2) = 0x00;
      gTraceCanFdMsg.byte(3) = 0x00;
      gTraceCanFdMsg.byte(4) = 0x00;
      gTraceCanFdMsg.byte(5) = 0x00;
      gTraceCanFdMsg.byte(6) = 0x05;
      gTraceCanFdMsg.byte(7) = 0x54;
      gTraceCanFdMsg.byte(8) = 0x35;
      gTraceCanFdMsg.byte(9) = 0x54;
      gTraceCanFdMsg.byte(10) = 0x03;
      gTraceCanFdMsg.byte(11) = 0x04;
      gTraceCanFdMsg.byte(12) = 0x64;
      gTraceCanFdMsg.byte(13) = 0x8C;
      gTraceCanFdMsg.byte(14) = 0xA3;
      gTraceCanFdMsg.byte(15) = 0x00;
      gTraceCanFdMsg.byte(16) = 0x18;
      gTraceCanFdMsg.byte(17) = 0x08;
      gTraceCanFdMsg.byte(18) = 0x01;
      gTraceCanFdMsg.byte(19) = 0x01;
      gTraceCanFdMsg.byte(20) = 0x01;
      gTraceCanFdMsg.byte(21) = 0x00;
      gTraceCanFdMsg.byte(22) = 0x6C;
      gTraceCanFdMsg.byte(23) = 0x01;
      gTraceCanFdMsg.byte(24) = 0x01;
      gTraceCanFdMsg.byte(25) = 0x12;
      gTraceCanFdMsg.byte(26) = 0x41;
      gTraceCanFdMsg.byte(27) = 0x30;
      gTraceCanFdMsg.byte(28) = 0x00;
      gTraceCanFdMsg.byte(29) = 0x00;
      gTraceCanFdMsg.byte(30) = 0x00;
      gTraceCanFdMsg.byte(31) = 0x00;
      break;
    case 161:
      gTraceCurrentId = 0x5FF;
      gTraceCurrentLength = 64;
      gTraceCanFdMsg.byte(0) = 0x43;
      gTraceCanFdMsg.byte(1) = 0x43;
      gTraceCanFdMsg.byte(2) = 0x43;
      gTraceCanFdMsg.byte(3) = 0x43;
      gTraceCanFdMsg.byte(4) = 0x43;
      gTraceCanFdMsg.byte(5) = 0x43;
      gTraceCanFdMsg.byte(6) = 0x43;
      gTraceCanFdMsg.byte(7) = 0x44;
      gTraceCanFdMsg.byte(8) = 0x44;
      gTraceCanFdMsg.byte(9) = 0x43;
      gTraceCanFdMsg.byte(10) = 0x43;
      gTraceCanFdMsg.byte(11) = 0x43;
      gTraceCanFdMsg.byte(12) = 0x43;
      gTraceCanFdMsg.byte(13) = 0x43;
      gTraceCanFdMsg.byte(14) = 0x43;
      gTraceCanFdMsg.byte(15) = 0x44;
      gTraceCanFdMsg.byte(16) = 0x43;
      gTraceCanFdMsg.byte(17) = 0x43;
      gTraceCanFdMsg.byte(18) = 0x43;
      gTraceCanFdMsg.byte(19) = 0x43;
      gTraceCanFdMsg.byte(20) = 0x43;
      gTraceCanFdMsg.byte(21) = 0x43;
      gTraceCanFdMsg.byte(22) = 0x43;
      gTraceCanFdMsg.byte(23) = 0x44;
      gTraceCanFdMsg.byte(24) = 0x28;
      gTraceCanFdMsg.byte(25) = 0x28;
      gTraceCanFdMsg.byte(26) = 0x28;
      gTraceCanFdMsg.byte(27) = 0x28;
      gTraceCanFdMsg.byte(28) = 0x28;
      gTraceCanFdMsg.byte(29) = 0x28;
      gTraceCanFdMsg.byte(30) = 0x28;
      gTraceCanFdMsg.byte(31) = 0x28;
      gTraceCanFdMsg.byte(32) = 0x28;
      gTraceCanFdMsg.byte(33) = 0x28;
      gTraceCanFdMsg.byte(34) = 0x28;
      gTraceCanFdMsg.byte(35) = 0x28;
      gTraceCanFdMsg.byte(36) = 0x28;
      gTraceCanFdMsg.byte(37) = 0x28;
      gTraceCanFdMsg.byte(38) = 0x28;
      gTraceCanFdMsg.byte(39) = 0x28;
      gTraceCanFdMsg.byte(40) = 0x28;
      gTraceCanFdMsg.byte(41) = 0x28;
      gTraceCanFdMsg.byte(42) = 0x28;
      gTraceCanFdMsg.byte(43) = 0x28;
      gTraceCanFdMsg.byte(44) = 0x28;
      gTraceCanFdMsg.byte(45) = 0x28;
      gTraceCanFdMsg.byte(46) = 0x28;
      gTraceCanFdMsg.byte(47) = 0x28;
      gTraceCanFdMsg.byte(48) = 0x00;
      gTraceCanFdMsg.byte(49) = 0x60;
      gTraceCanFdMsg.byte(50) = 0x00;
      gTraceCanFdMsg.byte(51) = 0x00;
      gTraceCanFdMsg.byte(52) = 0x00;
      gTraceCanFdMsg.byte(53) = 0x00;
      gTraceCanFdMsg.byte(54) = 0x00;
      gTraceCanFdMsg.byte(55) = 0x00;
      gTraceCanFdMsg.byte(56) = 0x00;
      gTraceCanFdMsg.byte(57) = 0x00;
      gTraceCanFdMsg.byte(58) = 0x00;
      gTraceCanFdMsg.byte(59) = 0x00;
      gTraceCanFdMsg.byte(60) = 0x00;
      gTraceCanFdMsg.byte(61) = 0x00;
      gTraceCanFdMsg.byte(62) = 0x00;
      gTraceCanFdMsg.byte(63) = 0x00;
      break;
    default:
      gTraceCurrentIndex = -1;
      gTraceCurrentId = 0;
      gTraceCurrentLength = 0;
      break;
  }

  gTraceCanFdMsg.ID = gTraceCurrentId;
  gTraceCanFdMsg.CAN = 1;
  gTraceCanFdMsg.DLC = GetCanFdDlcCode(gTraceCurrentLength);
  gTraceCanFdMsg.FDF = 1;
  gTraceCanFdMsg.BRS = 1;
  gTraceCanFdMsg.ESI = 0;
}

void TraceAdvanceIndex()
{
  gTraceNextIndex++;

  if (gTraceNextIndex >= gTraceMsgCount)
  {
    gTraceNextIndex = 0;
    write("All %ld CAN FD trace messages have been sent once; restart from the first ID.", gTraceMsgCount);
  }
}

void SendWakeupMsg_616()
{
  message 0x616 msgWake;

  if ((gState != 1) || (gWakeSendEnabled == 0))
  {
    return;
  }

  msgWake.dlc = 8;
  msgWake.byte(0) = 0x00;
  msgWake.byte(1) = 0x00;
  msgWake.byte(2) = 0x1F;
  msgWake.byte(3) = 0x00;
  msgWake.byte(4) = 0x00;
  msgWake.byte(5) = 0x00;
  msgWake.byte(6) = 0x00;
  msgWake.byte(7) = 0x00;

  output(msgWake);

  if ((gRound <= 10) || ((gRound % 1000) == 0))
  {
    write("Round %ld: send wakeup message 0x616, count=%d", gRound, gSendCount + 1);
  }
}

void FinishRepeatTest()
{
  cancelTimer(tWakeSend);
  cancelTimer(tSleepMonitor);
  cancelTimer(tNextRound);
  cancelTimer(tCanFdObserve);

  gState = 0;
  gTestRunning = 0;
  gWakeSendEnabled = 0;

  write("Wakeup/sleep repeat finished. Wake success=%ld, wake fail=%ld, sleep success=%ld, sleep fail=%ld, CAN FD sent=%ld, CAN FD no-wake=%ld, CAN FD abnormal wake=%ld",
        gWakeSuccessCount, gWakeFailCount, gSleepSuccessCount, gSleepFailCount,
        gTraceSentCount, gCanFdNoWakeCount, gCanFdAbnormalWakeCount);
}

void StartNextRound()
{
  if ((gTotalCount > 0) && (gRound >= gTotalCount))
  {
    FinishRepeatTest();
    return;
  }

  gRound++;
  gState = 1;
  gWakeSendEnabled = 1;
  gSendCount = 0;

  if (gTotalCount > 0)
  {
    write("Round %ld/%ld: start wakeup, send 0x616 every %d ms, max %d frames",
          gRound, gTotalCount, gSendPeriodMs, gMaxSendCount);
  }
  else
  {
    write("Round %ld: start wakeup, send 0x616 every %d ms, max %d frames",
          gRound, gSendPeriodMs, gMaxSendCount);
  }

  setTimer(tWakeSend, 1);
}

void StartSleepDisappearWait()
{
  cancelTimer(tWakeSend);
  cancelTimer(tNextRound);
  cancelTimer(tCanFdObserve);
  gWakeSendEnabled = 0;

  gState = 2;
  write("Round %ld: wait for 0x60B disappear after 0x616 wake, silent=%ld ms, timeout=%ld ms",
        gRound, gSleepSilentTimeMs, gSleepTimeoutMs);

  gSleepSilentElapsedMs = 0;
  gSleepWaitElapsedMs = 0;
  setTimer(tSleepMonitor, gSleepCheckPeriodMs);
}

void StartCanFdProbeDelay()
{
  cancelTimer(tWakeSend);
  cancelTimer(tSleepMonitor);
  cancelTimer(tCanFdObserve);
  gWakeSendEnabled = 0;
  gState = 3;

  write("Round %ld: sleep detected, wait %ld ms before CAN FD probe index %ld/%ld",
        gRound, gNextRoundDelayMs, gTraceNextIndex + 1, gTraceMsgCount);

  setTimer(tNextRound, gNextRoundDelayMs);
}

void SendTraceCanFdProbe()
{
  long indexToSend;

  if (gTraceMsgCount <= 0)
  {
    write("No CAN FD trace messages configured; stop test.");
    FinishRepeatTest();
    return;
  }

  indexToSend = gTraceNextIndex;
  TraceLoadCurrentMessage(indexToSend);

  if (gTraceCurrentIndex < 0)
  {
    write("Invalid CAN FD trace message index %ld; stop test.", indexToSend);
    FinishRepeatTest();
    return;
  }

  gState = 4;
  gCanErrorFrameCountAtProbe = gCanErrorFrameCount;
  setTimer(tCanFdObserve, gCanFdObserveTimeMs);
  output(gTraceCanFdMsg);
  gTraceSentCount++;

  write("Round %ld: send CAN FD probe %ld/%ld, ID=0x%X, length=%d, observe 0x60B for %ld ms",
        gRound, gTraceCurrentIndex + 1, gTraceMsgCount, gTraceCurrentId, gTraceCurrentLength, gCanFdObserveTimeMs);

  TraceAdvanceIndex();
}

void InitializeRepeatTest()
{
  cancelTimer(tWakeSend);
  cancelTimer(tSleepMonitor);
  cancelTimer(tNextRound);
  cancelTimer(tCanFdObserve);

  gState = 0;
  gTestRunning = 1;
  gWakeSendEnabled = 0;
  gRound = 0;
  gWakeSuccessCount = 0;
  gWakeFailCount = 0;
  gSleepSuccessCount = 0;
  gSleepFailCount = 0;
  gSendCount = 0;
  gSleepSilentElapsedMs = 0;
  gSleepWaitElapsedMs = 0;
  gTraceNextIndex = 0;
  gTraceCurrentIndex = -1;
  gTraceCurrentId = 0;
  gTraceCurrentLength = 0;
  gTraceSentCount = 0;
  gCanFdNoWakeCount = 0;
  gCanFdAbnormalWakeCount = 0;
  gCanErrorFrameCount = 0;
  gCanErrorFrameCountAtProbe = 0;

  if (gTotalCount > 0)
  {
    write("Start automatic wakeup/sleep CAN FD probe test, total rounds=%ld, trace messages=%ld.",
          gTotalCount, gTraceMsgCount);
  }
  else
  {
    write("Start automatic wakeup/sleep CAN FD probe test, run forever, trace messages=%ld.",
          gTraceMsgCount);
  }

  StartNextRound();
}

on start
{
  InitializeRepeatTest();
}

on stopMeasurement
{
  cancelTimer(tWakeSend);
  cancelTimer(tSleepMonitor);
  cancelTimer(tNextRound);
  cancelTimer(tCanFdObserve);
  gState = 0;
  gTestRunning = 0;
  gWakeSendEnabled = 0;

  write("Measurement stopped. Wake success=%ld, wake fail=%ld, sleep success=%ld, sleep fail=%ld, CAN FD sent=%ld, CAN FD no-wake=%ld, CAN FD abnormal wake=%ld, next trace index=%ld/%ld",
        gWakeSuccessCount, gWakeFailCount, gSleepSuccessCount, gSleepFailCount,
        gTraceSentCount, gCanFdNoWakeCount, gCanFdAbnormalWakeCount,
        gTraceNextIndex + 1, gTraceMsgCount);
}

on timer tWakeSend
{
  if ((gState != 1) || (gWakeSendEnabled == 0))
  {
    return;
  }

  if (gSendCount < gMaxSendCount)
  {
    SendWakeupMsg_616();
    gSendCount++;
    setTimer(tWakeSend, gSendPeriodMs);
    return;
  }

  gWakeFailCount++;
  gWakeSendEnabled = 0;
  cancelTimer(tWakeSend);

  write("Round %ld wakeup failed: 0x60B not received after %d transmissions of 0x616. Last CAN FD probe index=%ld/%ld, ID=0x%X, errorFrames=%ld. Stop script immediately.",
        gRound, gMaxSendCount, gTraceCurrentIndex + 1, gTraceMsgCount, gTraceCurrentId, gCanErrorFrameCount);

  FinishRepeatTest();
}

on timer tSleepMonitor
{
  if (gState != 2)
  {
    return;
  }

  gSleepSilentElapsedMs = gSleepSilentElapsedMs + gSleepCheckPeriodMs;
  gSleepWaitElapsedMs = gSleepWaitElapsedMs + gSleepCheckPeriodMs;

  if (gSleepSilentElapsedMs >= gSleepSilentTimeMs)
  {
    gSleepSuccessCount++;
    write("Round %ld sleep success after 0x616 wake: 0x60B disappeared for %ld ms",
          gRound, gSleepSilentTimeMs);

    StartCanFdProbeDelay();
    return;
  }

  if (gSleepWaitElapsedMs >= gSleepTimeoutMs)
  {
    gSleepFailCount++;
    write("Round %ld failed: 0x60B did not disappear within %ld ms, stop sequence",
          gRound, gSleepTimeoutMs);

    FinishRepeatTest();
    return;
  }

  setTimer(tSleepMonitor, gSleepCheckPeriodMs);
}

on timer tNextRound
{
  if (gState == 3)
  {
    write("Round %ld: delay finished, send CAN FD probe", gRound);
    SendTraceCanFdProbe();
    return;
  }

  if (gState == 6)
  {
    write("Round %ld: delay finished, start next 0x616 wakeup", gRound);
    gState = 0;
    StartNextRound();
    return;
  }
}

on timer tCanFdObserve
{
  if (gState != 4)
  {
    return;
  }

  gCanFdNoWakeCount++;
  write("Round %ld CAN FD probe no abnormal wake: ID=0x%X, CAN FD abnormal wake count=%ld, no-wake count=%ld, errorFramesDuringProbe=%ld",
        gRound, gTraceCurrentId, gCanFdAbnormalWakeCount, gCanFdNoWakeCount,
        gCanErrorFrameCount - gCanErrorFrameCountAtProbe);

  write("Round %ld: no 0x60B response within %ld ms after CAN FD probe, send normal CAN 0x616 next",
        gRound, gCanFdObserveTimeMs);

  gState = 0;
  StartNextRound();
}

on message 0x60B
{
  if (gState == 1)
  {
    cancelTimer(tWakeSend);
    gWakeSendEnabled = 0;
    gWakeSuccessCount++;

    write("Round %ld wakeup success: detected 0x60B, stop sending 0x616",
          gRound);

    StartSleepDisappearWait();
    return;
  }

  if (gState == 4)
  {
    cancelTimer(tCanFdObserve);
    gCanFdAbnormalWakeCount++;

    write("Round %ld CAN FD abnormal wake detected: ID=0x%X, length=%d, CAN FD abnormal wake count=%ld. Stop script immediately.",
          gRound, gTraceCurrentId, gTraceCurrentLength, gCanFdAbnormalWakeCount);

    FinishRepeatTest();
    return;
  }

  if (gState == 2)
  {
    gSleepSilentElapsedMs = 0;
  }
}

on errorFrame
{
  gCanErrorFrameCount++;

  if ((gCanErrorFrameCount <= 20) || ((gCanErrorFrameCount % 100) == 0))
  {
    write("CAN error frame detected, count=%ld, state=%d, last CAN FD ID=0x%X",
          gCanErrorFrameCount, gState, gTraceCurrentId);
  }
}
